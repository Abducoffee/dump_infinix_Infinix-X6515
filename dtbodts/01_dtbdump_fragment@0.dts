/dts-v1/;

/ {

	__fixups__ {
		Isink1 = "/fragment@31:target:0";
		accdet = "/fragment@14:target:0", "/fragment@58:target:0";
		audgpio = "/fragment@22:target:0";
		auxadc = "/fragment@28/__overlay__:io-channels:48", "/fragment@30/__overlay__:io-channels:0", "/fragment@40:target:0", "/fragment@41/__overlay__:io-channels:0";
		charger = "/fragment@10:target:0", "/fragment@29:target:0", "/fragment@38:target:0";
		chosen = "/fragment@0:target:0";
		consys = "/fragment@21:target:0";
		dsi_te = "/fragment@63:target:0";
		extcon_usb = "/fragment@30:target:0";
		gpio = "/fragment@54:target:0";
		gpio_usage_mapping = "/fragment@53:target:0";
		i2c0 = "/fragment@43:target:0";
		i2c1 = "/fragment@44:target:0";
		i2c2 = "/fragment@5:target:0", "/fragment@45:target:0";
		i2c3 = "/fragment@6:target:0", "/fragment@18:target:0", "/fragment@36:target:0", "/fragment@46:target:0";
		i2c4 = "/fragment@47:target:0";
		i2c5 = "/fragment@48:target:0";
		i2c6 = "/fragment@7:target:0", "/fragment@49:target:0";
		i2c7 = "/fragment@50:target:0";
		i2c8 = "/fragment@51:target:0";
		i2c9 = "/fragment@52:target:0";
		irq_nfc = "/fragment@59:target:0";
		kd_camera_hw1 = "/fragment@1:target:0", "/fragment@72:target:0", "/fragment@76:target:0";
		keypad = "/fragment@8:target:0", "/fragment@74:target:0";
		lk_charger = "/fragment@39:target:0";
		main_pmic = "/fragment@1/__overlay__:pmic:0", "/fragment@64:target:0";
		md1_sim1_hot_plug_eint = "/fragment@65:target:0";
		md_auxadc = "/fragment@41:target:0";
		mrdump_ext_rst = "/fragment@56:target:0";
		msdc1_ins = "/fragment@55:target:0";
		mt6370_chg = "/fragment@17:target:0";
		mt6370_pmu = "/fragment@16:target:0";
		mt6370_typec = "/fragment@19:target:0";
		mt_pmic_vcama_ldo_reg = "/fragment@66:target:0", "/fragment@72/__overlay__:vcama_main2-supply:0", "/fragment@76/__overlay__:cam2_vcama-supply:0";
		mt_pmic_vcamd_ldo_reg = "/fragment@69:target:0", "/fragment@72/__overlay__:vcamd-supply:0", "/fragment@72/__overlay__:vcamd_sub-supply:0", "/fragment@76/__overlay__:cam0_vcamd-supply:0", "/fragment@76/__overlay__:cam1_vcamd-supply:0";
		mt_pmic_vcamio_ldo_reg = "/fragment@70:target:0", "/fragment@72/__overlay__:vcamio-supply:0", "/fragment@72/__overlay__:vcamio_sub-supply:0", "/fragment@76/__overlay__:cam0_vcamio-supply:0", "/fragment@76/__overlay__:cam1_vcamio-supply:0";
		mt_pmic_vldo28_ldo_reg = "/fragment@71:target:0", "/fragment@72/__overlay__:vcamaf-supply:0", "/fragment@73/__overlay__:vtouch-supply:0";
		mt_pmic_vsim1_ldo_reg = "/fragment@67:target:0";
		mt_pmic_vsim2_ldo_reg = "/fragment@68:target:0";
		mtk_charger_type = "/fragment@27:target:0", "/fragment@28/__overlay__:charger:0", "/fragment@29/__overlay__:charger:0", "/fragment@30/__overlay__:charger:0", "/fragment@38/__overlay__:charger:0";
		mtk_gauge = "/fragment@28:target:0";
		mtkfb = "/fragment@25:target:0";
		odm = "/fragment@2:target:0", "/fragment@37:target:0";
		otg_iddig = "/fragment@62:target:0";
		pdc = "/fragment@12:target:0";
		pe2 = "/fragment@11:target:0";
		pe4 = "/fragment@13:target:0";
		pio = "/fragment@1/__overlay__:camera_input_gpio:0", "/fragment@2/__overlay__/fingerprint:interrupt-parent:0", "/fragment@3/__overlay__/fingerprint@0:interrupt-parent:0", "/fragment@3/__overlay__/fingerprint@0:irq-gpio-std:0", "/fragment@3/__overlay__/fingerprint@0:reset-gpio-std:0", "/fragment@4:target:0", "/fragment@9:target:0", "/fragment@15:target:0", "/fragment@16/__overlay__:mt6370,intr_gpio:0", "/fragment@18/__overlay__/rt9465@4b:rt,en_gpio:0", "/fragment@18/__overlay__/rt9465@4b:rt,intr_gpio:0", "/fragment@19/__overlay__:mt6370pd,intr_gpio:0", "/fragment@20:target:0", "/fragment@22/__overlay__:extamp_gpio:0", "/fragment@23:target:0", "/fragment@24:target:0", "/fragment@30/__overlay__:id-gpios:0", "/fragment@32:target:0", "/fragment@35:target:0", "/fragment@36/__overlay__/aw32257@6a:awinic,chg-en-gpio:0", "/fragment@53/__overlay__:GPIO_SIM2_SIO:0", "/fragment@53/__overlay__:GPIO_SIM2_SRST:0", "/fragment@53/__overlay__:GPIO_SIM2_SCLK:0", "/fragment@53/__overlay__:GPIO_SIM1_SCLK:0", "/fragment@53/__overlay__:GPIO_SIM1_SRST:0", "/fragment@53/__overlay__:GPIO_SIM1_SIO:0", "/fragment@53/__overlay__:GPIO_SIM1_HOT_PLUG:0", "/fragment@53/__overlay__:GPIO_FDD_BAND_SUPPORT_DETECT_1ST_PIN:0", "/fragment@53/__overlay__:GPIO_FDD_BAND_SUPPORT_DETECT_2ND_PIN:0", "/fragment@53/__overlay__:GPIO_FDD_BAND_SUPPORT_DETECT_3RD_PIN:0", "/fragment@55/__overlay__:interrupt-parent:0", "/fragment@55/__overlay__:deb-gpios:0", "/fragment@56/__overlay__:interrupt-parent:0", "/fragment@56/__overlay__:deb-gpios:0", "/fragment@57/__overlay__:interrupt-parent:0", "/fragment@58/__overlay__:interrupt-parent:0", "/fragment@58/__overlay__:deb-gpios:0", "/fragment@59/__overlay__:interrupt-parent:0", "/fragment@60/__overlay__:interrupt-parent:0", "/fragment@61/__overlay__:interrupt-parent:0", "/fragment@62/__overlay__:interrupt-parent:0", "/fragment@63/__overlay__:interrupt-parent:0", "/fragment@64/__overlay__:interrupt-parent:0", "/fragment@75:target:0", "/fragment@77:target:0", "/fragment@78:target:0";
		pmic_auxadc = "/fragment@28/__overlay__:io-channels:0", "/fragment@28/__overlay__:io-channels:8", "/fragment@28/__overlay__:io-channels:16", "/fragment@28/__overlay__:io-channels:24", "/fragment@28/__overlay__:io-channels:32", "/fragment@28/__overlay__:io-channels:40";
		pmic_clock_buffer_ctrl = "/fragment@42:target:0";
		rt9465_slave_chr = "/fragment@61:target:0";
		spi0 = "/fragment@3:target:0";
		spi2 = "/fragment@33:target:0";
		subpmic_pmu_eint = "/fragment@60:target:0";
		touch = "/fragment@34:target:0", "/fragment@57:target:0", "/fragment@73:target:0";
		u2port0 = "/fragment@26:target:0";
	};

	__local_fixups__ {

		fragment@14 {

			__overlay__ {
				pinctrl-0 = <0x0>;
				pinctrl-1 = <0x0>;
			};
		};

		fragment@2 {

			__overlay__ {

				fingerprint {
					pinctrl-0 = <0x0>;
					pinctrl-1 = <0x0>;
					pinctrl-2 = <0x0>;
					pinctrl-3 = <0x0>;
					pinctrl-4 = <0x0>;
				};

				flashlights_aw36515 {
					pinctrl-0 = <0x0>;
					pinctrl-1 = <0x0>;
					pinctrl-2 = <0x0>;
				};

				flashlights_ocp81375 {
					pinctrl-0 = <0x0>;
					pinctrl-1 = <0x0>;
					pinctrl-2 = <0x0>;
				};
			};
		};

		fragment@21 {

			__overlay__ {
				pinctrl-0 = <0x0>;
				pinctrl-1 = <0x0>;
				pinctrl-2 = <0x0>;
				pinctrl-3 = <0x0>;
				pinctrl-4 = <0x0>;
				pinctrl-5 = <0x0>;
			};
		};

		fragment@22 {

			__overlay__ {
				pinctrl-0 = <0x0>;
				pinctrl-1 = <0x0>;
				pinctrl-2 = <0x0>;
				pinctrl-3 = <0x0>;
				pinctrl-4 = <0x0>;
				pinctrl-5 = <0x0>;
				pinctrl-6 = <0x0>;
				pinctrl-7 = <0x0>;
			};
		};

		fragment@25 {

			__overlay__ {
				pinctrl-0 = <0x0>;
				pinctrl-1 = <0x0>;
				pinctrl-2 = <0x0>;
				pinctrl-3 = <0x0>;
				pinctrl-4 = <0x0>;
				pinctrl-5 = <0x0>;
				pinctrl-6 = <0x0>;
			};
		};

		fragment@3 {

			__overlay__ {

				fingerprint@0 {
					pinctrl-0 = <0x0>;
					pinctrl-1 = <0x0>;
					pinctrl-2 = <0x0>;
					pinctrl-3 = <0x0>;
					pinctrl-4 = <0x0>;
				};
			};
		};

		fragment@34 {

			__overlay__ {
				pinctrl-0 = <0x0>;
				pinctrl-1 = <0x0>;
				pinctrl-2 = <0x0>;
				pinctrl-3 = <0x0>;
				pinctrl-4 = <0x0>;
				pinctrl-5 = <0x0>;
			};
		};

		fragment@37 {

			__overlay__ {

				tran_battery {
					pinctrl-0 = <0x0>;
					pinctrl-1 = <0x0>;
					pinctrl-2 = <0x0>;
					pinctrl-3 = <0x0>;
					pinctrl-4 = <0x0>;
					pinctrl-5 = <0x0>;
				};
			};
		};

		fragment@76 {

			__overlay__ {
				pinctrl-0 = <0x0>;
				pinctrl-1 = <0x0>;
				pinctrl-10 = <0x0>;
				pinctrl-11 = <0x0>;
				pinctrl-12 = <0x0>;
				pinctrl-13 = <0x0>;
				pinctrl-14 = <0x0>;
				pinctrl-15 = <0x0>;
				pinctrl-16 = <0x0>;
				pinctrl-17 = <0x0>;
				pinctrl-18 = <0x0>;
				pinctrl-2 = <0x0>;
				pinctrl-3 = <0x0>;
				pinctrl-4 = <0x0>;
				pinctrl-5 = <0x0>;
				pinctrl-6 = <0x0>;
				pinctrl-7 = <0x0>;
				pinctrl-8 = <0x0>;
				pinctrl-9 = <0x0>;
			};
		};

		fragment@8 {

			__overlay__ {
				pinctrl-0 = <0x0>;
			};
		};
	};

	__symbols__ {
		accdet_pins_default = "/fragment@15/__overlay__/accdetdefault";
		accdet_pins_eint_as_int = "/fragment@15/__overlay__/accdeteint@0";
		aud_clk_miso_off = "/fragment@23/__overlay__/aud_clk_miso_off";
		aud_clk_miso_on = "/fragment@23/__overlay__/aud_clk_miso_on";
		aud_clk_mosi_off = "/fragment@23/__overlay__/aud_clk_mosi_off";
		aud_clk_mosi_on = "/fragment@23/__overlay__/aud_clk_mosi_on";
		aud_dat_miso_off = "/fragment@23/__overlay__/aud_dat_miso_off";
		aud_dat_miso_on = "/fragment@23/__overlay__/aud_dat_miso_on";
		aud_dat_mosi_off = "/fragment@23/__overlay__/aud_dat_mosi_off";
		aud_dat_mosi_on = "/fragment@23/__overlay__/aud_dat_mosi_on";
		camera_main_af_mtk = "/fragment@45/__overlay__/camera_main_af@0c";
		camera_main_eeprom_mtk = "/fragment@45/__overlay__/camera_main_eeprom@50";
		camera_main_mtk = "/fragment@45/__overlay__/camera_main@1a";
		camera_pins_cam0_mclk_off = "/fragment@75/__overlay__/camera_pins_cam0_mclk_off";
		camera_pins_cam0_mclk_on = "/fragment@75/__overlay__/camera_pins_cam0_mclk_on";
		camera_pins_cam0_pnd0 = "/fragment@75/__overlay__/cam0@2";
		camera_pins_cam0_pnd1 = "/fragment@75/__overlay__/cam0@3";
		camera_pins_cam0_rst0 = "/fragment@75/__overlay__/cam0@0";
		camera_pins_cam0_rst1 = "/fragment@75/__overlay__/cam0@1";
		camera_pins_cam1_mclk_off = "/fragment@75/__overlay__/camera_pins_cam1_mclk_off";
		camera_pins_cam1_mclk_on = "/fragment@75/__overlay__/camera_pins_cam1_mclk_on";
		camera_pins_cam1_pnd0 = "/fragment@75/__overlay__/cam1@2";
		camera_pins_cam1_pnd1 = "/fragment@75/__overlay__/cam1@3";
		camera_pins_cam1_rst0 = "/fragment@75/__overlay__/cam1@0";
		camera_pins_cam1_rst1 = "/fragment@75/__overlay__/cam1@1";
		camera_pins_cam2_mclk_off = "/fragment@75/__overlay__/camera_pins_cam2_mclk_off";
		camera_pins_cam2_mclk_on = "/fragment@75/__overlay__/camera_pins_cam2_mclk_on";
		camera_pins_cam_ldo_rear_vcama_0 = "/fragment@75/__overlay__/cam0@vcama0";
		camera_pins_cam_ldo_rear_vcama_1 = "/fragment@75/__overlay__/cam0@vcama1";
		camera_pins_cam_ldo_sub_vcama_0 = "/fragment@75/__overlay__/cam1@vcama0";
		camera_pins_cam_ldo_sub_vcama_1 = "/fragment@75/__overlay__/cam1@vcama1";
		camera_pins_default = "/fragment@75/__overlay__/camdefault";
		camera_sub_eeprom_mtk = "/fragment@47/__overlay__/camera_sub_eeprom@51";
		camera_sub_mtk = "/fragment@47/__overlay__/camera_sub@2d";
		consys_pins_default = "/fragment@20/__overlay__/consys_default";
		ctp_pins_default = "/fragment@35/__overlay__/eint0default";
		ctp_pins_eint_as_int = "/fragment@35/__overlay__/ctpeint@0";
		ctp_pins_eint_output0 = "/fragment@35/__overlay__/eintoutput0";
		ctp_pins_eint_output1 = "/fragment@35/__overlay__/eintoutput1";
		ctp_pins_rst_output0 = "/fragment@35/__overlay__/rstoutput0";
		ctp_pins_rst_output1 = "/fragment@35/__overlay__/rstoutput1";
		ext_buck_lp4_mtk = "/fragment@46/__overlay__/ext_buck_lp4@57";
		ext_buck_lp4x_mtk = "/fragment@46/__overlay__/ext_buck_lp4x@50";
		ext_buck_vgpu_mtk = "/fragment@49/__overlay__/ext_buck_vgpu@55";
		fingerprint = "/fragment@2/__overlay__/fingerprint";
		fingerprint_default = "/fragment@4/__overlay__/fingerprint_default";
		fingerprint_eint = "/fragment@4/__overlay__/gpio8_eint";
		fingerprint_eint_pull_down = "/fragment@4/__overlay__/gpio8_eint_pull_down";
		fingerprint_rst_one = "/fragment@4/__overlay__/rst_out_one";
		fingerprint_rst_zero = "/fragment@4/__overlay__/rst_out_zero";
		flashlights_aw36515 = "/fragment@2/__overlay__/flashlights_aw36515";
		flashlights_aw36515_pins_default = "/fragment@77/__overlay__/aw36515default";
		flashlights_aw36515_pins_hwen_high = "/fragment@77/__overlay__/aw36515hwen_high";
		flashlights_aw36515_pins_hwen_low = "/fragment@77/__overlay__/aw36515hwen_low";
		flashlights_ocp81375 = "/fragment@2/__overlay__/flashlights_ocp81375";
		flashlights_ocp81375_pins_default = "/fragment@78/__overlay__/ocp81375default";
		flashlights_ocp81375_pins_hwen_high = "/fragment@78/__overlay__/ocp81375hwen_high";
		flashlights_ocp81375_pins_hwen_low = "/fragment@78/__overlay__/ocp81375hwen_low";
		fmgpio_pins_0 = "/fragment@20/__overlay__/fmgpio@4";
		fmgpio_pins_1 = "/fragment@20/__overlay__/fmgpio@3";
		gpio178_otg = "/fragment@32/__overlay__/otg_init";
		gpio178_otg_high = "/fragment@32/__overlay__/otg_high";
		gpio178_otg_low = "/fragment@32/__overlay__/otg_low";
		gpio8_meta = "/fragment@32/__overlay__/meta_init";
		gpio8_meta_high = "/fragment@32/__overlay__/meta_high";
		gpio8_meta_low = "/fragment@32/__overlay__/meta_low";
		gpslna_pins_init = "/fragment@20/__overlay__/gpslna@0";
		gpslna_pins_oh = "/fragment@20/__overlay__/gpslna@1";
		gpslna_pins_ol = "/fragment@20/__overlay__/gpslna@2";
		i2c_lcd_bias_mtk = "/fragment@48/__overlay__/i2c_lcd_bias@3e";
		kpd_pins_default = "/fragment@9/__overlay__/kpdgpiodefault";
		led0 = "/fragment@2/__overlay__/led@0";
		led1 = "/fragment@2/__overlay__/led@1";
		led2 = "/fragment@2/__overlay__/led@2";
		led3 = "/fragment@2/__overlay__/led@3";
		led4 = "/fragment@2/__overlay__/led@4";
		led5 = "/fragment@2/__overlay__/led@5";
		led6 = "/fragment@2/__overlay__/led@6";
		mtkfb_pins_default = "/fragment@24/__overlay__/dispdefault";
		mtkfb_pins_lcd_bias_enn0 = "/fragment@24/__overlay__/lcd_bias_enn0_gpio";
		mtkfb_pins_lcd_bias_enn1 = "/fragment@24/__overlay__/lcd_bias_enn1_gpio";
		mtkfb_pins_lcd_bias_enp0 = "/fragment@24/__overlay__/lcd_bias_enp0_gpio";
		mtkfb_pins_lcd_bias_enp1 = "/fragment@24/__overlay__/lcd_bias_enp1_gpio";
		mtkfb_pins_lcm_reset0 = "/fragment@24/__overlay__/lcm_rst_out0_gpio";
		mtkfb_pins_lcm_reset1 = "/fragment@24/__overlay__/lcm_rst_out1_gpio";
		nfc_mtk = "/fragment@46/__overlay__/nfc@08";
		slave_charger_mtk = "/fragment@46/__overlay__/slave_charger@4b";
		speaker_amp_mtk = "/fragment@46/__overlay__/speaker_amp@34";
		strobe_main_mtk = "/fragment@48/__overlay__/strobe_main@63";
		subpmic_pmu_mtk = "/fragment@48/__overlay__/subpmic_pmu@34";
		tran_battery = "/fragment@37/__overlay__/tran_battery";
		tran_battery_aging = "/fragment@37/__overlay__/tran_battery_aging";
		tran_touch = "/fragment@33/__overlay__/touch@0";
		usb_type_c_mtk = "/fragment@48/__overlay__/usb_type_c@4e";
		vibrator0 = "/fragment@2/__overlay__/vibrator@0";
	};

	fragment@0 {
		target = <0xffffffff>;

		__overlay__ {
			atag,videolfb-fb_base_h = <0x0>;
			atag,videolfb-fb_base_l = "^`P";
			atag,videolfb-fps = <0x1770>;
			atag,videolfb-islcm_inited = <0x0>;
			atag,videolfb-islcmfound = <0x1>;
			atag,videolfb-lcmname = "nt35521_hd_dsi_vdo_truly_rt5081_drv";
			atag,videolfb-vramSize = <0x17bb000>;
		};
	};

	fragment@1 {
		target = <0xffffffff>;

		__overlay__ {
			cam0_enable_sensor = "hi1336_mipi_raw s5k3l6_mipi_raw";
			cam1_enable_sensor = "hi556_mipi_raw gc05a2_mipi_raw";
			cam2_enable_sensor = "fake_serial_yuv";
			camera_input_gpio = <0xffffffff 0x16 0x0>;
			pmic = <0xffffffff>;
		};
	};

	fragment@10 {
		target = <0xffffffff>;

		__overlay__ {
			charger_configuration = <0x1>;
		};
	};

	fragment@11 {
		target = <0xffffffff>;

		__overlay__ {
			dcs_chg1_charger_current = <0x1e8480>;
			dcs_chg2_charger_current = <0x1e8480>;
		};
	};

	fragment@12 {
		target = <0xffffffff>;

		__overlay__ {
			dcs_chg1_charger_current = <0x1e8480>;
			dcs_chg2_charger_current = <0x1e8480>;
			pd_vbus_upper_bound = <0xb71b00>;
		};
	};

	fragment@13 {
		target = <0xffffffff>;

		__overlay__ {
			dcs_chg1_charger_current = <0x1e8480>;
			dcs_chg2_charger_current = <0x1e8480>;
		};
	};

	fragment@14 {
		target = <0xffffffff>;

		__overlay__ {
			accdet-mic-mode = <0x1>;
			accdet-mic-vol = <0x6>;
			accdet-plugout-debounce = <0x1>;
			headset-eint-level-pol = <0x8>;
			headset-four-key-threshold = <0x0 0x3a 0x79 0xc0 0x190>;
			headset-mode-setting = <0x500 0x500 0x1 0x1f0 0x800 0x800 0x20 0x44>;
			headset-three-key-threshold = <0x0 0x50 0xdc 0x190>;
			headset-three-key-threshold-CDD = <0x0 0x79 0xc0 0x258>;
			pinctrl-0 = <0xd>;
			pinctrl-1 = <0xe>;
			pinctrl-names = "default", "state_eint_as_int";
			status = "okay";
		};
	};

	fragment@15 {
		target = <0xffffffff>;

		__overlay__ {

			accdetdefault {
				phandle = <0xd>;
			};

			accdeteint@0 {
				phandle = <0xe>;

				pins_cmd_dat {
					bias-disable;
					pinmux = <0x900>;
					slew-rate = <0x0>;
				};
			};
		};
	};

	fragment@16 {
		target = <0xffffffff>;

		__overlay__ {
			mt6370,intr_gpio = <0xffffffff 0xb 0x0>;
			mt6370,intr_gpio_num = <0xb>;
		};
	};

	fragment@17 {
		target = <0xffffffff>;

		__overlay__ {
			bc12_sel = <0x1>;
		};
	};

	fragment@18 {
		target = <0xffffffff>;

		__overlay__ {

			rt9465@4b {
				charger_name = "secondary_chg";
				compatible = "richtek,rt9465";
				cv = <0x456d70>;
				en_st;
				en_wdt;
				ichg = <0x16e360>;
				ieoc = <0xaae60>;
				interrupt-names = "wdtmri";
				mivr = <0x44aa20>;
				reg = <0x4b>;
				rt,en_gpio = <0xffffffff 0xb0 0x0>;
				rt,en_gpio_num = <0xb0>;
				rt,intr_gpio = <0xffffffff 0x17 0x0>;
				rt,intr_gpio_num = <0x17>;
				safety_timer = <0xc>;
				status = "okay";
			};
		};
	};

	fragment@19 {
		target = <0xffffffff>;

		__overlay__ {
			mt6370pd,intr_gpio = <0xffffffff 0x29 0x0>;
			mt6370pd,intr_gpio_num = <0x29>;
		};
	};

	fragment@2 {
		target = <0xffffffff>;

		__overlay__ {

			fingerprint {
				compatible = "tran_fp";
				debounce = <0x8 0x0>;
				interrupt-parent = <0xffffffff>;
				interrupts = <0x8 0x1 0x8 0x0>;
				phandle = <0x4d>;
				pinctrl-0 = <0x7>;
				pinctrl-1 = <0x8>;
				pinctrl-2 = <0x9>;
				pinctrl-3 = <0xa>;
				pinctrl-4 = <0xb>;
				pinctrl-names = "tran_fp_default", "tran_fp_pin_irq", "tran_fp_irq_pull_down", "tran_fp_reset_high", "tran_fp_reset_low";
				status = "okay";
			};

			flashlights_aw36515 {
				compatible = "mediatek,flashlights_aw36515";
				phandle = <0x43>;
				pinctrl-0 = <0x1>;
				pinctrl-1 = <0x2>;
				pinctrl-2 = <0x3>;
				pinctrl-names = "aw36515default", "aw36515hwen_high", "aw36515hwen_low";
				status = "okay";
			};

			flashlights_ocp81375 {
				compatible = "mediatek,flashlights_ocp81375";
				phandle = <0x44>;
				pinctrl-0 = <0x4>;
				pinctrl-1 = <0x5>;
				pinctrl-2 = <0x6>;
				pinctrl-names = "ocp81375default", "ocp81375hwen_high", "ocp81375hwen_low";
				status = "okay";
			};

			led@0 {
				compatible = "mediatek,red";
				data = <0x1>;
				led_mode = <0x0>;
				phandle = <0x45>;
				pwm_config = <0x0 0x0 0x0 0x0 0x0>;
			};

			led@1 {
				compatible = "mediatek,green";
				data = <0x1>;
				led_mode = <0x0>;
				phandle = <0x46>;
				pwm_config = <0x0 0x0 0x0 0x0 0x0>;
			};

			led@2 {
				compatible = "mediatek,blue";
				data = <0x1>;
				led_mode = <0x0>;
				phandle = <0x47>;
				pwm_config = <0x0 0x0 0x0 0x0 0x0>;
			};

			led@3 {
				compatible = "mediatek,jogball-backlight";
				data = <0x1>;
				led_mode = <0x0>;
				phandle = <0x48>;
				pwm_config = <0x0 0x0 0x0 0x0 0x0>;
			};

			led@4 {
				compatible = "mediatek,keyboard-backlight";
				data = <0x1>;
				led_mode = <0x0>;
				phandle = <0x49>;
				pwm_config = <0x0 0x0 0x0 0x0 0x0>;
			};

			led@5 {
				compatible = "mediatek,button-backlight";
				data = <0x1>;
				led_mode = <0x0>;
				phandle = <0x4a>;
				pwm_config = <0x0 0x0 0x0 0x0 0x0>;
			};

			led@6 {
				compatible = "mediatek,lcd-backlight";
				data = <0x1>;
				led_mode = <0x5>;
				phandle = <0x4b>;
				pwm_config = <0x1 0x0 0x0 0x0 0x0>;
			};

			vibrator@0 {
				compatible = "mediatek,vibrator";
				phandle = <0x4c>;
				vib_limit = <0x9>;
				vib_timer = <0x19>;
				vib_vol = <0x9>;
			};
		};
	};

	fragment@20 {
		target = <0xffffffff>;

		__overlay__ {

			consys_default {
				phandle = <0xf>;
			};

			fmgpio@3 {
				phandle = <0x13>;

				pins_cmd_dat {
					output-high;
					pinmux = <0xaf00>;
					slew-rate = <0x1>;
				};
			};

			fmgpio@4 {
				phandle = <0x14>;

				pins_cmd_dat {
					output-low;
					pinmux = <0xaf00>;
					slew-rate = <0x1>;
				};
			};

			gpslna@0 {
				phandle = <0x10>;

				pins_cmd_dat {
					bias-disable;
					output-low;
					pinmux = <0x5b00>;
					slew-rate = <0x0>;
				};
			};

			gpslna@1 {
				phandle = <0x11>;

				pins_cmd_dat {
					output-high;
					pinmux = <0x5b00>;
					slew-rate = <0x1>;
				};
			};

			gpslna@2 {
				phandle = <0x12>;

				pins_cmd_dat {
					output-low;
					pinmux = <0x5b00>;
					slew-rate = <0x1>;
				};
			};
		};
	};

	fragment@21 {
		target = <0xffffffff>;

		__overlay__ {
			pinctrl-0 = <0xf>;
			pinctrl-1 = <0x10>;
			pinctrl-2 = <0x11>;
			pinctrl-3 = <0x12>;
			pinctrl-4 = <0x13>;
			pinctrl-5 = <0x14>;
			pinctrl-names = "default", "gps_lna_state_init", "gps_lna_state_oh", "gps_lna_state_ol", "fm_gpio_func_1", "fm_gpio_func_0";
			status = "okay";
		};
	};

	fragment@22 {
		target = <0xffffffff>;

		__overlay__ {
			extamp_gpio = <0xffffffff 0x97 0x0>;
			extamp_mode = <0x2>;
			extamp_speech_mode = <0x2>;
			pinctrl-0 = <0x15>;
			pinctrl-1 = <0x16>;
			pinctrl-2 = <0x17>;
			pinctrl-3 = <0x18>;
			pinctrl-4 = <0x19>;
			pinctrl-5 = <0x1a>;
			pinctrl-6 = <0x1b>;
			pinctrl-7 = <0x1c>;
			pinctrl-names = "aud_clk_mosi_off", "aud_clk_mosi_on", "aud_clk_miso_off", "aud_clk_miso_on", "aud_dat_mosi_off", "aud_dat_mosi_on", "aud_dat_miso_off", "aud_dat_miso_on", "aud_smartpa_off", "aud_smartpa_on";
			status = "okay";
		};
	};

	fragment@23 {
		target = <0xffffffff>;

		__overlay__ {

			aud_clk_miso_off {
				phandle = <0x17>;

				pins_cmd0_dat {
					pinmux = <0x8c00>;
				};
			};

			aud_clk_miso_on {
				phandle = <0x18>;

				pins_cmd0_dat {
					pinmux = <0x8c01>;
				};
			};

			aud_clk_mosi_off {
				phandle = <0x15>;

				pins_cmd0_dat {
					pinmux = <0x8800>;
				};
			};

			aud_clk_mosi_on {
				phandle = <0x16>;

				pins_cmd0_dat {
					pinmux = <0x8801>;
				};
			};

			aud_dat_miso_off {
				phandle = <0x1b>;

				pins_cmd1_dat {
					bias-disable;
					input-enable;
					pinmux = <0x8e00>;
					slew-rate = <0x0>;
				};

				pins_cmd2_dat {
					bias-disable;
					input-enable;
					pinmux = <0x8f00>;
					slew-rate = <0x0>;
				};
			};

			aud_dat_miso_on {
				phandle = <0x1c>;

				pins_cmd1_dat {
					pinmux = <0x8e01>;
				};

				pins_cmd2_dat {
					pinmux = <0x8f01>;
				};
			};

			aud_dat_mosi_off {
				phandle = <0x19>;

				pins_cmd1_dat {
					bias-disable;
					input-enable;
					pinmux = <0x8a00>;
					slew-rate = <0x0>;
				};

				pins_cmd2_dat {
					bias-disable;
					input-enable;
					pinmux = <0x8b00>;
					slew-rate = <0x0>;
				};
			};

			aud_dat_mosi_on {
				phandle = <0x1a>;

				pins_cmd1_dat {
					pinmux = <0x8a01>;
				};

				pins_cmd2_dat {
					pinmux = <0x8b01>;
				};
			};
		};
	};

	fragment@24 {
		target = <0xffffffff>;

		__overlay__ {

			dispdefault {
				phandle = <0x1d>;
			};

			lcd_bias_enn0_gpio {
				phandle = <0x22>;

				pins_cmd_dat {
					output-low;
					pinmux = <0x9f00>;
					slew-rate = <0x1>;
				};
			};

			lcd_bias_enn1_gpio {
				phandle = <0x23>;

				pins_cmd_dat {
					output-high;
					pinmux = <0x9f00>;
					slew-rate = <0x1>;
				};
			};

			lcd_bias_enp0_gpio {
				phandle = <0x20>;

				pins_cmd_dat {
					output-low;
					pinmux = <0x9a00>;
					slew-rate = <0x1>;
				};
			};

			lcd_bias_enp1_gpio {
				phandle = <0x21>;

				pins_cmd_dat {
					output-high;
					pinmux = <0x9a00>;
					slew-rate = <0x1>;
				};
			};

			lcm_rst_out0_gpio {
				phandle = <0x1e>;

				pins_cmd_dat {
					output-low;
					pinmux = <0x2d00>;
					slew-rate = <0x1>;
				};
			};

			lcm_rst_out1_gpio {
				phandle = <0x1f>;

				pins_cmd_dat {
					output-high;
					pinmux = <0x2d00>;
					slew-rate = <0x1>;
				};
			};
		};
	};

	fragment@25 {
		target = <0xffffffff>;

		__overlay__ {
			pinctrl-0 = <0x1d>;
			pinctrl-1 = <0x1e>;
			pinctrl-2 = <0x1f>;
			pinctrl-3 = <0x20>;
			pinctrl-4 = <0x21>;
			pinctrl-5 = <0x22>;
			pinctrl-6 = <0x23>;
			pinctrl-names = "dispdefault", "lcm_rst_out0_gpio", "lcm_rst_out1_gpio", "lcd_bias_enp0_gpio", "lcd_bias_enp1_gpio", "lcd_bias_enn0_gpio", "lcd_bias_enn1_gpio";
			status = "okay";
		};
	};

	fragment@26 {
		target = <0xffffffff>;

		__overlay__ {
			mediatek,eye-rev6 = <0x1>;
			mediatek,eye-term = <0x6>;
			mediatek,eye-vrt = <0x6>;
			mediatek,host-eye-rev6 = <0x1>;
			mediatek,host-eye-term = <0x4>;
			mediatek,host-eye-vrt = <0x4>;
		};
	};

	fragment@27 {
		target = <0xffffffff>;

		__overlay__ {
			bc12_active = <0x1>;
		};
	};

	fragment@28 {
		target = <0xffffffff>;

		__overlay__ {
			charger = <0xffffffff>;
			io-channel-names = "pmic_battery_temp", "pmic_battery_voltage", "pmic_bif_voltage", "pmic_ptim_voltage", "pmic_ptim_r", "pmic_isense_voltage", "batteryID-channel";
			io-channels = <0xffffffff 0x3 0xffffffff 0x1 0xffffffff 0xe 0xffffffff 0xf 0xffffffff 0x10 0xffffffff 0x1 0xffffffff 0x3>;
		};
	};

	fragment@29 {
		target = <0xffffffff>;

		__overlay__ {
			charger = <0xffffffff>;
		};
	};

	fragment@3 {
		target = <0xffffffff>;

		__overlay__ {

			fingerprint@0 {
				compatible = "tran_fp";
				debounce = <0x8 0x0>;
				interrupt-parent = <0xffffffff>;
				interrupts = <0x8 0x1 0x8 0x0>;
				irq-gpio = <0x8>;
				irq-gpio-std = <0xffffffff 0x8 0x0>;
				pinctrl-0 = <0x7>;
				pinctrl-1 = <0x8>;
				pinctrl-2 = <0x9>;
				pinctrl-3 = <0xa>;
				pinctrl-4 = <0xb>;
				pinctrl-names = "tran_fp_default", "tran_fp_pin_irq", "tran_fp_irq_pull_down", "tran_fp_reset_high", "tran_fp_reset_low", "tran_fp_spi_default";
				reg = <0x0>;
				reset-gpio = <0x18>;
				reset-gpio-std = <0xffffffff 0x18 0x0>;
				spi-max-frequency = <0x19bfcc0>;
				status = "okay";
			};
		};
	};

	fragment@30 {
		target = <0xffffffff>;

		__overlay__ {
			charger = <0xffffffff>;
			id-gpios = <0xffffffff 0x29 0x0>;
			io-channel-names = "AUX_CHG";
			io-channels = <0xffffffff 0x4>;
		};
	};

	fragment@31 {
		target = <0xffffffff>;

		__overlay__ {
			label = "blue";
		};
	};

	fragment@32 {
		target = <0xffffffff>;

		__overlay__ {

			meta_high {
				phandle = <0x2f>;

				pins_cmd_dat {
					output-high;
					pinmux = <0xab00>;
					slew-rate = <0x1>;
				};
			};

			meta_init {
				phandle = <0x2d>;

				pins_cmd_dat {
					pinmux = <0xab00>;
					slew-rate = <0x1>;
				};
			};

			meta_low {
				phandle = <0x2e>;

				pins_cmd_dat {
					output-low;
					pinmux = <0xab00>;
					slew-rate = <0x1>;
				};
			};

			otg_high {
				phandle = <0x2c>;

				pins_cmd_dat {
					output-high;
					pinmux = <0x1500>;
					slew-rate = <0x1>;
				};
			};

			otg_init {
				phandle = <0x2a>;

				pins_cmd_dat {
					pinmux = <0x1500>;
					slew-rate = <0x1>;
				};
			};

			otg_low {
				phandle = <0x2b>;

				pins_cmd_dat {
					output-low;
					pinmux = <0x1500>;
					slew-rate = <0x1>;
				};
			};
		};
	};

	fragment@33 {
		target = <0xffffffff>;

		__overlay__ {

			touch@0 {
				compatible = "mediatek,cap_touch_2", "focaltech,fts";
				omnivision,block-delay-us = <0x0>;
				omnivision,byte-delay-us = <0x0>;
				omnivision,irq-on-state = <0x0>;
				omnivision,power-delay-ms = <0xc8>;
				omnivision,reset-active-ms = <0x14>;
				omnivision,reset-delay-ms = <0xc8>;
				omnivision,reset-on-state = <0x0>;
				omnivision,spi-mode = <0x3>;
				omnivision,ubl-byte-delay-us = <0x14>;
				omnivision,ubl-max-freq = <0x7a1200>;
				phandle = <0x4e>;
				pt11_hi_limits_01 = <0x32 0x32 0x32 0x32 0x32 0x32 0x32 0x32 0x32 0x32 0x32 0x32 0x32 0x32 0x32 0x32 0x32 0x32 0x32 0x32 0x32 0x32 0x32 0x32 0x32 0x32 0x32 0x32 0x32 0x32 0x32 0x32 0x32 0x32 0x32 0x32 0x32 0x32 0x32 0x32 0x32 0x32 0x32 0x32 0x32 0x32 0x32 0x32 0x32 0x32 0x32 0x32 0x32 0x32 0x32 0x32 0x32 0x32 0x32 0x32 0x32 0x32 0x32 0x32 0x32 0x32 0x32 0x32 0x32 0x32 0x32 0x32 0x32 0x32 0x32 0x32 0x32 0x32 0x32 0x32 0x32 0x32 0x32 0x32 0x32 0x32 0x32 0x32 0x32 0x32 0x32 0x32 0x32 0x32 0x32 0x32 0x32 0x32 0x32 0x32 0x32 0x32 0x32 0x32 0x32 0x32 0x32 0x32 0x32 0x32 0x32 0x32 0x32 0x32 0x32 0x32 0x32 0x32 0x32 0x32 0x32 0x32 0x32 0x32 0x32 0x32 0x32 0x32 0x32 0x32 0x32 0x32 0x32 0x32 0x32 0x32 0x32 0x32 0x32 0x32 0x32 0x32 0x32 0x32 0x32 0x32 0x32 0x32 0x32 0x32 0x32 0x32 0x32 0x32 0x32 0x32 0x32 0x32 0x32 0x32 0x32 0x32 0x32 0x32 0x32 0x32 0x32 0x32 0x32 0x32 0x32 0x32 0x32 0x32 0x32 0x32 0x32 0x32 0x32 0x32 0x32 0x32 0x32 0x32 0x32 0x32 0x32 0x32 0x32 0x32 0x32 0x32 0x32 0x32 0x32 0x32 0x32 0x32 0x32 0x32 0x32 0x32 0x32 0x32 0x32 0x32 0x32 0x32 0x32 0x32 0x32 0x32 0x32 0x32 0x32 0x32 0x32 0x32 0x32 0x32 0x32 0x32 0x32 0x32 0x32 0x32 0x32 0x32 0x32 0x32 0x32 0x32 0x32 0x32 0x32 0x32 0x32 0x32 0x32 0x32 0x32 0x32 0x32 0x32 0x32 0x32 0x32 0x32 0x32 0x32 0x32 0x32 0x32 0x32 0x32 0x32 0x32 0x32 0x32 0x32 0x32 0x32 0x32 0x32 0x32 0x32 0x32 0x32 0x32 0x32 0x32 0x32 0x32 0x32 0x32 0x32 0x32 0x32 0x32 0x32 0x32 0x32 0x32 0x32 0x32 0x32 0x32 0x32 0x32 0x32 0x32 0x32 0x32 0x32 0x32 0x32 0x32 0x32 0x32 0x32 0x32 0x32 0x32 0x32 0x32 0x32 0x32 0x32 0x32 0x32 0x32 0x32 0x32 0x32 0x32 0x32 0x32 0x32 0x32 0x32 0x32 0x32 0x32 0x32 0x32 0x32 0x32 0x32 0x32 0x32 0x32 0x32 0x32 0x32 0x32 0x32 0x32 0x32 0x32 0x32 0x32 0x32 0x32 0x32 0x32 0x32 0x32 0x32 0x32 0x32 0x32 0x32 0x32 0x32 0x32 0x32 0x32 0x32 0x32 0x32 0x32 0x32 0x32 0x32 0x32 0x32 0x32 0x32 0x32 0x32 0x32 0x32 0x32 0x32 0x32 0x32 0x32 0x32 0x32 0x32 0x32 0x32 0x32 0x32 0x32 0x32 0x32 0x32 0x32 0x32 0x32 0x32 0x32 0x32 0x32 0x32 0x32 0x32 0x32 0x32 0x32 0x32 0x32 0x32 0x32 0x32 0x32 0x32 0x32 0x32 0x32 0x32 0x32 0x32 0x32 0x32 0x32 0x32 0x32 0x32 0x32 0x32 0x32 0x32 0x32 0x32 0x32 0x32 0x32 0x32 0x32 0x32 0x32 0x32 0x32 0x32 0x32 0x32 0x32 0x32 0x32 0x32 0x32 0x32 0x32 0x32 0x32 0x32 0x32 0x32 0x32 0x32 0x32 0x32 0x32 0x32 0x32 0x32 0x32 0x32 0x32 0x32 0x32 0x32 0x32 0x32 0x32 0x32 0x32 0x32 0x32 0x32 0x32 0x32 0x32 0x32 0x32 0x32 0x32 0x32 0x32 0x32 0x32 0x32 0x32 0x32 0x32 0x32 0x32 0x32 0x32 0x32 0x32 0x32 0x32 0x32 0x32 0x32 0x32 0x32 0x32 0x32 0x32 0x32 0x32 0x32 0x32 0x32 0x32 0x32 0x32 0x32 0x32 0x32 0x32 0x32 0x32 0x32 0x32 0x32 0x32 0x32 0x32 0x32 0x32 0x32 0x32 0x32 0x32 0x32 0x32 0x32 0x32 0x32 0x32 0x32 0x32 0x32 0x32 0x32 0x32 0x32 0x32 0x32 0x32 0x32 0x32 0x32 0x32 0x32 0x32 0x32 0x32 0x32 0x32 0x32 0x32 0x32 0x32 0x32 0x32 0x32 0x32 0x32 0x32 0x32 0x32 0x32 0x32 0x32 0x32 0x32 0x32 0x32 0x32 0x32 0x32 0x32 0x32 0x32 0x32 0x32 0x32 0x32 0x32 0x32 0x32 0x32 0x32 0x32 0x32 0x32 0x32 0x32 0x32 0x32 0x32 0x32 0x32 0x32 0x32 0x32 0x32 0x32 0x32 0x32 0x32 0x32 0x32 0x32 0x32 0x32 0x32 0x32 0x32 0x32 0x32 0x32 0x32 0x32 0x32 0x32 0x32 0x32 0x32 0x32 0x32 0x32 0x32 0x32 0x32 0x32 0x32 0x32 0x32 0x32 0x32 0x32 0x32 0x32 0x32 0x32 0x32 0x32 0x32 0x32 0x32 0x32 0x32 0x32 0x32 0x32 0x32 0x32 0x32 0x32 0x32 0x32 0x32 0x32 0x32 0x32 0x32 0x32 0x32 0x32 0x32 0x32 0x32 0x32 0x32 0x32 0x32 0x32 0x32 0x32 0x32 0x32 0x32 0x32 0x32 0x32 0x32 0x32 0x32 0x32 0x32 0x32 0x32 0x32 0x32 0x32 0x32 0x32 0x32 0x32 0x32 0x32 0x32 0x32 0x32 0x32 0x32 0x32 0x32 0x32 0x32 0x32 0x32 0x32 0x32 0x32 0x32 0x32 0x32 0x32 0x32 0x32 0x32 0x32 0x32 0x32 0x32 0x32 0x32 0x32 0x32 0x32 0x32 0x32 0x32 0x32 0x32 0x32 0x32 0x32 0x32 0x32 0x32 0x32 0x32 0x32 0x32 0x32 0x32 0x32 0x32 0x32 0x32 0x32 0x32 0x32 0x32 0x32 0x32 0x32 0x32 0x32 0x32 0x32 0x32 0x32 0x32 0x32 0x32 0x32 0x32 0x32 0x32 0x32 0x32 0x32 0x32 0x32 0x32 0x32 0x32 0x32 0x32 0x32 0x32 0x32 0x32 0x32 0x32 0x32 0x32 0x32 0x32 0x32 0x32 0x32 0x32 0x32 0x32 0x32 0x32 0x32 0x32 0x32 0x32 0x32 0x32 0x32 0x32 0x32 0x32 0x32 0x32 0x32 0x32 0x32 0x32 0x32 0x32 0x32 0x32 0x32 0x32 0x32 0x32 0x32 0x32 0x32 0x32 0x32 0x32 0x32 0x32 0x32 0x32 0x32 0x32 0x32 0x32 0x32 0x32 0x32 0x32 0x32 0x32 0x32 0x32 0x32 0x32 0x32 0x32 0x32 0x32 0x32 0x32 0x32 0x32 0x32 0x32 0x32 0x32 0x32 0x32 0x32 0x32 0x32 0x32 0x32 0x32 0x32 0x32 0x32 0x32 0x32 0x32 0x32 0x32 0x32 0x32 0x32 0x32 0x32 0x32 0x32 0x32 0x32 0x32 0x32 0x32 0x32 0x32 0x32 0x32 0x32 0x32 0x32 0x32 0x32 0x32 0x32 0x32 0x32 0x32 0x32 0x32 0x32 0x32 0x32 0x32 0x32 0x32 0x32 0x32 0x32 0x32 0x32 0x32 0x32 0x32 0x32 0x32 0x32 0x32 0x32 0x32 0x32 0x32 0x32 0x32 0x32 0x32 0x32 0x32 0x32 0x32 0x32 0x32 0x32 0x32 0x32 0x32 0x32 0x32 0x32 0x32 0x32 0x32 0x32 0x32 0x32 0x32 0x32 0x32 0x32 0x32 0x32 0x32 0x32 0x32 0x32 0x32 0x32 0x32 0x32 0x32 0x32 0x32 0x32 0x32 0x32 0x32 0x32 0x32 0x32 0x32 0x32 0x32 0x32 0x32 0x32 0x32 0x32 0x32 0x32 0x32 0x32 0x32 0x32 0x32 0x32 0x32 0x32 0x32 0x32 0x32 0x32 0x32 0x32 0x32 0x32 0x32 0x32 0x32 0x32 0x32 0x32 0x32 0x32 0x32 0x32 0x32 0x32 0x32 0x32 0x32 0x32 0x32 0x32 0x32 0x32 0x32 0x32 0x32 0x32 0x32 0x32 0x32 0x32 0x32 0x32 0x32 0x32 0x32 0x32 0x32 0x32 0x32 0x32 0x32 0x32 0x32 0x32 0x32 0x32 0x32 0x32 0x32 0x32 0x32 0x32 0x32 0x32 0x32 0x32 0x32 0x32 0x32 0x32 0x32 0x32 0x32 0x32 0x32 0x32 0x32 0x32 0x32 0x32 0x32 0x32 0x32 0x32 0x32 0x32 0x32 0x32 0x32 0x32 0x32 0x32 0x32 0x32 0x32 0x32 0x32 0x32 0x32 0x32 0x32 0x32 0x32 0x32 0x32 0x32 0x32 0x32 0x32 0x32 0x32 0x32 0x32 0x32 0x32 0x32 0x32 0x32 0x32 0x32 0x32 0x32 0x32 0x32 0x32 0x32 0x32 0x32 0x32 0x32 0x32 0x32 0x32 0x32 0x32 0x32 0x32 0x32 0x32 0x32 0x32 0x32 0x32 0x32 0x32 0x32 0x32 0x32 0x32 0x32 0x32 0x32 0x32 0x32 0x32 0x32 0x32 0x32 0x32 0x32 0x32 0x32 0x32 0x32 0x32 0x32 0x32 0x32 0x32 0x32 0x32 0x32 0x32 0x32 0x32 0x32 0x32 0x32 0x32 0x32 0x32 0x32 0x32 0x32 0x32 0x32 0x32 0x32 0x32 0x32 0x32 0x32 0x32 0x32 0x32 0x32 0x32 0x32 0x32 0x32 0x32 0x32 0x32 0x32 0x32 0x32 0x32 0x32 0x32 0x32 0x32 0x32 0x32 0x32 0x32 0x32 0x32 0x32 0x32 0x32 0x32 0x32 0x32 0x32 0x32 0x32 0x32 0x32 0x32 0x32 0x32 0x32 0x270f 0x32 0x32 0x32 0x32 0x32 0x32 0x32 0x32 0x32 0x32 0x32 0x32 0x32 0x32 0x32 0x32 0x270f 0x32 0x32 0x32 0x32 0x32 0x32 0x32 0x32 0x32 0x32 0x32 0x32 0x32 0x32 0x32 0x32 0x32 0x32 0x32 0x32 0x32 0x32 0x32 0x32 0x32 0x32 0x32 0x32 0x32 0x32 0x32 0x32 0x32 0x32 0x32 0x32 0x32 0x32 0x32 0x32 0x32 0x32 0x32 0x32 0x32 0x32 0x32 0x32 0x32 0x32 0x32 0x32 0x32 0x32 0x32 0x32 0x32 0x32 0x32 0x32 0x32 0x32 0x32 0x32 0x32 0x32 0x32 0x32 0x32 0x32 0x32 0x32 0x32 0x32 0x32 0x32 0x32 0x32 0x32 0x32 0x32 0x32 0x32 0x32 0x32 0x32 0x32 0x32 0x32 0x32 0x32 0x32 0x32 0x32 0x32 0x32 0x32 0x32 0x32 0x32 0x32 0x32 0x32 0x32 0x32 0x32 0x32 0x32 0x32 0x32 0x32 0x32 0x32 0x32 0x32 0x32 0x32 0x32 0x32 0x32 0x32 0x32 0x32 0x32 0x32 0x32 0x32 0x32 0x32 0x32 0x32 0x32 0x32 0x32 0x32 0x32 0x32 0x32 0x32 0x32 0x32 0x32 0x32 0x32 0x32 0x32 0x32 0x32 0x32 0x32 0x32 0x32 0x32 0x32 0x32 0x32 0x32 0x32 0x32 0x32 0x32 0x32 0x32 0x32 0x32 0x32 0x32 0x32 0x32 0x32 0x32 0x32 0x32 0x32 0x32 0x32 0x32 0x32 0x32 0x32 0x32 0x32 0x32 0x32 0x32 0x32 0x32 0x32 0x32 0x32 0x32 0x32 0x32 0x32 0x32 0x32 0x32 0x32 0x32 0x32 0x32 0x32 0x32 0x32 0x32 0x32 0x32 0x32 0x32 0x32>;
				pt11_hi_limits_02 = <0x3c 0x3c 0x3c 0x3c 0x3c 0x3c 0x3c 0x3c 0x3c 0x3c 0x3c 0x3c 0x3c 0x3c 0x3c 0x3c 0x3c 0x3c 0x3c 0x3c 0x3c 0x3c 0x3c 0x3c 0x3c 0x3c 0x3c 0x3c 0x3c 0x3c 0x3c 0x3c 0x3c 0x3c 0x3c 0x3c 0x3c 0x3c 0x3c 0x3c 0x3c 0x3c 0x3c 0x3c 0x3c 0x3c 0x3c 0x3c 0x3c 0x3c 0x3c 0x3c 0x3c 0x3c 0x3c 0x3c 0x3c 0x3c 0x3c 0x3c 0x3c 0x3c 0x3c 0x3c 0x3c 0x3c 0x3c 0x3c 0x3c 0x3c 0x3c 0x3c 0x3c 0x3c 0x3c 0x3c 0x3c 0x3c 0x3c 0x3c 0x3c 0x3c 0x3c 0x3c 0x3c 0x3c 0x3c 0x3c 0x3c 0x3c 0x3c 0x3c 0x3c 0x3c 0x3c 0x3c 0x3c 0x3c 0x3c 0x3c 0x3c 0x3c 0x3c 0x3c 0x3c 0x3c 0x3c 0x3c 0x3c 0x3c 0x3c 0x3c 0x3c 0x3c 0x3c 0x3c 0x3c 0x3c 0x3c 0x3c 0x3c 0x3c 0x3c 0x3c 0x3c 0x3c 0x3c 0x3c 0x3c 0x3c 0x3c 0x3c 0x3c 0x3c 0x3c 0x3c 0x3c 0x3c 0x3c 0x3c 0x3c 0x3c 0x3c 0x3c 0x3c 0x3c 0x3c 0x3c 0x3c 0x3c 0x3c 0x3c 0x3c 0x3c 0x3c 0x3c 0x3c 0x3c 0x3c 0x3c 0x3c 0x3c 0x3c 0x3c 0x3c 0x3c 0x3c 0x3c 0x3c 0x3c 0x3c 0x3c 0x3c 0x3c 0x3c 0x3c 0x3c 0x3c 0x3c 0x3c 0x3c 0x3c 0x3c 0x3c 0x3c 0x3c 0x3c 0x3c 0x3c 0x3c 0x3c 0x3c 0x3c 0x3c 0x3c 0x3c 0x3c 0x3c 0x3c 0x3c 0x3c 0x3c 0x3c 0x3c 0x3c 0x3c 0x3c 0x3c 0x3c 0x3c 0x3c 0x3c 0x3c 0x3c 0x3c 0x3c 0x3c 0x3c 0x3c 0x3c 0x3c 0x3c 0x3c 0x3c 0x3c 0x3c 0x3c 0x3c 0x3c 0x3c 0x3c 0x3c 0x3c 0x3c 0x3c 0x3c 0x3c 0x3c 0x3c 0x3c 0x3c 0x3c 0x3c 0x3c 0x3c 0x3c 0x3c 0x3c 0x3c 0x3c 0x3c 0x3c 0x3c 0x3c 0x3c 0x3c 0x3c 0x3c 0x3c 0x3c 0x3c 0x3c 0x3c 0x3c 0x3c 0x3c 0x3c 0x3c 0x3c 0x3c 0x3c 0x3c 0x3c 0x3c 0x3c 0x3c 0x3c 0x3c 0x3c 0x3c 0x3c 0x3c 0x3c 0x3c 0x3c 0x3c 0x3c 0x3c 0x3c 0x3c 0x3c 0x3c 0x3c 0x3c 0x3c 0x3c 0x3c 0x3c 0x3c 0x3c 0x3c 0x3c 0x3c 0x3c 0x3c 0x3c 0x3c 0x3c 0x3c 0x3c 0x3c 0x3c 0x3c 0x3c 0x3c 0x3c 0x3c 0x3c 0x3c 0x3c 0x3c 0x3c 0x3c 0x3c 0x3c 0x3c 0x3c 0x3c 0x3c 0x3c 0x3c 0x3c 0x3c 0x3c 0x3c 0x3c 0x3c 0x3c 0x3c 0x3c 0x3c 0x3c 0x3c 0x3c 0x3c 0x3c 0x3c 0x3c 0x3c 0x3c 0x3c 0x3c 0x3c 0x3c 0x3c 0x3c 0x3c 0x3c 0x3c 0x3c 0x3c 0x3c 0x3c 0x3c 0x3c 0x3c 0x3c 0x3c 0x3c 0x3c 0x3c 0x3c 0x3c 0x3c 0x3c 0x3c 0x3c 0x3c 0x3c 0x3c 0x3c 0x3c 0x3c 0x3c 0x3c 0x3c 0x3c 0x3c 0x3c 0x3c 0x3c 0x3c 0x3c 0x3c 0x3c 0x3c 0x3c 0x3c 0x3c 0x3c 0x3c 0x3c 0x3c 0x3c 0x3c 0x3c 0x3c 0x3c 0x3c 0x3c 0x3c 0x3c 0x3c 0x3c 0x3c 0x3c 0x3c 0x3c 0x3c 0x3c 0x3c 0x3c 0x3c 0x3c 0x3c 0x3c 0x3c 0x3c 0x3c 0x3c 0x3c 0x3c 0x3c 0x3c 0x3c 0x3c 0x3c 0x3c 0x3c 0x3c 0x3c 0x3c 0x3c 0x3c 0x3c 0x3c 0x3c 0x3c 0x3c 0x3c 0x3c 0x3c 0x3c 0x3c 0x3c 0x3c 0x3c 0x3c 0x3c 0x3c 0x3c 0x3c 0x3c 0x3c 0x3c 0x3c 0x3c 0x3c 0x3c 0x3c 0x3c 0x3c 0x3c 0x3c 0x3c 0x3c 0x3c 0x3c 0x3c 0x3c 0x3c 0x3c 0x3c 0x3c 0x3c 0x3c 0x3c 0x3c 0x3c 0x3c 0x3c 0x3c 0x3c 0x3c 0x3c 0x3c 0x3c 0x3c 0x3c 0x3c 0x3c 0x3c 0x3c 0x3c 0x3c 0x3c 0x3c 0x3c 0x3c 0x3c 0x3c 0x3c 0x3c 0x3c 0x3c 0x3c 0x3c 0x3c 0x3c 0x3c 0x3c 0x3c 0x3c 0x3c 0x3c 0x3c 0x3c 0x3c 0x3c 0x3c 0x3c 0x3c 0x3c 0x3c 0x3c 0x3c 0x3c 0x3c 0x3c 0x3c 0x3c 0x3c 0x3c 0x3c 0x3c 0x3c 0x3c 0x3c 0x3c 0x3c 0x3c 0x3c 0x3c 0x3c 0x3c 0x3c 0x3c 0x3c 0x3c 0x3c 0x3c 0x3c 0x3c 0x3c 0x3c 0x3c 0x3c 0x3c 0x3c 0x3c 0x3c 0x3c 0x3c 0x3c 0x3c 0x3c 0x3c 0x3c 0x3c 0x3c 0x3c 0x3c 0x3c 0x3c 0x3c 0x3c 0x3c 0x3c 0x3c 0x3c 0x3c 0x3c 0x3c 0x3c 0x3c 0x3c 0x3c 0x3c 0x3c 0x3c 0x3c 0x3c 0x3c 0x3c 0x3c 0x3c 0x3c 0x3c 0x3c 0x3c 0x3c 0x3c 0x3c 0x3c 0x3c 0x3c 0x3c 0x3c 0x3c 0x3c 0x3c 0x3c 0x3c 0x3c 0x3c 0x3c 0x3c 0x3c 0x3c 0x3c 0x3c 0x3c 0x3c 0x3c 0x3c 0x3c 0x3c 0x3c 0x3c 0x3c 0x3c 0x3c 0x3c 0x3c 0x3c 0x3c 0x3c 0x3c 0x3c 0x3c 0x3c 0x3c 0x3c 0x3c 0x3c 0x3c 0x3c 0x3c 0x3c 0x3c 0x3c 0x3c 0x3c 0x3c 0x3c 0x3c 0x3c 0x3c 0x3c 0x3c 0x3c 0x3c 0x3c 0x3c 0x3c 0x3c 0x3c 0x3c 0x3c 0x3c 0x3c 0x3c 0x3c 0x3c 0x3c 0x3c 0x3c 0x3c 0x3c 0x3c 0x3c 0x3c 0x3c 0x3c 0x3c 0x3c 0x3c 0x3c 0x3c 0x3c 0x3c 0x3c 0x3c 0x3c 0x3c 0x3c 0x3c 0x3c 0x3c 0x3c 0x3c 0x3c 0x3c 0x3c 0x3c 0x3c 0x3c 0x3c 0x3c 0x3c 0x3c 0x3c 0x3c 0x3c 0x3c 0x3c 0x3c 0x3c 0x3c 0x3c 0x3c 0x3c 0x3c 0x3c 0x3c 0x3c 0x3c 0x3c 0x3c 0x3c 0x3c 0x3c 0x3c 0x3c 0x3c 0x3c 0x3c 0x3c 0x3c 0x3c 0x3c 0x3c 0x3c 0x3c 0x3c 0x3c 0x3c 0x3c 0x3c 0x3c 0x3c 0x3c 0x3c 0x3c 0x3c 0x3c 0x3c 0x3c 0x3c 0x3c 0x3c 0x3c 0x3c 0x3c 0x3c 0x3c 0x3c 0x3c 0x3c 0x3c 0x3c 0x3c 0x3c 0x3c 0x3c 0x3c 0x3c 0x3c 0x3c 0x3c 0x3c 0x3c 0x3c 0x3c 0x3c 0x3c 0x3c 0x3c 0x3c 0x3c 0x3c 0x3c 0x3c 0x3c 0x3c 0x3c 0x3c 0x3c 0x3c 0x3c 0x3c 0x3c 0x3c 0x3c 0x3c 0x3c 0x3c 0x3c 0x3c 0x3c 0x3c 0x3c 0x3c 0x3c 0x3c 0x3c 0x3c 0x3c 0x3c 0x3c 0x3c 0x3c 0x3c 0x3c 0x3c 0x3c 0x3c 0x3c 0x3c 0x3c 0x3c 0x3c 0x3c 0x3c 0x3c 0x3c 0x3c 0x3c 0x3c 0x3c 0x3c 0x3c 0x3c 0x3c 0x3c 0x3c 0x3c 0x3c 0x3c 0x3c 0x3c 0x3c 0x3c 0x3c 0x3c 0x3c 0x3c 0x3c 0x3c 0x3c 0x3c 0x3c 0x3c 0x3c 0x3c 0x3c 0x3c 0x3c 0x3c 0x3c 0x3c 0x3c 0x3c 0x3c 0x3c 0x3c 0x3c 0x3c 0x3c 0x3c 0x3c 0x3c 0x3c 0x3c 0x3c 0x3c 0x3c 0x3c 0x3c 0x3c 0x3c 0x3c 0x3c 0x3c 0x3c 0x3c 0x3c 0x3c 0x3c 0x3c 0x3c 0x3c 0x3c 0x3c 0x3c 0x3c 0x3c 0x3c 0x3c 0x3c 0x3c 0x3c 0x3c 0x3c 0x3c 0x3c 0x3c 0x3c 0x3c 0x3c 0x3c 0x3c 0x3c 0x3c 0x3c 0x3c 0x3c 0x3c 0x3c 0x3c 0x3c 0x3c 0x3c 0x3c 0x3c 0x3c 0x3c 0x3c 0x3c 0x3c 0x3c 0x3c 0x3c 0x3c 0x3c 0x3c 0x3c 0x3c 0x3c 0x3c 0x3c 0x3c 0x3c 0x3c 0x3c 0x3c 0x3c 0x3c 0x3c 0x3c 0x3c 0x3c 0x3c 0x3c 0x3c 0x3c 0x3c 0x3c 0x3c 0x3c 0x3c 0x3c 0x3c 0x3c 0x3c 0x3c 0x3c 0x3c 0x3c 0x3c 0x3c 0x3c 0x3c 0x3c 0x3c 0x3c 0x3c 0x3c 0x3c 0x3c 0x3c 0x3c 0x3c 0x3c 0x3c 0x3c 0x3c 0x3c 0x3c 0x3c 0x3c 0x3c 0x3c 0x3c 0x3c 0x3c 0x3c 0x3c 0x3c 0x3c 0x3c 0x3c 0x3c 0x3c 0x3c 0x3c 0x3c 0x3c 0x3c 0x3c 0x3c 0x3c 0x3c 0x3c 0x3c 0x3c 0x3c 0x3c 0x3c 0x3c 0x3c 0x3c 0x3c 0x3c 0x3c 0x3c 0x3c 0x3c 0x3c 0x3c 0x3c 0x3c 0x3c 0x3c 0x3c 0x3c 0x3c 0x3c 0x3c 0x3c 0x3c 0x3c 0x3c 0x3c 0x3c 0x3c 0x3c 0x3c 0x3c 0x3c 0x3c 0x3c 0x3c 0x3c 0x3c 0x3c 0x3c 0x3c 0x3c 0x3c 0x3c 0x3c 0x3c 0x3c 0x3c 0x3c 0x3c 0x3c 0x3c 0x3c 0x3c 0x3c 0x3c 0x3c 0x3c 0x3c 0x3c 0x3c 0x3c 0x3c 0x3c 0x3c 0x3c 0x3c 0x3c 0x3c 0x3c 0x3c 0x3c 0x3c 0x3c 0x3c 0x3c 0x3c 0x3c 0x3c 0x3c 0x3c 0x3c 0x3c 0x3c 0x3c 0x3c 0x3c 0x3c 0x3c 0x3c 0x3c 0x3c 0x3c 0x3c 0x3c 0x3c 0x3c 0x3c 0x3c 0x3c 0x3c 0x3c 0x3c 0x3c 0x3c 0x3c 0x3c 0x3c 0x3c 0x3c 0x3c 0x3c 0x3c 0x3c 0x3c 0x3c 0x3c 0x3c 0x3c 0x3c 0x3c 0x3c 0x3c 0x3c 0x3c 0x3c 0x3c 0x3c 0x3c 0x3c 0x3c 0x3c 0x3c 0x3c 0x3c 0x3c 0x3c 0x3c 0x3c 0x3c 0x3c 0x3c 0x3c 0x3c 0x3c 0x3c 0x3c 0x3c 0x3c 0x3c 0x3c 0x3c 0x3c 0x3c 0x3c 0x3c 0x3c 0x3c 0x3c 0x3c 0x3c 0x3c 0x3c 0x3c 0x3c 0x3c 0x3c 0x3c 0x3c 0x3c 0x3c 0x3c 0x3c 0x3c 0x3c 0x3c 0x3c 0x3c 0x3c 0x3c 0x3c 0x3c 0x3c 0x3c 0x3c 0x3c 0x3c 0x3c 0x3c 0x3c 0x3c 0x3c 0x3c 0x3c 0x3c 0x3c 0x3c 0x3c 0x3c 0x3c 0x3c 0x3c 0x3c 0x3c 0x3c 0x3c 0x3c 0x3c 0x3c 0x3c 0x3c 0x3c 0x3c 0x3c 0x3c 0x3c 0x3c 0x3c 0x3c 0x3c 0x3c 0x3c 0x3c 0x3c 0x3c 0x3c 0x3c 0x3c 0x3c 0x3c 0x3c 0x3c 0x3c 0x3c 0x3c 0x3c 0x3c 0x3c 0x3c 0x3c 0x3c 0x3c 0x3c 0x3c 0x3c 0x3c 0x3c 0x3c 0x3c 0x3c 0x3c 0x3c 0x3c 0x3c 0x3c 0x3c 0x3c 0x3c 0x3c 0x3c 0x3c 0x3c 0x3c 0x3c 0x3c 0x3c 0x3c 0x3c 0x3c 0x3c 0x3c 0x3c 0x3c 0x3c 0x3c 0x3c 0x3c 0x3c 0x3c 0x3c 0x3c 0x3c 0x3c 0x3c 0x3c 0x3c 0x3c 0x3c 0x3c 0x3c 0x3c 0x3c 0x3c 0x3c 0x3c 0x3c 0x3c 0x3c 0x3c 0x3c 0x3c 0x3c 0x3c 0x3c 0x3c 0x3c 0x3c 0x3c 0x3c 0x3c 0x3c 0x3c 0x3c 0x3c 0x3c 0x3c 0x3c 0x3c 0x3c 0x3c 0x3c 0x3c 0x3c 0x3c 0x3c 0x3c 0x3c 0x3c 0x3c 0x3c 0x3c 0x3c 0x3c 0x3c 0x3c 0x3c 0x3c 0x3c 0x3c 0x3c 0x3c 0x3c 0x3c 0x3c 0x3c 0x3c 0x3c 0x3c 0x3c 0x3c 0x3c 0x3c 0x3c 0x3c 0x3c 0x3c 0x3c 0x3c 0x3c 0x3c 0x3c 0x3c 0x3c 0x3c 0x3c 0x3c 0x3c 0x3c 0x3c 0x3c 0x3c 0x3c 0x3c 0x3c 0x3c 0x3c 0x3c 0x3c 0x3c 0x3c 0x3c 0x3c 0x3c 0x3c 0x3c 0x3c 0x3c 0x3c 0x3c 0x3c 0x3c 0x3c 0x3c 0x3c 0x3c 0x3c 0x3c 0x3c 0x3c 0x3c 0x3c 0x3c 0x3c 0x3c 0x3c 0x3c 0x3c>;
				pt11_hi_limits_cols_01 = <0x26>;
				pt11_hi_limits_cols_02 = <0x26>;
				pt11_hi_limits_row_01 = <0x26>;
				pt11_hi_limits_row_02 = <0x26>;
				pt11_lo_limits_01 = <0xffffffce 0xffffffce 0xffffffce 0xffffffce 0xffffffce 0xffffffce 0xffffffce 0xffffffce 0xffffffce 0xffffffce 0xffffffce 0xffffffce 0xffffffce 0xffffffce 0xffffffce 0xffffffce 0xffffffce 0xffffffce 0xffffffce 0xffffffce 0xffffffce 0xffffffce 0xffffffce 0xffffffce 0xffffffce 0xffffffce 0xffffffce 0xffffffce 0xffffffce 0xffffffce 0xffffffce 0xffffffce 0xffffffce 0xffffffce 0xffffffce 0xffffffce 0xffffffce 0xffffffce 0xffffffce 0xffffffce 0xffffffce 0xffffffce 0xffffffce 0xffffffce 0xffffffce 0xffffffce 0xffffffce 0xffffffce 0xffffffce 0xffffffce 0xffffffce 0xffffffce 0xffffffce 0xffffffce 0xffffffce 0xffffffce 0xffffffce 0xffffffce 0xffffffce 0xffffffce 0xffffffce 0xffffffce 0xffffffce 0xffffffce 0xffffffce 0xffffffce 0xffffffce 0xffffffce 0xffffffce 0xffffffce 0xffffffce 0xffffffce 0xffffffce 0xffffffce 0xffffffce 0xffffffce 0xffffffce 0xffffffce 0xffffffce 0xffffffce 0xffffffce 0xffffffce 0xffffffce 0xffffffce 0xffffffce 0xffffffce 0xffffffce 0xffffffce 0xffffffce 0xffffffce 0xffffffce 0xffffffce 0xffffffce 0xffffffce 0xffffffce 0xffffffce 0xffffffce 0xffffffce 0xffffffce 0xffffffce 0xffffffce 0xffffffce 0xffffffce 0xffffffce 0xffffffce 0xffffffce 0xffffffce 0xffffffce 0xffffffce 0xffffffce 0xffffffce 0xffffffce 0xffffffce 0xffffffce 0xffffffce 0xffffffce 0xffffffce 0xffffffce 0xffffffce 0xffffffce 0xffffffce 0xffffffce 0xffffffce 0xffffffce 0xffffffce 0xffffffce 0xffffffce 0xffffffce 0xffffffce 0xffffffce 0xffffffce 0xffffffce 0xffffffce 0xffffffce 0xffffffce 0xffffffce 0xffffffce 0xffffffce 0xffffffce 0xffffffce 0xffffffce 0xffffffce 0xffffffce 0xffffffce 0xffffffce 0xffffffce 0xffffffce 0xffffffce 0xffffffce 0xffffffce 0xffffffce 0xffffffce 0xffffffce 0xffffffce 0xffffffce 0xffffffce 0xffffffce 0xffffffce 0xffffffce 0xffffffce 0xffffffce 0xffffffce 0xffffffce 0xffffffce 0xffffffce 0xffffffce 0xffffffce 0xffffffce 0xffffffce 0xffffffce 0xffffffce 0xffffffce 0xffffffce 0xffffffce 0xffffffce 0xffffffce 0xffffffce 0xffffffce 0xffffffce 0xffffffce 0xffffffce 0xffffffce 0xffffffce 0xffffffce 0xffffffce 0xffffffce 0xffffffce 0xffffffce 0xffffffce 0xffffffce 0xffffffce 0xffffffce 0xffffffce 0xffffffce 0xffffffce 0xffffffce 0xffffffce 0xffffffce 0xffffffce 0xffffffce 0xffffffce 0xffffffce 0xffffffce 0xffffffce 0xffffffce 0xffffffce 0xffffffce 0xffffffce 0xffffffce 0xffffffce 0xffffffce 0xffffffce 0xffffffce 0xffffffce 0xffffffce 0xffffffce 0xffffffce 0xffffffce 0xffffffce 0xffffffce 0xffffffce 0xffffffce 0xffffffce 0xffffffce 0xffffffce 0xffffffce 0xffffffce 0xffffffce 0xffffffce 0xffffffce 0xffffffce 0xffffffce 0xffffffce 0xffffffce 0xffffffce 0xffffffce 0xffffffce 0xffffffce 0xffffffce 0xffffffce 0xffffffce 0xffffffce 0xffffffce 0xffffffce 0xffffffce 0xffffffce 0xffffffce 0xffffffce 0xffffffce 0xffffffce 0xffffffce 0xffffffce 0xffffffce 0xffffffce 0xffffffce 0xffffffce 0xffffffce 0xffffffce 0xffffffce 0xffffffce 0xffffffce 0xffffffce 0xffffffce 0xffffffce 0xffffffce 0xffffffce 0xffffffce 0xffffffce 0xffffffce 0xffffffce 0xffffffce 0xffffffce 0xffffffce 0xffffffce 0xffffffce 0xffffffce 0xffffffce 0xffffffce 0xffffffce 0xffffffce 0xffffffce 0xffffffce 0xffffffce 0xffffffce 0xffffffce 0xffffffce 0xffffffce 0xffffffce 0xffffffce 0xffffffce 0xffffffce 0xffffffce 0xffffffce 0xffffffce 0xffffffce 0xffffffce 0xffffffce 0xffffffce 0xffffffce 0xffffffce 0xffffffce 0xffffffce 0xffffffce 0xffffffce 0xffffffce 0xffffffce 0xffffffce 0xffffffce 0xffffffce 0xffffffce 0xffffffce 0xffffffce 0xffffffce 0xffffffce 0xffffffce 0xffffffce 0xffffffce 0xffffffce 0xffffffce 0xffffffce 0xffffffce 0xffffffce 0xffffffce 0xffffffce 0xffffffce 0xffffffce 0xffffffce 0xffffffce 0xffffffce 0xffffffce 0xffffffce 0xffffffce 0xffffffce 0xffffffce 0xffffffce 0xffffffce 0xffffffce 0xffffffce 0xffffffce 0xffffffce 0xffffffce 0xffffffce 0xffffffce 0xffffffce 0xffffffce 0xffffffce 0xffffffce 0xffffffce 0xffffffce 0xffffffce 0xffffffce 0xffffffce 0xffffffce 0xffffffce 0xffffffce 0xffffffce 0xffffffce 0xffffffce 0xffffffce 0xffffffce 0xffffffce 0xffffffce 0xffffffce 0xffffffce 0xffffffce 0xffffffce 0xffffffce 0xffffffce 0xffffffce 0xffffffce 0xffffffce 0xffffffce 0xffffffce 0xffffffce 0xffffffce 0xffffffce 0xffffffce 0xffffffce 0xffffffce 0xffffffce 0xffffffce 0xffffffce 0xffffffce 0xffffffce 0xffffffce 0xffffffce 0xffffffce 0xffffffce 0xffffffce 0xffffffce 0xffffffce 0xffffffce 0xffffffce 0xffffffce 0xffffffce 0xffffffce 0xffffffce 0xffffffce 0xffffffce 0xffffffce 0xffffffce 0xffffffce 0xffffffce 0xffffffce 0xffffffce 0xffffffce 0xffffffce 0xffffffce 0xffffffce 0xffffffce 0xffffffce 0xffffffce 0xffffffce 0xffffffce 0xffffffce 0xffffffce 0xffffffce 0xffffffce 0xffffffce 0xffffffce 0xffffffce 0xffffffce 0xffffffce 0xffffffce 0xffffffce 0xffffffce 0xffffffce 0xffffffce 0xffffffce 0xffffffce 0xffffffce 0xffffffce 0xffffffce 0xffffffce 0xffffffce 0xffffffce 0xffffffce 0xffffffce 0xffffffce 0xffffffce 0xffffffce 0xffffffce 0xffffffce 0xffffffce 0xffffffce 0xffffffce 0xffffffce 0xffffffce 0xffffffce 0xffffffce 0xffffffce 0xffffffce 0xffffffce 0xffffffce 0xffffffce 0xffffffce 0xffffffce 0xffffffce 0xffffffce 0xffffffce 0xffffffce 0xffffffce 0xffffffce 0xffffffce 0xffffffce 0xffffffce 0xffffffce 0xffffffce 0xffffffce 0xffffffce 0xffffffce 0xffffffce 0xffffffce 0xffffffce 0xffffffce 0xffffffce 0xffffffce 0xffffffce 0xffffffce 0xffffffce 0xffffffce 0xffffffce 0xffffffce 0xffffffce 0xffffffce 0xffffffce 0xffffffce 0xffffffce 0xffffffce 0xffffffce 0xffffffce 0xffffffce 0xffffffce 0xffffffce 0xffffffce 0xffffffce 0xffffffce 0xffffffce 0xffffffce 0xffffffce 0xffffffce 0xffffffce 0xffffffce 0xffffffce 0xffffffce 0xffffffce 0xffffffce 0xffffffce 0xffffffce 0xffffffce 0xffffffce 0xffffffce 0xffffffce 0xffffffce 0xffffffce 0xffffffce 0xffffffce 0xffffffce 0xffffffce 0xffffffce 0xffffffce 0xffffffce 0xffffffce 0xffffffce 0xffffffce 0xffffffce 0xffffffce 0xffffffce 0xffffffce 0xffffffce 0xffffffce 0xffffffce 0xffffffce 0xffffffce 0xffffffce 0xffffffce 0xffffffce 0xffffffce 0xffffffce 0xffffffce 0xffffffce 0xffffffce 0xffffffce 0xffffffce 0xffffffce 0xffffffce 0xffffffce 0xffffffce 0xffffffce 0xffffffce 0xffffffce 0xffffffce 0xffffffce 0xffffffce 0xffffffce 0xffffffce 0xffffffce 0xffffffce 0xffffffce 0xffffffce 0xffffffce 0xffffffce 0xffffffce 0xffffffce 0xffffffce 0xffffffce 0xffffffce 0xffffffce 0xffffffce 0xffffffce 0xffffffce 0xffffffce 0xffffffce 0xffffffce 0xffffffce 0xffffffce 0xffffffce 0xffffffce 0xffffffce 0xffffffce 0xffffffce 0xffffffce 0xffffffce 0xffffffce 0xffffffce 0xffffffce 0xffffffce 0xffffffce 0xffffffce 0xffffffce 0xffffffce 0xffffffce 0xffffffce 0xffffffce 0xffffffce 0xffffffce 0xffffffce 0xffffffce 0xffffffce 0xffffffce 0xffffffce 0xffffffce 0xffffffce 0xffffffce 0xffffffce 0xffffffce 0xffffffce 0xffffffce 0xffffffce 0xffffffce 0xffffffce 0xffffffce 0xffffffce 0xffffffce 0xffffffce 0xffffffce 0xffffffce 0xffffffce 0xffffffce 0xffffffce 0xffffffce 0xffffffce 0xffffffce 0xffffffce 0xffffffce 0xffffffce 0xffffffce 0xffffffce 0xffffffce 0xffffffce 0xffffffce 0xffffffce 0xffffffce 0xffffffce 0xffffffce 0xffffffce 0xffffffce 0xffffffce 0xffffffce 0xffffffce 0xffffffce 0xffffffce 0xffffffce 0xffffffce 0xffffffce 0xffffffce 0xffffffce 0xffffffce 0xffffffce 0xffffffce 0xffffffce 0xffffffce 0xffffffce 0xffffffce 0xffffffce 0xffffffce 0xffffffce 0xffffffce 0xffffffce 0xffffffce 0xffffffce 0xffffffce 0xffffffce 0xffffffce 0xffffffce 0xffffffce 0xffffffce 0xffffffce 0xffffffce 0xffffffce 0xffffffce 0xffffffce 0xffffffce 0xffffffce 0xffffffce 0xffffffce 0xffffffce 0xffffffce 0xffffffce 0xffffffce 0xffffffce 0xffffffce 0xffffffce 0xffffffce 0xffffffce 0xffffffce 0xffffffce 0xffffffce 0xffffffce 0xffffffce 0xffffffce 0xffffffce 0xffffffce 0xffffffce 0xffffffce 0xffffffce 0xffffffce 0xffffffce 0xffffffce 0xffffffce 0xffffffce 0xffffffce 0xffffffce 0xffffffce 0xffffffce 0xffffffce 0xffffffce 0xffffffce 0xffffffce 0xffffffce 0xffffffce 0xffffffce 0xffffffce 0xffffffce 0xffffffce 0xffffffce 0xffffffce 0xffffffce 0xffffffce 0xffffffce 0xffffffce 0xffffffce 0xffffffce 0xffffffce 0xffffffce 0xffffffce 0xffffffce 0xffffffce 0xffffffce 0xffffffce 0xffffffce 0xffffffce 0xffffffce 0xffffffce 0xffffffce 0xffffffce 0xffffffce 0xffffffce 0xffffffce 0xffffffce 0xffffffce 0xffffffce 0xffffffce 0xffffffce 0xffffffce 0xffffffce 0xffffffce 0xffffffce 0xffffffce 0xffffffce 0xffffffce 0xffffffce 0xffffffce 0xffffffce 0xffffffce 0xffffffce 0xffffffce 0xffffffce 0xffffffce 0xffffffce 0xffffffce 0xffffffce 0xffffffce 0xffffffce 0xffffffce 0xffffffce 0xffffffce 0xffffffce 0xffffffce 0xffffffce 0xffffffce 0xffffffce 0xffffffce 0xffffffce 0xffffffce 0xffffffce 0xffffffce 0xffffffce 0xffffffce 0xffffffce 0xffffffce 0xffffffce 0xffffffce 0xffffffce 0xffffffce 0xffffffce 0xffffffce 0xffffffce 0xffffffce 0xffffffce 0xffffffce 0xffffffce 0xffffffce 0xffffffce 0xffffffce 0xffffffce 0xffffffce 0xffffffce 0xffffffce 0xffffffce 0xffffffce 0xffffffce 0xffffffce 0xffffffce 0xffffffce 0xffffffce 0xffffffce 0xffffffce 0xffffffce 0xffffffce 0xffffffce 0xffffffce 0xffffffce 0xffffffce 0xffffffce 0xffffffce 0xffffffce 0xffffffce 0xffffffce 0xffffffce 0xffffffce 0xffffffce 0xffffffce 0xffffffce 0xffffffce 0xffffffce 0xffffffce 0xffffffce 0xffffffce 0xffffffce 0xffffffce 0xffffffce 0xffffffce 0xffffffce 0xffffffce 0xffffffce 0xffffffce 0xffffffce 0xffffffce 0xffffffce 0xffffffce 0xffffffce 0xffffffce 0xffffffce 0xffffffce 0xffffffce 0xffffffce 0xffffffce 0xffffffce 0xffffffce 0xffffffce 0xffffffce 0xffffffce 0xffffffce 0xffffffce 0xffffffce 0xffffffce 0xffffffce 0xffffffce 0xffffffce 0xffffffce 0xffffffce 0xffffffce 0xffffffce 0xffffffce 0xffffffce 0xffffffce 0xffffffce 0xffffffce 0xffffffce 0xffffffce 0xffffffce 0xffffffce 0xffffffce 0xffffffce 0xffffffce 0xffffffce 0xffffffce 0xffffffce 0xffffffce 0xffffffce 0xffffffce 0xffffffce 0xffffffce 0xffffffce 0xffffffce 0xffffffce 0xffffffce 0xffffffce 0xffffffce 0xffffffce 0xffffffce 0xffffffce 0xffffffce 0xffffffce 0xffffffce 0xffffffce 0xffffffce 0xffffffce 0xffffffce 0xffffffce 0xffffffce 0xffffffce 0xffffffce 0xffffffce 0xffffffce 0xffffffce 0xffffffce 0xffffffce 0xffffffce 0xffffffce 0xffffffce 0xffffffce 0xffffffce 0xffffffce 0xffffffce 0xffffffce 0xffffffce 0xffffffce 0xffffffce 0xffffffce 0xffffffce 0xffffffce 0xffffffce 0xffffffce 0xffffffce 0xffffffce 0xffffffce 0xffffffce 0xffffffce 0xffffffce 0xffffffce 0xffffffce 0xffffffce 0xffffffce 0xffffffce 0xffffffce 0xffffffce 0xffffffce 0xffffffce 0xffffffce 0xffffffce 0xffffffce 0xffffffce 0xffffffce 0xffffffce 0xffffffce 0xffffffce 0xffffffce 0xffffffce 0xffffffce 0xffffffce 0xffffffce 0xffffffce 0xffffffce 0xffffffce 0xffffffce 0xffffffce 0xffffffce 0xffffffce 0xffffffce 0xffffffce 0xffffffce 0xffffffce 0xffffffce 0xffffffce 0xffffffce 0xffffffce 0xffffffce 0xffffffce 0xffffffce 0xffffffce 0xffffffce 0xffffffce 0xffffffce 0xffffffce 0xffffffce 0xffffffce 0xffffffce 0xffffffce 0xffffffce 0xffffffce 0xffffffce 0xffffffce 0xffffffce 0xffffffce 0xffffffce 0xffffffce 0xffffffce 0xffffffce 0xffffffce 0xffffffce 0xffffffce 0xffffffce 0xffffffce 0xffffffce 0xffffffce 0xffffffce 0xffffffce 0xffffffce 0xffffffce 0xffffffce 0xffffffce 0xffffffce 0xffffffce 0xffffffce 0xffffffce 0xffffffce 0xffffffce 0xffffffce 0xffffffce 0xffffffce 0xffffffce 0xffffffce 0xffffffce 0xffffffce 0xffffffce 0xffffffce 0xffffffce 0xffffffce 0xffffffce 0xffffffce 0xffffffce 0xffffffce 0xffffffce 0xffffffce 0xffffffce 0xffffffce 0xffffffce 0xffffffce 0xffffffce 0xffffffce 0xffffffce 0xffffffce 0xffffffce 0xffffffce 0xffffffce 0xffffffce 0xffffffce 0xffffffce 0xffffffce 0xffffffce 0xffffffce 0xffffffce 0xffffffce 0xffffffce 0xffffffce 0xffffffce 0xffffffce 0xffffffce 0xffffffce 0xffffffce 0xffffffce 0xffffffce 0xffffffce 0xffffffce 0xffffffce 0xffffffce 0xffffffce 0xffffffce 0xffffffce 0xffffffce 0xffffffce 0xffffffce 0xffffffce 0xffffffce 0xffffffce 0xffffffce 0xffffffce 0xffffffce 0xffffffce 0xffffffce 0xffffffce 0xffffffce 0xffffffce 0xffffffce 0xffffffce 0xffffffce 0xffffffce 0xffffffce 0xffffffce 0xffffffce 0xffffffce 0xffffffce 0xffffffce 0xffffffce 0xffffffce 0xffffffce 0xffffffce 0xffffffce 0xffffffce 0xffffffce 0xffffffce 0xffffffce 0xffffffce 0xffffffce 0xffffffce 0xffffffce 0xffffffce 0xffffffce 0xffffffce 0xffffffce 0xffffffce 0xffffffce 0xffffffce 0xffffffce 0xffffffce 0xffffffce 0xffffffce 0xffffffce 0xffffffce 0xffffffce 0xffffffce 0xffffffce 0xffffffce 0xffffffce 0xffffffce 0xffffffce 0xffffffce 0xffffffce 0xffffffce 0xffffffce 0xffffffce 0xffffffce 0xffffffce 0xffffffce 0xffffffce 0xffffffce 0xffffffce 0xffffffce 0xffffffce 0xffffffce 0xffffffce 0xffffffce 0xffffffce 0xffffffce 0xffffffce 0xffffffce 0xffffffce 0xffffffce 0xffffffce 0xffffffce 0xffffffce 0xffffffce 0xffffffce 0xffffffce 0xffffffce 0xffffffce 0xffffffce 0xffffffce 0xffffffce 0xffffffce 0xffffffce 0xffffffce 0xffffffce 0xffffffce 0xffffffce 0xffffffce 0xffffffce 0xffffffce 0xffffffce 0xffffffce 0xffffffce 0xffffffce 0xffffffce 0xffffffce 0xffffffce 0xffffffce 0xffffffce 0xffffffce 0xffffffce 0xffffffce 0xffffffce 0xffffffce 0xffffffce 0xffffffce 0xffffffce 0xffffffce 0xffffffce 0xffffffce 0xffffffce 0xffffffce 0xffffffce 0xffffffce 0xffffffce 0xffffffce 0xffffffce 0xffffffce 0xffffffce 0xffffffce 0xffffffce 0xffffffce 0xffffffce 0xffffffce 0xffffffce 0xffffffce 0xffffffce 0xffffffce 0xffffffce 0xffffffce 0xffffffce 0xffffffce 0xffffffce 0xffffffce 0xffffffce 0xffffffce 0xffffffce 0xffffffce 0xffffffce 0xffffffce 0xffffffce 0xffffffce 0xffffffce 0xffffffce 0xffffffce 0xffffffce 0xffffd8f1 0xffffffce 0xffffffce 0xffffffce 0xffffffce 0xffffffce 0xffffffce 0xffffffce 0xffffffce 0xffffffce 0xffffffce 0xffffffce 0xffffffce 0xffffffce 0xffffffce 0xffffffce 0xffffffce 0xffffd8f1 0xffffffce 0xffffffce 0xffffffce 0xffffffce 0xffffffce 0xffffffce 0xffffffce 0xffffffce 0xffffffce 0xffffffce 0xffffffce 0xffffffce 0xffffffce 0xffffffce 0xffffffce 0xffffffce 0xffffffce 0xffffffce 0xffffffce 0xffffffce 0xffffffce 0xffffffce 0xffffffce 0xffffffce 0xffffffce 0xffffffce 0xffffffce 0xffffffce 0xffffffce 0xffffffce 0xffffffce 0xffffffce 0xffffffce 0xffffffce 0xffffffce 0xffffffce 0xffffffce 0xffffffce 0xffffffce 0xffffffce 0xffffffce 0xffffffce 0xffffffce 0xffffffce 0xffffffce 0xffffffce 0xffffffce 0xffffffce 0xffffffce 0xffffffce 0xffffffce 0xffffffce 0xffffffce 0xffffffce 0xffffffce 0xffffffce 0xffffffce 0xffffffce 0xffffffce 0xffffffce 0xffffffce 0xffffffce 0xffffffce 0xffffffce 0xffffffce 0xffffffce 0xffffffce 0xffffffce 0xffffffce 0xffffffce 0xffffffce 0xffffffce 0xffffffce 0xffffffce 0xffffffce 0xffffffce 0xffffffce 0xffffffce 0xffffffce 0xffffffce 0xffffffce 0xffffffce 0xffffffce 0xffffffce 0xffffffce 0xffffffce 0xffffffce 0xffffffce 0xffffffce 0xffffffce 0xffffffce 0xffffffce 0xffffffce 0xffffffce 0xffffffce 0xffffffce 0xffffffce 0xffffffce 0xffffffce 0xffffffce 0xffffffce 0xffffffce 0xffffffce 0xffffffce 0xffffffce 0xffffffce 0xffffffce 0xffffffce 0xffffffce 0xffffffce 0xffffffce 0xffffffce 0xffffffce 0xffffffce 0xffffffce 0xffffffce 0xffffffce 0xffffffce 0xffffffce 0xffffffce 0xffffffce 0xffffffce 0xffffffce 0xffffffce 0xffffffce 0xffffffce 0xffffffce 0xffffffce 0xffffffce 0xffffffce 0xffffffce 0xffffffce 0xffffffce 0xffffffce 0xffffffce 0xffffffce 0xffffffce 0xffffffce 0xffffffce 0xffffffce 0xffffffce 0xffffffce 0xffffffce 0xffffffce 0xffffffce 0xffffffce 0xffffffce 0xffffffce 0xffffffce 0xffffffce 0xffffffce 0xffffffce 0xffffffce 0xffffffce 0xffffffce 0xffffffce 0xffffffce 0xffffffce 0xffffffce 0xffffffce 0xffffffce 0xffffffce 0xffffffce 0xffffffce 0xffffffce 0xffffffce 0xffffffce 0xffffffce 0xffffffce 0xffffffce 0xffffffce 0xffffffce 0xffffffce 0xffffffce 0xffffffce 0xffffffce 0xffffffce 0xffffffce 0xffffffce 0xffffffce 0xffffffce 0xffffffce 0xffffffce 0xffffffce 0xffffffce 0xffffffce 0xffffffce 0xffffffce 0xffffffce 0xffffffce 0xffffffce 0xffffffce 0xffffffce 0xffffffce 0xffffffce 0xffffffce 0xffffffce 0xffffffce 0xffffffce 0xffffffce 0xffffffce 0xffffffce 0xffffffce 0xffffffce 0xffffffce 0xffffffce 0xffffffce 0xffffffce 0xffffffce 0xffffffce>;
				pt11_lo_limits_02 = <0xffffffc4 0xffffffc4 0xffffffc4 0xffffffc4 0xffffffc4 0xffffffc4 0xffffffc4 0xffffffc4 0xffffffc4 0xffffffc4 0xffffffc4 0xffffffc4 0xffffffc4 0xffffffc4 0xffffffc4 0xffffffc4 0xffffffc4 0xffffffc4 0xffffffc4 0xffffffc4 0xffffffc4 0xffffffc4 0xffffffc4 0xffffffc4 0xffffffc4 0xffffffc4 0xffffffc4 0xffffffc4 0xffffffc4 0xffffffc4 0xffffffc4 0xffffffc4 0xffffffc4 0xffffffc4 0xffffffc4 0xffffffc4 0xffffffc4 0xffffffc4 0xffffffc4 0xffffffc4 0xffffffc4 0xffffffc4 0xffffffc4 0xffffffc4 0xffffffc4 0xffffffc4 0xffffffc4 0xffffffc4 0xffffffc4 0xffffffc4 0xffffffc4 0xffffffc4 0xffffffc4 0xffffffc4 0xffffffc4 0xffffffc4 0xffffffc4 0xffffffc4 0xffffffc4 0xffffffc4 0xffffffc4 0xffffffc4 0xffffffc4 0xffffffc4 0xffffffc4 0xffffffc4 0xffffffc4 0xffffffc4 0xffffffc4 0xffffffc4 0xffffffc4 0xffffffc4 0xffffffc4 0xffffffc4 0xffffffc4 0xffffffc4 0xffffffc4 0xffffffc4 0xffffffc4 0xffffffc4 0xffffffc4 0xffffffc4 0xffffffc4 0xffffffc4 0xffffffc4 0xffffffc4 0xffffffc4 0xffffffc4 0xffffffc4 0xffffffc4 0xffffffc4 0xffffffc4 0xffffffc4 0xffffffc4 0xffffffc4 0xffffffc4 0xffffffc4 0xffffffc4 0xffffffc4 0xffffffc4 0xffffffc4 0xffffffc4 0xffffffc4 0xffffffc4 0xffffffc4 0xffffffc4 0xffffffc4 0xffffffc4 0xffffffc4 0xffffffc4 0xffffffc4 0xffffffc4 0xffffffc4 0xffffffc4 0xffffffc4 0xffffffc4 0xffffffc4 0xffffffc4 0xffffffc4 0xffffffc4 0xffffffc4 0xffffffc4 0xffffffc4 0xffffffc4 0xffffffc4 0xffffffc4 0xffffffc4 0xffffffc4 0xffffffc4 0xffffffc4 0xffffffc4 0xffffffc4 0xffffffc4 0xffffffc4 0xffffffc4 0xffffffc4 0xffffffc4 0xffffffc4 0xffffffc4 0xffffffc4 0xffffffc4 0xffffffc4 0xffffffc4 0xffffffc4 0xffffffc4 0xffffffc4 0xffffffc4 0xffffffc4 0xffffffc4 0xffffffc4 0xffffffc4 0xffffffc4 0xffffffc4 0xffffffc4 0xffffffc4 0xffffffc4 0xffffffc4 0xffffffc4 0xffffffc4 0xffffffc4 0xffffffc4 0xffffffc4 0xffffffc4 0xffffffc4 0xffffffc4 0xffffffc4 0xffffffc4 0xffffffc4 0xffffffc4 0xffffffc4 0xffffffc4 0xffffffc4 0xffffffc4 0xffffffc4 0xffffffc4 0xffffffc4 0xffffffc4 0xffffffc4 0xffffffc4 0xffffffc4 0xffffffc4 0xffffffc4 0xffffffc4 0xffffffc4 0xffffffc4 0xffffffc4 0xffffffc4 0xffffffc4 0xffffffc4 0xffffffc4 0xffffffc4 0xffffffc4 0xffffffc4 0xffffffc4 0xffffffc4 0xffffffc4 0xffffffc4 0xffffffc4 0xffffffc4 0xffffffc4 0xffffffc4 0xffffffc4 0xffffffc4 0xffffffc4 0xffffffc4 0xffffffc4 0xffffffc4 0xffffffc4 0xffffffc4 0xffffffc4 0xffffffc4 0xffffffc4 0xffffffc4 0xffffffc4 0xffffffc4 0xffffffc4 0xffffffc4 0xffffffc4 0xffffffc4 0xffffffc4 0xffffffc4 0xffffffc4 0xffffffc4 0xffffffc4 0xffffffc4 0xffffffc4 0xffffffc4 0xffffffc4 0xffffffc4 0xffffffc4 0xffffffc4 0xffffffc4 0xffffffc4 0xffffffc4 0xffffffc4 0xffffffc4 0xffffffc4 0xffffffc4 0xffffffc4 0xffffffc4 0xffffffc4 0xffffffc4 0xffffffc4 0xffffffc4 0xffffffc4 0xffffffc4 0xffffffc4 0xffffffc4 0xffffffc4 0xffffffc4 0xffffffc4 0xffffffc4 0xffffffc4 0xffffffc4 0xffffffc4 0xffffffc4 0xffffffc4 0xffffffc4 0xffffffc4 0xffffffc4 0xffffffc4 0xffffffc4 0xffffffc4 0xffffffc4 0xffffffc4 0xffffffc4 0xffffffc4 0xffffffc4 0xffffffc4 0xffffffc4 0xffffffc4 0xffffffc4 0xffffffc4 0xffffffc4 0xffffffc4 0xffffffc4 0xffffffc4 0xffffffc4 0xffffffc4 0xffffffc4 0xffffffc4 0xffffffc4 0xffffffc4 0xffffffc4 0xffffffc4 0xffffffc4 0xffffffc4 0xffffffc4 0xffffffc4 0xffffffc4 0xffffffc4 0xffffffc4 0xffffffc4 0xffffffc4 0xffffffc4 0xffffffc4 0xffffffc4 0xffffffc4 0xffffffc4 0xffffffc4 0xffffffc4 0xffffffc4 0xffffffc4 0xffffffc4 0xffffffc4 0xffffffc4 0xffffffc4 0xffffffc4 0xffffffc4 0xffffffc4 0xffffffc4 0xffffffc4 0xffffffc4 0xffffffc4 0xffffffc4 0xffffffc4 0xffffffc4 0xffffffc4 0xffffffc4 0xffffffc4 0xffffffc4 0xffffffc4 0xffffffc4 0xffffffc4 0xffffffc4 0xffffffc4 0xffffffc4 0xffffffc4 0xffffffc4 0xffffffc4 0xffffffc4 0xffffffc4 0xffffffc4 0xffffffc4 0xffffffc4 0xffffffc4 0xffffffc4 0xffffffc4 0xffffffc4 0xffffffc4 0xffffffc4 0xffffffc4 0xffffffc4 0xffffffc4 0xffffffc4 0xffffffc4 0xffffffc4 0xffffffc4 0xffffffc4 0xffffffc4 0xffffffc4 0xffffffc4 0xffffffc4 0xffffffc4 0xffffffc4 0xffffffc4 0xffffffc4 0xffffffc4 0xffffffc4 0xffffffc4 0xffffffc4 0xffffffc4 0xffffffc4 0xffffffc4 0xffffffc4 0xffffffc4 0xffffffc4 0xffffffc4 0xffffffc4 0xffffffc4 0xffffffc4 0xffffffc4 0xffffffc4 0xffffffc4 0xffffffc4 0xffffffc4 0xffffffc4 0xffffffc4 0xffffffc4 0xffffffc4 0xffffffc4 0xffffffc4 0xffffffc4 0xffffffc4 0xffffffc4 0xffffffc4 0xffffffc4 0xffffffc4 0xffffffc4 0xffffffc4 0xffffffc4 0xffffffc4 0xffffffc4 0xffffffc4 0xffffffc4 0xffffffc4 0xffffffc4 0xffffffc4 0xffffffc4 0xffffffc4 0xffffffc4 0xffffffc4 0xffffffc4 0xffffffc4 0xffffffc4 0xffffffc4 0xffffffc4 0xffffffc4 0xffffffc4 0xffffffc4 0xffffffc4 0xffffffc4 0xffffffc4 0xffffffc4 0xffffffc4 0xffffffc4 0xffffffc4 0xffffffc4 0xffffffc4 0xffffffc4 0xffffffc4 0xffffffc4 0xffffffc4 0xffffffc4 0xffffffc4 0xffffffc4 0xffffffc4 0xffffffc4 0xffffffc4 0xffffffc4 0xffffffc4 0xffffffc4 0xffffffc4 0xffffffc4 0xffffffc4 0xffffffc4 0xffffffc4 0xffffffc4 0xffffffc4 0xffffffc4 0xffffffc4 0xffffffc4 0xffffffc4 0xffffffc4 0xffffffc4 0xffffffc4 0xffffffc4 0xffffffc4 0xffffffc4 0xffffffc4 0xffffffc4 0xffffffc4 0xffffffc4 0xffffffc4 0xffffffc4 0xffffffc4 0xffffffc4 0xffffffc4 0xffffffc4 0xffffffc4 0xffffffc4 0xffffffc4 0xffffffc4 0xffffffc4 0xffffffc4 0xffffffc4 0xffffffc4 0xffffffc4 0xffffffc4 0xffffffc4 0xffffffc4 0xffffffc4 0xffffffc4 0xffffffc4 0xffffffc4 0xffffffc4 0xffffffc4 0xffffffc4 0xffffffc4 0xffffffc4 0xffffffc4 0xffffffc4 0xffffffc4 0xffffffc4 0xffffffc4 0xffffffc4 0xffffffc4 0xffffffc4 0xffffffc4 0xffffffc4 0xffffffc4 0xffffffc4 0xffffffc4 0xffffffc4 0xffffffc4 0xffffffc4 0xffffffc4 0xffffffc4 0xffffffc4 0xffffffc4 0xffffffc4 0xffffffc4 0xffffffc4 0xffffffc4 0xffffffc4 0xffffffc4 0xffffffc4 0xffffffc4 0xffffffc4 0xffffffc4 0xffffffc4 0xffffffc4 0xffffffc4 0xffffffc4 0xffffffc4 0xffffffc4 0xffffffc4 0xffffffc4 0xffffffc4 0xffffffc4 0xffffffc4 0xffffffc4 0xffffffc4 0xffffffc4 0xffffffc4 0xffffffc4 0xffffffc4 0xffffffc4 0xffffffc4 0xffffffc4 0xffffffc4 0xffffffc4 0xffffffc4 0xffffffc4 0xffffffc4 0xffffffc4 0xffffffc4 0xffffffc4 0xffffffc4 0xffffffc4 0xffffffc4 0xffffffc4 0xffffffc4 0xffffffc4 0xffffffc4 0xffffffc4 0xffffffc4 0xffffffc4 0xffffffc4 0xffffffc4 0xffffffc4 0xffffffc4 0xffffffc4 0xffffffc4 0xffffffc4 0xffffffc4 0xffffffc4 0xffffffc4 0xffffffc4 0xffffffc4 0xffffffc4 0xffffffc4 0xffffffc4 0xffffffc4 0xffffffc4 0xffffffc4 0xffffffc4 0xffffffc4 0xffffffc4 0xffffffc4 0xffffffc4 0xffffffc4 0xffffffc4 0xffffffc4 0xffffffc4 0xffffffc4 0xffffffc4 0xffffffc4 0xffffffc4 0xffffffc4 0xffffffc4 0xffffffc4 0xffffffc4 0xffffffc4 0xffffffc4 0xffffffc4 0xffffffc4 0xffffffc4 0xffffffc4 0xffffffc4 0xffffffc4 0xffffffc4 0xffffffc4 0xffffffc4 0xffffffc4 0xffffffc4 0xffffffc4 0xffffffc4 0xffffffc4 0xffffffc4 0xffffffc4 0xffffffc4 0xffffffc4 0xffffffc4 0xffffffc4 0xffffffc4 0xffffffc4 0xffffffc4 0xffffffc4 0xffffffc4 0xffffffc4 0xffffffc4 0xffffffc4 0xffffffc4 0xffffffc4 0xffffffc4 0xffffffc4 0xffffffc4 0xffffffc4 0xffffffc4 0xffffffc4 0xffffffc4 0xffffffc4 0xffffffc4 0xffffffc4 0xffffffc4 0xffffffc4 0xffffffc4 0xffffffc4 0xffffffc4 0xffffffc4 0xffffffc4 0xffffffc4 0xffffffc4 0xffffffc4 0xffffffc4 0xffffffc4 0xffffffc4 0xffffffc4 0xffffffc4 0xffffffc4 0xffffffc4 0xffffffc4 0xffffffc4 0xffffffc4 0xffffffc4 0xffffffc4 0xffffffc4 0xffffffc4 0xffffffc4 0xffffffc4 0xffffffc4 0xffffffc4 0xffffffc4 0xffffffc4 0xffffffc4 0xffffffc4 0xffffffc4 0xffffffc4 0xffffffc4 0xffffffc4 0xffffffc4 0xffffffc4 0xffffffc4 0xffffffc4 0xffffffc4 0xffffffc4 0xffffffc4 0xffffffc4 0xffffffc4 0xffffffc4 0xffffffc4 0xffffffc4 0xffffffc4 0xffffffc4 0xffffffc4 0xffffffc4 0xffffffc4 0xffffffc4 0xffffffc4 0xffffffc4 0xffffffc4 0xffffffc4 0xffffffc4 0xffffffc4 0xffffffc4 0xffffffc4 0xffffffc4 0xffffffc4 0xffffffc4 0xffffffc4 0xffffffc4 0xffffffc4 0xffffffc4 0xffffffc4 0xffffffc4 0xffffffc4 0xffffffc4 0xffffffc4 0xffffffc4 0xffffffc4 0xffffffc4 0xffffffc4 0xffffffc4 0xffffffc4 0xffffffc4 0xffffffc4 0xffffffc4 0xffffffc4 0xffffffc4 0xffffffc4 0xffffffc4 0xffffffc4 0xffffffc4 0xffffffc4 0xffffffc4 0xffffffc4 0xffffffc4 0xffffffc4 0xffffffc4 0xffffffc4 0xffffffc4 0xffffffc4 0xffffffc4 0xffffffc4 0xffffffc4 0xffffffc4 0xffffffc4 0xffffffc4 0xffffffc4 0xffffffc4 0xffffffc4 0xffffffc4 0xffffffc4 0xffffffc4 0xffffffc4 0xffffffc4 0xffffffc4 0xffffffc4 0xffffffc4 0xffffffc4 0xffffffc4 0xffffffc4 0xffffffc4 0xffffffc4 0xffffffc4 0xffffffc4 0xffffffc4 0xffffffc4 0xffffffc4 0xffffffc4 0xffffffc4 0xffffffc4 0xffffffc4 0xffffffc4 0xffffffc4 0xffffffc4 0xffffffc4 0xffffffc4 0xffffffc4 0xffffffc4 0xffffffc4 0xffffffc4 0xffffffc4 0xffffffc4 0xffffffc4 0xffffffc4 0xffffffc4 0xffffffc4 0xffffffc4 0xffffffc4 0xffffffc4 0xffffffc4 0xffffffc4 0xffffffc4 0xffffffc4 0xffffffc4 0xffffffc4 0xffffffc4 0xffffffc4 0xffffffc4 0xffffffc4 0xffffffc4 0xffffffc4 0xffffffc4 0xffffffc4 0xffffffc4 0xffffffc4 0xffffffc4 0xffffffc4 0xffffffc4 0xffffffc4 0xffffffc4 0xffffffc4 0xffffffc4 0xffffffc4 0xffffffc4 0xffffffc4 0xffffffc4 0xffffffc4 0xffffffc4 0xffffffc4 0xffffffc4 0xffffffc4 0xffffffc4 0xffffffc4 0xffffffc4 0xffffffc4 0xffffffc4 0xffffffc4 0xffffffc4 0xffffffc4 0xffffffc4 0xffffffc4 0xffffffc4 0xffffffc4 0xffffffc4 0xffffffc4 0xffffffc4 0xffffffc4 0xffffffc4 0xffffffc4 0xffffffc4 0xffffffc4 0xffffffc4 0xffffffc4 0xffffffc4 0xffffffc4 0xffffffc4 0xffffffc4 0xffffffc4 0xffffffc4 0xffffffc4 0xffffffc4 0xffffffc4 0xffffffc4 0xffffffc4 0xffffffc4 0xffffffc4 0xffffffc4 0xffffffc4 0xffffffc4 0xffffffc4 0xffffffc4 0xffffffc4 0xffffffc4 0xffffffc4 0xffffffc4 0xffffffc4 0xffffffc4 0xffffffc4 0xffffffc4 0xffffffc4 0xffffffc4 0xffffffc4 0xffffffc4 0xffffffc4 0xffffffc4 0xffffffc4 0xffffffc4 0xffffffc4 0xffffffc4 0xffffffc4 0xffffffc4 0xffffffc4 0xffffffc4 0xffffffc4 0xffffffc4 0xffffffc4 0xffffffc4 0xffffffc4 0xffffffc4 0xffffffc4 0xffffffc4 0xffffffc4 0xffffffc4 0xffffffc4 0xffffffc4 0xffffffc4 0xffffffc4 0xffffffc4 0xffffffc4 0xffffffc4 0xffffffc4 0xffffffc4 0xffffffc4 0xffffffc4 0xffffffc4 0xffffffc4 0xffffffc4 0xffffffc4 0xffffffc4 0xffffffc4 0xffffffc4 0xffffffc4 0xffffffc4 0xffffffc4 0xffffffc4 0xffffffc4 0xffffffc4 0xffffffc4 0xffffffc4 0xffffffc4 0xffffffc4 0xffffffc4 0xffffffc4 0xffffffc4 0xffffffc4 0xffffffc4 0xffffffc4 0xffffffc4 0xffffffc4 0xffffffc4 0xffffffc4 0xffffffc4 0xffffffc4 0xffffffc4 0xffffffc4 0xffffffc4 0xffffffc4 0xffffffc4 0xffffffc4 0xffffffc4 0xffffffc4 0xffffffc4 0xffffffc4 0xffffffc4 0xffffffc4 0xffffffc4 0xffffffc4 0xffffffc4 0xffffffc4 0xffffffc4 0xffffffc4 0xffffffc4 0xffffffc4 0xffffffc4 0xffffffc4 0xffffffc4 0xffffffc4 0xffffffc4 0xffffffc4 0xffffffc4 0xffffffc4 0xffffffc4 0xffffffc4 0xffffffc4 0xffffffc4 0xffffffc4 0xffffffc4 0xffffffc4 0xffffffc4 0xffffffc4 0xffffffc4 0xffffffc4 0xffffffc4 0xffffffc4 0xffffffc4 0xffffffc4 0xffffffc4 0xffffffc4 0xffffffc4 0xffffffc4 0xffffffc4 0xffffffc4 0xffffffc4 0xffffffc4 0xffffffc4 0xffffffc4 0xffffffc4 0xffffffc4 0xffffffc4 0xffffffc4 0xffffffc4 0xffffffc4 0xffffffc4 0xffffffc4 0xffffffc4 0xffffffc4 0xffffffc4 0xffffffc4 0xffffffc4 0xffffffc4 0xffffffc4 0xffffffc4 0xffffffc4 0xffffffc4 0xffffffc4 0xffffffc4 0xffffffc4 0xffffffc4 0xffffffc4 0xffffffc4 0xffffffc4 0xffffffc4 0xffffffc4 0xffffffc4 0xffffffc4 0xffffffc4 0xffffffc4 0xffffffc4 0xffffffc4 0xffffffc4 0xffffffc4 0xffffffc4 0xffffffc4 0xffffffc4 0xffffffc4 0xffffffc4 0xffffffc4 0xffffffc4 0xffffffc4 0xffffffc4 0xffffffc4 0xffffffc4 0xffffffc4 0xffffffc4 0xffffffc4 0xffffffc4 0xffffffc4 0xffffffc4 0xffffffc4 0xffffffc4 0xffffffc4 0xffffffc4 0xffffffc4 0xffffffc4 0xffffffc4 0xffffffc4 0xffffffc4 0xffffffc4 0xffffffc4 0xffffffc4 0xffffffc4 0xffffffc4 0xffffffc4 0xffffffc4 0xffffffc4 0xffffffc4 0xffffffc4 0xffffffc4 0xffffffc4 0xffffffc4 0xffffffc4 0xffffffc4 0xffffffc4 0xffffffc4 0xffffffc4 0xffffffc4 0xffffffc4 0xffffffc4 0xffffffc4 0xffffffc4 0xffffffc4 0xffffffc4 0xffffffc4 0xffffffc4 0xffffffc4 0xffffffc4 0xffffffc4 0xffffffc4 0xffffffc4 0xffffffc4 0xffffffc4 0xffffffc4 0xffffffc4 0xffffffc4 0xffffffc4 0xffffffc4 0xffffffc4 0xffffffc4 0xffffffc4 0xffffffc4 0xffffffc4 0xffffffc4 0xffffffc4 0xffffffc4 0xffffffc4 0xffffffc4 0xffffffc4 0xffffffc4 0xffffffc4 0xffffffc4 0xffffffc4 0xffffffc4 0xffffffc4 0xffffffc4 0xffffffc4 0xffffffc4 0xffffffc4 0xffffffc4 0xffffffc4 0xffffffc4 0xffffffc4 0xffffffc4 0xffffffc4 0xffffffc4 0xffffffc4 0xffffffc4 0xffffffc4 0xffffffc4 0xffffffc4 0xffffffc4 0xffffffc4 0xffffffc4 0xffffffc4 0xffffffc4 0xffffffc4 0xffffffc4 0xffffffc4 0xffffffc4 0xffffffc4 0xffffffc4 0xffffffc4 0xffffffc4 0xffffffc4 0xffffffc4 0xffffffc4 0xffffffc4 0xffffffc4 0xffffffc4 0xffffffc4 0xffffffc4 0xffffffc4 0xffffffc4 0xffffffc4 0xffffffc4 0xffffffc4 0xffffffc4 0xffffffc4 0xffffffc4 0xffffffc4 0xffffffc4 0xffffffc4 0xffffffc4 0xffffffc4 0xffffffc4 0xffffffc4 0xffffffc4 0xffffffc4 0xffffffc4 0xffffffc4 0xffffffc4 0xffffffc4 0xffffffc4 0xffffffc4 0xffffffc4 0xffffffc4 0xffffffc4 0xffffffc4 0xffffffc4 0xffffffc4 0xffffffc4 0xffffffc4 0xffffffc4 0xffffffc4 0xffffffc4 0xffffffc4 0xffffffc4 0xffffffc4 0xffffffc4 0xffffffc4 0xffffffc4 0xffffffc4 0xffffffc4 0xffffffc4 0xffffffc4 0xffffffc4 0xffffffc4 0xffffffc4 0xffffffc4 0xffffffc4 0xffffffc4 0xffffffc4 0xffffffc4 0xffffffc4 0xffffffc4 0xffffffc4 0xffffffc4 0xffffffc4 0xffffffc4 0xffffffc4 0xffffffc4 0xffffffc4 0xffffffc4 0xffffffc4 0xffffffc4 0xffffffc4 0xffffffc4 0xffffffc4 0xffffffc4 0xffffffc4 0xffffffc4 0xffffffc4 0xffffffc4 0xffffffc4 0xffffffc4 0xffffffc4 0xffffffc4 0xffffffc4 0xffffffc4 0xffffffc4 0xffffffc4 0xffffffc4 0xffffffc4 0xffffffc4 0xffffffc4 0xffffffc4 0xffffffc4 0xffffffc4 0xffffffc4 0xffffffc4 0xffffffc4 0xffffffc4 0xffffffc4 0xffffffc4 0xffffffc4 0xffffffc4 0xffffffc4 0xffffffc4 0xffffffc4 0xffffffc4 0xffffffc4 0xffffffc4 0xffffffc4 0xffffffc4 0xffffffc4 0xffffffc4 0xffffffc4 0xffffffc4 0xffffffc4 0xffffffc4 0xffffffc4 0xffffffc4 0xffffffc4 0xffffffc4 0xffffffc4 0xffffffc4 0xffffffc4 0xffffffc4 0xffffffc4 0xffffffc4 0xffffffc4 0xffffffc4 0xffffffc4 0xffffffc4 0xffffffc4 0xffffffc4 0xffffffc4 0xffffffc4 0xffffffc4 0xffffffc4 0xffffffc4 0xffffffc4 0xffffffc4 0xffffffc4 0xffffffc4 0xffffffc4 0xffffffc4 0xffffffc4 0xffffffc4 0xffffffc4 0xffffffc4 0xffffffc4 0xffffffc4 0xffffffc4 0xffffffc4 0xffffffc4 0xffffffc4 0xffffffc4 0xffffffc4 0xffffffc4 0xffffffc4 0xffffffc4 0xffffffc4 0xffffffc4 0xffffffc4 0xffffffc4 0xffffffc4 0xffffffc4 0xffffffc4 0xffffffc4 0xffffffc4 0xffffffc4 0xffffffc4 0xffffffc4 0xffffffc4 0xffffffc4 0xffffffc4 0xffffffc4 0xffffffc4 0xffffffc4 0xffffffc4 0xffffffc4 0xffffffc4 0xffffffc4 0xffffffc4 0xffffffc4 0xffffffc4 0xffffffc4 0xffffffc4 0xffffffc4 0xffffffc4 0xffffffc4 0xffffffc4 0xffffffc4 0xffffffc4 0xffffffc4 0xffffffc4 0xffffffc4 0xffffffc4 0xffffffc4 0xffffffc4 0xffffffc4 0xffffffc4 0xffffffc4 0xffffffc4 0xffffffc4 0xffffffc4 0xffffffc4 0xffffffc4 0xffffffc4 0xffffffc4 0xffffffc4 0xffffffc4 0xffffffc4 0xffffffc4 0xffffffc4 0xffffffc4 0xffffffc4 0xffffffc4 0xffffffc4 0xffffffc4 0xffffffc4 0xffffffc4 0xffffffc4 0xffffffc4 0xffffffc4 0xffffffc4 0xffffffc4 0xffffffc4 0xffffffc4 0xffffffc4 0xffffffc4 0xffffffc4 0xffffffc4 0xffffffc4 0xffffffc4 0xffffffc4 0xffffffc4 0xffffffc4 0xffffffc4 0xffffffc4 0xffffffc4 0xffffffc4 0xffffffc4 0xffffffc4 0xffffffc4 0xffffffc4 0xffffffc4 0xffffffc4 0xffffffc4 0xffffffc4 0xffffffc4 0xffffffc4 0xffffffc4 0xffffffc4 0xffffffc4 0xffffffc4 0xffffffc4 0xffffffc4 0xffffffc4 0xffffffc4 0xffffffc4 0xffffffc4 0xffffffc4 0xffffffc4 0xffffffc4 0xffffffc4 0xffffffc4 0xffffffc4 0xffffffc4 0xffffffc4 0xffffffc4 0xffffffc4 0xffffffc4 0xffffffc4 0xffffffc4 0xffffffc4 0xffffffc4 0xffffffc4 0xffffffc4 0xffffffc4 0xffffffc4 0xffffffc4 0xffffffc4 0xffffffc4 0xffffffc4 0xffffffc4 0xffffffc4 0xffffffc4 0xffffffc4 0xffffffc4 0xffffffc4 0xffffffc4 0xffffffc4 0xffffffc4 0xffffffc4 0xffffffc4 0xffffffc4 0xffffffc4 0xffffffc4 0xffffffc4 0xffffffc4 0xffffffc4 0xffffffc4 0xffffffc4 0xffffffc4 0xffffffc4 0xffffffc4 0xffffffc4 0xffffffc4 0xffffffc4 0xffffffc4 0xffffffc4 0xffffffc4 0xffffffc4 0xffffffc4 0xffffffc4 0xffffffc4 0xffffffc4 0xffffffc4 0xffffffc4 0xffffffc4 0xffffffc4 0xffffffc4 0xffffffc4 0xffffffc4 0xffffffc4 0xffffffc4 0xffffffc4 0xffffffc4 0xffffffc4 0xffffffc4>;
				pt11_lo_limits_cols_01 = <0x26>;
				pt11_lo_limits_cols_02 = <0x26>;
				pt11_lo_limits_row_01 = <0x26>;
				pt11_lo_limits_row_02 = <0x26>;
				pt7_hi_limits_01 = <0x578 0x578 0x578 0x578 0x578 0x578 0x578 0x578 0x578 0x578 0x578 0x578 0x578 0x578 0x578 0x578 0x578 0x578 0x578 0x578 0x578 0x578 0x578 0x578 0x578 0x578 0x578 0x578 0x578 0x578 0x578 0x578 0x578 0x578 0x578 0x578 0x578 0x578 0x578 0x578 0x578 0x578 0x578 0x578 0x578 0x578 0x578 0x578 0x578 0x578 0x578 0x578 0x578 0x578 0x578 0x578 0x578 0x578 0x578 0x578 0x578 0x578 0x578 0x578 0x578 0x578 0x578 0x578 0x578 0x578 0x578 0x578 0x578 0x578 0x578 0x578 0x578 0x578 0x578 0x578 0x578 0x578 0x578 0x578 0x578 0x578 0x578 0x578 0x578 0x578 0x578 0x578 0x578 0x578 0x578 0x578 0x578 0x578 0x578 0x578 0x578 0x578 0x578 0x578 0x578 0x578 0x578 0x578 0x578 0x578 0x578 0x578 0x578 0x578 0x578 0x578 0x578 0x578 0x578 0x578 0x578 0x578 0x578 0x578 0x578 0x578 0x578 0x578 0x578 0x578 0x578 0x578 0x578 0x578 0x578 0x578 0x578 0x578 0x578 0x578 0x578 0x578 0x578 0x578 0x578 0x578 0x578 0x578 0x578 0x578 0x578 0x578 0x578 0x578 0x578 0x578 0x578 0x578 0x578 0x578 0x578 0x578 0x578 0x578 0x578 0x578 0x578 0x578 0x578 0x578 0x578 0x578 0x578 0x578 0x578 0x578 0x578 0x578 0x578 0x578 0x578 0x578 0x578 0x578 0x578 0x578 0x578 0x578 0x578 0x578 0x578 0x578 0x578 0x578 0x578 0x578 0x578 0x578 0x578 0x578 0x578 0x578 0x578 0x578 0x578 0x578 0x578 0x578 0x578 0x578 0x578 0x578 0x578 0x578 0x578 0x578 0x578 0x578 0x578 0x578 0x578 0x578 0x578 0x578 0x578 0x578 0x578 0x578 0x578 0x578 0x578 0x578 0x578 0x578 0x578 0x578 0x578 0x578 0x578 0x578 0x578 0x578 0x578 0x578 0x578 0x578 0x578 0x578 0x578 0x578 0x578 0x578 0x578 0x578 0x578 0x578 0x578 0x578 0x578 0x578 0x578 0x578 0x578 0x578 0x578 0x578 0x578 0x578 0x578 0x578 0x578 0x578 0x578 0x578 0x578 0x578 0x578 0x578 0x578 0x578 0x578 0x578 0x578 0x578 0x578 0x578 0x578 0x578 0x578 0x578 0x578 0x578 0x578 0x578 0x578 0x578 0x578 0x578 0x578 0x578 0x578 0x578 0x578 0x578 0x578 0x578 0x578 0x578 0x578 0x578 0x578 0x578 0x578 0x578 0x578 0x578 0x578 0x578 0x578 0x578 0x578 0x578 0x578 0x578 0x578 0x578 0x578 0x578 0x578 0x578 0x578 0x578 0x578 0x578 0x578 0x578 0x578 0x578 0x578 0x578 0x578 0x578 0x578 0x578 0x578 0x578 0x578 0x578 0x578 0x578 0x578 0x578 0x578 0x578 0x578 0x578 0x578 0x578 0x578 0x578 0x578 0x578 0x578 0x578 0x578 0x578 0x578 0x578 0x578 0x578 0x578 0x578 0x578 0x578 0x578 0x578 0x578 0x578 0x578 0x578 0x578 0x578 0x578 0x578 0x578 0x578 0x578 0x578 0x578 0x578 0x578 0x578 0x578 0x578 0x578 0x578 0x578 0x578 0x578 0x578 0x578 0x578 0x578 0x578 0x578 0x578 0x578 0x578 0x578 0x578 0x578 0x578 0x578 0x578 0x578 0x578 0x578 0x578 0x578 0x578 0x578 0x578 0x578 0x578 0x578 0x578 0x578 0x578 0x578 0x578 0x578 0x578 0x578 0x578 0x578 0x578 0x578 0x578 0x578 0x578 0x578 0x578 0x578 0x578 0x578 0x578 0x578 0x578 0x578 0x578 0x578 0x578 0x578 0x578 0x578 0x578 0x578 0x578 0x578 0x578 0x578 0x578 0x578 0x578 0x578 0x578 0x578 0x578 0x578 0x578 0x578 0x578 0x578 0x578 0x578 0x578 0x578 0x578 0x578 0x578 0x578 0x578 0x578 0x578 0x578 0x578 0x578 0x578 0x578 0x578 0x578 0x578 0x578 0x578 0x578 0x578 0x578 0x578 0x578 0x578 0x578 0x578 0x578 0x578 0x578 0x578 0x578 0x578 0x578 0x578 0x578 0x578 0x578 0x578 0x578 0x578 0x578 0x578 0x578 0x578 0x578 0x578 0x578 0x578 0x578 0x578 0x578 0x578 0x578 0x578 0x578 0x578 0x578 0x578 0x578 0x578 0x578 0x578 0x578 0x578 0x578 0x578 0x578 0x578 0x578 0x578 0x578 0x578 0x578 0x578 0x578 0x578 0x578 0x578 0x578 0x578 0x578 0x578 0x578 0x578 0x578 0x578 0x578 0x578 0x578 0x578 0x578 0x578 0x578 0x578 0x578 0x578 0x578 0x578 0x578 0x578 0x578 0x578 0x578 0x578 0x578 0x578 0x578 0x578 0x578 0x578 0x578 0x578 0x578 0x578 0x578 0x578 0x578 0x578 0x578 0x578 0x578 0x578 0x578 0x578 0x578 0x578 0x578 0x578 0x578 0x578 0x578 0x578 0x578 0x578 0x578 0x578 0x578 0x578 0x578 0x578 0x578 0x578 0x578 0x578 0x578 0x578 0x578 0x578 0x578 0x578 0x578 0x578 0x578 0x578 0x578 0x578 0x578 0x578 0x578 0x578 0x578 0x578 0x578 0x578 0x578 0x578 0x578 0x578 0x578 0x578 0x578 0x578 0x578 0x578 0x578 0x578 0x578 0x578 0x578 0x578 0x578 0x578 0x578 0x578 0x578 0x578 0x578 0x578 0x578 0x578 0x578 0x578 0x578 0x578 0x578 0x578 0x578 0x578 0x578 0x578 0x578 0x578 0x578 0x578 0x578 0x578 0x578 0x578 0x578 0x578 0x578 0x578 0x578 0x578 0x578 0x578 0x578 0x578 0x578 0x578 0x578 0x578 0x578 0x578 0x578 0x578 0x578 0x578 0x578 0x578 0x578 0x578 0x578 0x578 0x578 0x578 0x578 0x578 0x578 0x578 0x578 0x578 0x578 0x578 0x578 0x578 0x578 0x578 0x578 0x578 0x578 0x578 0x578 0x578 0x578 0x578 0x578 0x578 0x578 0x578 0x578 0x578 0x578 0x578 0x578 0x578 0x578 0x578 0x578 0x578 0x578 0x578 0x578 0x578 0x578 0x578 0x578 0x578 0x578 0x578 0x578 0x578 0x578 0x578 0x578 0x578 0x578 0x578 0x578 0x578 0x578 0x578 0x578 0x578 0x578 0x578 0x578 0x578 0x578 0x578 0x578 0x578 0x578 0x578 0x578 0x578 0x578 0x578 0x578 0x578 0x578 0x578 0x578 0x578 0x578 0x578 0x578 0x578 0x578 0x578 0x578 0x578 0x578 0x578 0x578 0x578 0x578 0x578 0x578 0x578 0x578 0x578 0x578 0x578 0x578 0x578 0x578 0x578 0x578 0x578 0x578 0x578 0x578 0x578 0x578 0x578 0x578 0x578 0x578 0x578 0x578 0x578 0x578 0x578 0x578 0x578 0x578 0x578 0x578 0x578 0x578 0x578 0x578 0x578 0x578 0x578 0x578 0x578 0x578 0x578 0x578 0x578 0x578 0x578 0x578 0x578 0x578 0x578 0x578 0x578 0x578 0x578 0x578 0x578 0x578 0x578 0x578 0x578 0x578 0x578 0x578 0x578 0x578 0x578 0x578 0x578 0x578 0x578 0x578 0x578 0x578 0x578 0x578 0x578 0x578 0x578 0x578 0x578 0x578 0x578 0x578 0x578 0x578 0x578 0x578 0x578 0x578 0x578 0x578 0x578 0x578 0x578 0x578 0x578 0x578 0x578 0x578 0x578 0x578 0x578 0x578 0x578 0x578 0x578 0x578 0x578 0x578 0x578 0x578 0x578 0x578 0x578 0x578 0x578 0x578 0x578 0x578 0x578 0x578 0x578 0x578 0x578 0x578 0x578 0x578 0x578 0x578 0x578 0x578 0x578 0x578 0x578 0x578 0x578 0x578 0x578 0x578 0x578 0x578 0x578 0x578 0x578 0x578 0x578 0x578 0x578 0x578 0x578 0x578 0x578 0x578 0x578 0x578 0x578 0x578 0x578 0x578 0x578 0x578 0x578 0x578 0x578 0x578 0x578 0x578 0x578 0x578 0x578 0x578 0x578 0x578 0x578 0x578 0x578 0x578 0x578 0x578 0x578 0x578 0x578 0x578 0x578 0x578 0x578 0x578 0x578 0x578 0x578 0x578 0x578 0x578 0x578 0x578 0x578 0x578 0x578 0x578 0x578 0x578 0x578 0x578 0x578 0x578 0x578 0x578 0x578 0x578 0x578 0x578 0x578 0x578 0x578 0x578 0x578 0x578 0x578 0x578 0x578 0x578 0x578 0x578 0x578 0x578 0x578 0x578 0x578 0x578 0x578 0x578 0x578 0x578 0x578 0x578 0x578 0x578 0x578 0x578 0x578 0x578 0x578 0x578 0x578 0x578 0x578 0x578 0x578 0x578 0x578 0x578 0x578 0x578 0x578 0x578 0x578 0x578 0x578 0x578 0x578 0x578 0x578 0x578 0x578 0x578 0x578 0x578 0x578 0x578 0x578 0x578 0x578 0x578 0x578 0x578 0x578 0x578 0x578 0x578 0x578 0x578 0x578 0x578 0x578 0x578 0x578 0x578 0x578 0x578 0x578 0x578 0x578 0x578 0x578 0x578 0x578 0x578 0x578 0x578 0x578 0x578 0x578 0x578 0x578 0x578 0x578 0x578 0x578 0x578 0x578 0x578 0x578 0x578 0x578 0x578 0x578 0x578 0x578 0x578 0x578 0x578 0x578 0x578 0x578 0x578 0x578 0x578 0x578 0x578 0x578 0x578 0x578 0x578 0x578 0x578 0x578 0x578 0x578 0x578 0x578 0x578 0x578 0x578 0x578 0x578 0x578 0x578 0x578 0x578 0x578 0x578 0x578 0x578 0x578 0x578 0x578 0x578 0x578 0x578 0x578 0x578 0x578 0x578 0x578 0x578 0x578 0x578 0x578 0x578 0x578 0x578 0x578 0x578 0x578 0x9c4 0x578 0x578 0x578 0x578 0x578 0x578 0x578 0x578 0x578 0x578 0x578 0x578 0x578 0x578 0x578 0x578 0x9c4 0x578 0x578 0x578 0x578 0x578 0x578 0x578 0x578 0x578 0x578 0x578 0x578 0x578 0x578 0x578 0x578 0x578 0x578 0x578 0x578 0x578 0x578 0x578 0x578 0x578 0x578 0x578 0x578 0x578 0x578 0x578 0x578 0x578 0x578 0x578 0x578 0x578 0x578 0x578 0x578 0x578 0x578 0x578 0x578 0x578 0x578 0x578 0x578 0x578 0x578 0x578 0x578 0x578 0x578 0x578 0x578 0x578 0x578 0x578 0x578 0x578 0x578 0x578 0x578 0x578 0x578 0x578 0x578 0x578 0x578 0x578 0x578 0x578 0x578 0x578 0x578 0x578 0x578 0x578 0x578 0x578 0x578 0x578 0x578 0x578 0x578 0x578 0x578 0x578 0x578 0x578 0x578 0x578 0x578 0x578 0x578 0x578 0x578 0x578 0x578 0x578 0x578 0x578 0x578 0x578 0x578 0x578 0x578 0x578 0x578 0x578 0x578 0x578 0x578 0x578 0x578 0x578 0x578 0x578 0x578 0x578 0x578 0x578 0x578 0x578 0x578 0x578 0x578 0x578 0x578 0x578 0x578 0x578 0x578 0x578 0x578 0x578 0x578 0x578 0x578 0x578 0x578 0x578 0x578 0x578 0x578 0x578 0x578 0x578 0x578 0x578 0x578 0x578 0x578 0x578 0x578 0x578 0x578 0x578 0x578 0x578 0x578 0x578 0x578 0x578 0x578 0x578 0x578 0x578 0x578 0x578 0x578 0x578 0x578 0x578 0x578 0x578 0x578 0x578 0x578 0x578 0x578 0x578 0x578 0x578 0x578 0x578 0x578 0x578 0x578 0x578 0x578 0x578 0x578 0x578 0x578 0x578 0x578 0x578 0x578 0x578 0x578 0x578 0x578 0x578 0x578 0x578 0x578 0x578 0x578 0x578 0x578 0x578 0x578 0x578 0x578 0x578 0x578 0x578 0x578 0x578 0x578 0x578 0x578 0x578 0x578 0x578 0x578 0x578 0x578 0x578 0x578 0x578 0x578 0x578 0x578 0x578 0x578 0x578 0x578 0x578 0x578 0x578 0x578 0x578 0x578 0x578 0x578>;
				pt7_hi_limits_02 = <0x514 0x514 0x514 0x514 0x514 0x514 0x514 0x514 0x514 0x514 0x514 0x514 0x514 0x514 0x514 0x514 0x514 0x514 0x514 0x514 0x514 0x514 0x514 0x514 0x514 0x514 0x514 0x514 0x514 0x514 0x514 0x514 0x514 0x514 0x514 0x514 0x514 0x514 0x514 0x514 0x514 0x514 0x514 0x514 0x514 0x514 0x514 0x514 0x514 0x514 0x514 0x514 0x514 0x514 0x514 0x514 0x514 0x514 0x514 0x514 0x514 0x514 0x514 0x514 0x514 0x514 0x514 0x514 0x514 0x514 0x514 0x514 0x514 0x514 0x514 0x514 0x514 0x514 0x514 0x514 0x514 0x514 0x514 0x514 0x514 0x514 0x514 0x514 0x514 0x514 0x514 0x514 0x514 0x514 0x514 0x514 0x514 0x514 0x514 0x514 0x514 0x514 0x514 0x514 0x514 0x514 0x514 0x514 0x514 0x514 0x514 0x514 0x514 0x514 0x514 0x514 0x514 0x514 0x514 0x514 0x514 0x514 0x514 0x514 0x514 0x514 0x514 0x514 0x514 0x514 0x514 0x514 0x514 0x514 0x514 0x514 0x514 0x514 0x514 0x514 0x514 0x514 0x514 0x514 0x514 0x514 0x514 0x514 0x514 0x514 0x514 0x514 0x514 0x514 0x514 0x514 0x514 0x514 0x514 0x514 0x514 0x514 0x514 0x514 0x514 0x514 0x514 0x514 0x514 0x514 0x514 0x514 0x514 0x514 0x514 0x514 0x514 0x514 0x514 0x514 0x514 0x514 0x514 0x514 0x514 0x514 0x514 0x514 0x514 0x514 0x514 0x514 0x514 0x514 0x514 0x514 0x514 0x514 0x514 0x514 0x514 0x514 0x514 0x514 0x514 0x514 0x514 0x514 0x514 0x514 0x514 0x514 0x514 0x514 0x514 0x514 0x514 0x514 0x514 0x514 0x514 0x514 0x514 0x514 0x514 0x514 0x514 0x514 0x514 0x514 0x514 0x514 0x514 0x514 0x514 0x514 0x514 0x514 0x514 0x514 0x514 0x514 0x514 0x514 0x514 0x514 0x514 0x514 0x514 0x514 0x514 0x514 0x514 0x514 0x514 0x514 0x514 0x514 0x514 0x514 0x514 0x514 0x514 0x514 0x514 0x514 0x514 0x514 0x514 0x514 0x514 0x514 0x514 0x514 0x514 0x514 0x514 0x514 0x514 0x514 0x514 0x514 0x514 0x514 0x514 0x514 0x514 0x514 0x514 0x514 0x514 0x514 0x514 0x514 0x514 0x514 0x514 0x514 0x514 0x514 0x514 0x514 0x514 0x514 0x514 0x514 0x514 0x514 0x514 0x514 0x514 0x514 0x514 0x514 0x514 0x514 0x514 0x514 0x514 0x514 0x514 0x514 0x514 0x514 0x514 0x514 0x514 0x514 0x514 0x514 0x514 0x514 0x514 0x514 0x514 0x514 0x514 0x514 0x514 0x514 0x514 0x514 0x514 0x514 0x514 0x514 0x514 0x514 0x514 0x514 0x514 0x514 0x514 0x514 0x514 0x514 0x514 0x514 0x514 0x514 0x514 0x514 0x514 0x514 0x514 0x514 0x514 0x514 0x514 0x514 0x514 0x514 0x514 0x514 0x514 0x514 0x514 0x514 0x514 0x514 0x514 0x514 0x514 0x514 0x514 0x514 0x514 0x514 0x514 0x514 0x514 0x514 0x514 0x514 0x514 0x514 0x514 0x514 0x514 0x514 0x514 0x514 0x514 0x514 0x514 0x514 0x514 0x514 0x514 0x514 0x514 0x514 0x514 0x514 0x514 0x514 0x514 0x514 0x514 0x514 0x514 0x514 0x514 0x514 0x514 0x514 0x514 0x514 0x514 0x514 0x514 0x514 0x514 0x514 0x514 0x514 0x514 0x514 0x514 0x514 0x514 0x514 0x514 0x514 0x514 0x514 0x514 0x514 0x514 0x514 0x514 0x514 0x514 0x514 0x514 0x514 0x514 0x514 0x514 0x514 0x514 0x514 0x514 0x514 0x514 0x514 0x514 0x514 0x514 0x514 0x514 0x514 0x514 0x514 0x514 0x514 0x514 0x514 0x514 0x514 0x514 0x514 0x514 0x514 0x514 0x514 0x514 0x514 0x514 0x514 0x514 0x514 0x514 0x514 0x514 0x514 0x514 0x514 0x514 0x514 0x514 0x514 0x514 0x514 0x514 0x514 0x514 0x514 0x514 0x514 0x514 0x514 0x514 0x514 0x514 0x514 0x514 0x514 0x514 0x514 0x514 0x514 0x514 0x514 0x514 0x514 0x514 0x514 0x514 0x514 0x514 0x514 0x514 0x514 0x514 0x514 0x514 0x514 0x514 0x514 0x514 0x514 0x514 0x514 0x514 0x514 0x514 0x514 0x514 0x514 0x514 0x514 0x514 0x514 0x514 0x514 0x514 0x514 0x514 0x514 0x514 0x514 0x514 0x514 0x514 0x514 0x514 0x514 0x514 0x514 0x514 0x514 0x514 0x514 0x514 0x514 0x514 0x514 0x514 0x514 0x514 0x514 0x514 0x514 0x514 0x514 0x514 0x514 0x514 0x514 0x514 0x514 0x514 0x514 0x514 0x514 0x514 0x514 0x514 0x514 0x514 0x514 0x514 0x514 0x514 0x514 0x514 0x514 0x514 0x514 0x514 0x514 0x514 0x514 0x514 0x514 0x514 0x514 0x514 0x514 0x514 0x514 0x514 0x514 0x514 0x514 0x514 0x514 0x514 0x514 0x514 0x514 0x514 0x514 0x514 0x514 0x514 0x514 0x514 0x514 0x514 0x514 0x514 0x514 0x514 0x514 0x514 0x514 0x514 0x514 0x514 0x514 0x514 0x514 0x514 0x514 0x514 0x514 0x514 0x514 0x514 0x514 0x514 0x514 0x514 0x514 0x514 0x514 0x514 0x514 0x514 0x514 0x514 0x514 0x514 0x514 0x514 0x514 0x514 0x514 0x514 0x514 0x514 0x514 0x514 0x514 0x514 0x514 0x514 0x514 0x514 0x514 0x514 0x514 0x514 0x514 0x514 0x514 0x514 0x514 0x514 0x514 0x514 0x514 0x514 0x514 0x514 0x514 0x514 0x514 0x514 0x514 0x514 0x514 0x514 0x514 0x514 0x514 0x514 0x514 0x514 0x514 0x514 0x514 0x514 0x514 0x514 0x514 0x514 0x514 0x514 0x514 0x514 0x514 0x514 0x514 0x514 0x514 0x514 0x514 0x514 0x514 0x514 0x514 0x514 0x514 0x514 0x514 0x514 0x514 0x514 0x514 0x514 0x514 0x514 0x514 0x514 0x514 0x514 0x514 0x514 0x514 0x514 0x514 0x514 0x514 0x514 0x514 0x514 0x514 0x514 0x514 0x514 0x514 0x514 0x514 0x514 0x514 0x514 0x514 0x514 0x514 0x514 0x514 0x514 0x514 0x514 0x514 0x514 0x514 0x514 0x514 0x514 0x514 0x514 0x514 0x514 0x514 0x514 0x514 0x514 0x514 0x514 0x514 0x514 0x514 0x514 0x514 0x514 0x514 0x514 0x514 0x514 0x514 0x514 0x514 0x514 0x514 0x514 0x514 0x514 0x514 0x514 0x514 0x514 0x514 0x514 0x514 0x514 0x514 0x514 0x514 0x514 0x514 0x514 0x514 0x514 0x514 0x514 0x514 0x514 0x514 0x514 0x514 0x514 0x514 0x514 0x514 0x514 0x514 0x514 0x514 0x514 0x514 0x514 0x514 0x514 0x514 0x514 0x514 0x514 0x514 0x514 0x514 0x514 0x514 0x514 0x514 0x514 0x514 0x514 0x514 0x514 0x514 0x514 0x514 0x514 0x514 0x514 0x514 0x514 0x514 0x514 0x514 0x514 0x514 0x514 0x514 0x514 0x514 0x514 0x514 0x514 0x514 0x514 0x514 0x514 0x514 0x514 0x514 0x514 0x514 0x514 0x514 0x514 0x514 0x514 0x514 0x514 0x514 0x514 0x514 0x514 0x514 0x514 0x514 0x514 0x514 0x514 0x514 0x514 0x514 0x514 0x514 0x514 0x514 0x514 0x514 0x514 0x514 0x514 0x514 0x514 0x514 0x514 0x514 0x514 0x514 0x514 0x514 0x514 0x514 0x514 0x514 0x514 0x514 0x514 0x514 0x514 0x514 0x514 0x514 0x514 0x514 0x514 0x514 0x514 0x514 0x514 0x514 0x514 0x514 0x514 0x514 0x514 0x514 0x514 0x514 0x514 0x514 0x514 0x514 0x514 0x514 0x514 0x514 0x514 0x514 0x514 0x514 0x514 0x514 0x514 0x514 0x514 0x514 0x514 0x514 0x514 0x514 0x514 0x514 0x514 0x514 0x514 0x514 0x514 0x514 0x514 0x514 0x514 0x514 0x514 0x514 0x514 0x514 0x514 0x514 0x514 0x514 0x514 0x514 0x514 0x514 0x514 0x514 0x514 0x514 0x514 0x514 0x514 0x514 0x514 0x514 0x514 0x514 0x514 0x514 0x514 0x514 0x514 0x514 0x514 0x514 0x514 0x514 0x514 0x514 0x514 0x514 0x514 0x514 0x514 0x514 0x514 0x514 0x514 0x514 0x514 0x514 0x514 0x514 0x514 0x514 0x514 0x514 0x514 0x514 0x514 0x514 0x514 0x514 0x514 0x514 0x514 0x514 0x514 0x514 0x514 0x514 0x514 0x514 0x514 0x514 0x514 0x514 0x514 0x514 0x514 0x514 0x514 0x514 0x514 0x514 0x514 0x514 0x514 0x514 0x514 0x514 0x514 0x514 0x514 0x514 0x514 0x514 0x514 0x514 0x514 0x514 0x514 0x514 0x514 0x514 0x514 0x514 0x514 0x514 0x514 0x514 0x514 0x514 0x514 0x514 0x514 0x514 0x514 0x514 0x514 0x514 0x514 0x514 0x514 0x514 0x514 0x514 0x514 0x514 0x514 0x514 0x514 0x514 0x514 0x514 0x514 0x514 0x514 0x514 0x514 0x514 0x514 0x514 0x514 0x514 0x514 0x514 0x514 0x514 0x514 0x514 0x514 0x514 0x514 0x514 0x514 0x514 0x514 0x514 0x514 0x514 0x514 0x514 0x514 0x514 0x514 0x514 0x514 0x514 0x514 0x514 0x514 0x514 0x514 0x514 0x514 0x514 0x514 0x514 0x514 0x514 0x514 0x514 0x514 0x514 0x514 0x514 0x514 0x514 0x514 0x514 0x514 0x514 0x514 0x514 0x514 0x514 0x514 0x514 0x514 0x514 0x514 0x514 0x514 0x514 0x514 0x514 0x514 0x514 0x514 0x514 0x514 0x514 0x514 0x514 0x514 0x514 0x514 0x514 0x514 0x514 0x514 0x514 0x514 0x514 0x514 0x514 0x514 0x514 0x514 0x514 0x514 0x514 0x514 0x514 0x514 0x514 0x514 0x514 0x514 0x514 0x514 0x514 0x514 0x514 0x514 0x514 0x514 0x514 0x514 0x514 0x514 0x514 0x514 0x514 0x514 0x514 0x514 0x514 0x514 0x514 0x514 0x514 0x514 0x514 0x514 0x514 0x514 0x514 0x514 0x514 0x514 0x514 0x514 0x514 0x514 0x514 0x514 0x514 0x514 0x514 0x514 0x514 0x514 0x514 0x514 0x514 0x514 0x514 0x514 0x514 0x514 0x514 0x514 0x514 0x514 0x514 0x514 0x514 0x514 0x514 0x514 0x514 0x514 0x514 0x514 0x514 0x514 0x514 0x514 0x514 0x514 0x514 0x514 0x514 0x514 0x514 0x514 0x514 0x514 0x514 0x514 0x514 0x514 0x514 0x514 0x514 0x514 0x514 0x514 0x514 0x514 0x514 0x514 0x514 0x514 0x514 0x514 0x514 0x514 0x514 0x514 0x514 0x514 0x514 0x514 0x514 0x514 0x514 0x514 0x514 0x514 0x514 0x514 0x514 0x514 0x514 0x514 0x514 0x514 0x514 0x514 0x514 0x514 0x514 0x514 0x514 0x514 0x514 0x514 0x514 0x514 0x514 0x514 0x514 0x514 0x514 0x514 0x514 0x514 0x514 0x514 0x514 0x514 0x514 0x514 0x514 0x514 0x514 0x514 0x514 0x514 0x514 0x514 0x514 0x514 0x514 0x514 0x514 0x514 0x514 0x514 0x514 0x514 0x514 0x514 0x514 0x514 0x514 0x514 0x514 0x514 0x514 0x514 0x514 0x514 0x514 0x514 0x514 0x514 0x514 0x514 0x514 0x514 0x514 0x514 0x514 0x514 0x514 0x514 0x514 0x514 0x514 0x514 0x514 0x514 0x514 0x514 0x514 0x514 0x514 0x514 0x514 0x514 0x514>;
				pt7_hi_limits_cols_01 = <0x26>;
				pt7_hi_limits_cols_02 = <0x26>;
				pt7_hi_limits_row_01 = <0x26>;
				pt7_hi_limits_row_02 = <0x26>;
				pt7_lo_limits_01 = <0x226 0x226 0x226 0x226 0x226 0x226 0x226 0x226 0x226 0x226 0x226 0x226 0x226 0x226 0x226 0x226 0x226 0x226 0x226 0x226 0x226 0x226 0x226 0x226 0x226 0x226 0x226 0x226 0x226 0x226 0x226 0x226 0x226 0x226 0x226 0x226 0x226 0x226 0x226 0x226 0x226 0x226 0x226 0x226 0x226 0x226 0x226 0x226 0x226 0x226 0x226 0x226 0x226 0x226 0x226 0x226 0x226 0x226 0x226 0x226 0x226 0x226 0x226 0x226 0x226 0x226 0x226 0x226 0x226 0x226 0x226 0x226 0x226 0x226 0x226 0x226 0x226 0x226 0x226 0x226 0x226 0x226 0x226 0x226 0x226 0x226 0x226 0x226 0x226 0x226 0x226 0x226 0x226 0x226 0x226 0x226 0x226 0x226 0x226 0x226 0x226 0x226 0x226 0x226 0x226 0x226 0x226 0x226 0x226 0x226 0x226 0x226 0x226 0x226 0x226 0x226 0x226 0x226 0x226 0x226 0x226 0x226 0x226 0x226 0x226 0x226 0x226 0x226 0x226 0x226 0x226 0x226 0x226 0x226 0x226 0x226 0x226 0x226 0x226 0x226 0x226 0x226 0x226 0x226 0x226 0x226 0x226 0x226 0x226 0x226 0x226 0x226 0x226 0x226 0x226 0x226 0x226 0x226 0x226 0x226 0x226 0x226 0x226 0x226 0x226 0x226 0x226 0x226 0x226 0x226 0x226 0x226 0x226 0x226 0x226 0x226 0x226 0x226 0x226 0x226 0x226 0x226 0x226 0x226 0x226 0x226 0x226 0x226 0x226 0x226 0x226 0x226 0x226 0x226 0x226 0x226 0x226 0x226 0x226 0x226 0x226 0x226 0x226 0x226 0x226 0x226 0x226 0x226 0x226 0x226 0x226 0x226 0x226 0x226 0x226 0x226 0x226 0x226 0x226 0x226 0x226 0x226 0x226 0x226 0x226 0x226 0x226 0x226 0x226 0x226 0x226 0x226 0x226 0x226 0x226 0x226 0x226 0x226 0x226 0x226 0x226 0x226 0x226 0x226 0x226 0x226 0x226 0x226 0x226 0x226 0x226 0x226 0x226 0x226 0x226 0x226 0x226 0x226 0x226 0x226 0x226 0x226 0x226 0x226 0x226 0x226 0x226 0x226 0x226 0x226 0x226 0x226 0x226 0x226 0x226 0x226 0x226 0x226 0x226 0x226 0x226 0x226 0x226 0x226 0x226 0x226 0x226 0x226 0x226 0x226 0x226 0x226 0x226 0x226 0x226 0x226 0x226 0x226 0x226 0x226 0x226 0x226 0x226 0x226 0x226 0x226 0x226 0x226 0x226 0x226 0x226 0x226 0x226 0x226 0x226 0x226 0x226 0x226 0x226 0x226 0x226 0x226 0x226 0x226 0x226 0x226 0x226 0x226 0x226 0x226 0x226 0x226 0x226 0x226 0x226 0x226 0x226 0x226 0x226 0x226 0x226 0x226 0x226 0x226 0x226 0x226 0x226 0x226 0x226 0x226 0x226 0x226 0x226 0x226 0x226 0x226 0x226 0x226 0x226 0x226 0x226 0x226 0x226 0x226 0x226 0x226 0x226 0x226 0x226 0x226 0x226 0x226 0x226 0x226 0x226 0x226 0x226 0x226 0x226 0x226 0x226 0x226 0x226 0x226 0x226 0x226 0x226 0x226 0x226 0x226 0x226 0x226 0x226 0x226 0x226 0x226 0x226 0x226 0x226 0x226 0x226 0x226 0x226 0x226 0x226 0x226 0x226 0x226 0x226 0x226 0x226 0x226 0x226 0x226 0x226 0x226 0x226 0x226 0x226 0x226 0x226 0x226 0x226 0x226 0x226 0x226 0x226 0x226 0x226 0x226 0x226 0x226 0x226 0x226 0x226 0x226 0x226 0x226 0x226 0x226 0x226 0x226 0x226 0x226 0x226 0x226 0x226 0x226 0x226 0x226 0x226 0x226 0x226 0x226 0x226 0x226 0x226 0x226 0x226 0x226 0x226 0x226 0x226 0x226 0x226 0x226 0x226 0x226 0x226 0x226 0x226 0x226 0x226 0x226 0x226 0x226 0x226 0x226 0x226 0x226 0x226 0x226 0x226 0x226 0x226 0x226 0x226 0x226 0x226 0x226 0x226 0x226 0x226 0x226 0x226 0x226 0x226 0x226 0x226 0x226 0x226 0x226 0x226 0x226 0x226 0x226 0x226 0x226 0x226 0x226 0x226 0x226 0x226 0x226 0x226 0x226 0x226 0x226 0x226 0x226 0x226 0x226 0x226 0x226 0x226 0x226 0x226 0x226 0x226 0x226 0x226 0x226 0x226 0x226 0x226 0x226 0x226 0x226 0x226 0x226 0x226 0x226 0x226 0x226 0x226 0x226 0x226 0x226 0x226 0x226 0x226 0x226 0x226 0x226 0x226 0x226 0x226 0x226 0x226 0x226 0x226 0x226 0x226 0x226 0x226 0x226 0x226 0x226 0x226 0x226 0x226 0x226 0x226 0x226 0x226 0x226 0x226 0x226 0x226 0x226 0x226 0x226 0x226 0x226 0x226 0x226 0x226 0x226 0x226 0x226 0x226 0x226 0x226 0x226 0x226 0x226 0x226 0x226 0x226 0x226 0x226 0x226 0x226 0x226 0x226 0x226 0x226 0x226 0x226 0x226 0x226 0x226 0x226 0x226 0x226 0x226 0x226 0x226 0x226 0x226 0x226 0x226 0x226 0x226 0x226 0x226 0x226 0x226 0x226 0x226 0x226 0x226 0x226 0x226 0x226 0x226 0x226 0x226 0x226 0x226 0x226 0x226 0x226 0x226 0x226 0x226 0x226 0x226 0x226 0x226 0x226 0x226 0x226 0x226 0x226 0x226 0x226 0x226 0x226 0x226 0x226 0x226 0x226 0x226 0x226 0x226 0x226 0x226 0x226 0x226 0x226 0x226 0x226 0x226 0x226 0x226 0x226 0x226 0x226 0x226 0x226 0x226 0x226 0x226 0x226 0x226 0x226 0x226 0x226 0x226 0x226 0x226 0x226 0x226 0x226 0x226 0x226 0x226 0x226 0x226 0x226 0x226 0x226 0x226 0x226 0x226 0x226 0x226 0x226 0x226 0x226 0x226 0x226 0x226 0x226 0x226 0x226 0x226 0x226 0x226 0x226 0x226 0x226 0x226 0x226 0x226 0x226 0x226 0x226 0x226 0x226 0x226 0x226 0x226 0x226 0x226 0x226 0x226 0x226 0x226 0x226 0x226 0x226 0x226 0x226 0x226 0x226 0x226 0x226 0x226 0x226 0x226 0x226 0x226 0x226 0x226 0x226 0x226 0x226 0x226 0x226 0x226 0x226 0x226 0x226 0x226 0x226 0x226 0x226 0x226 0x226 0x226 0x226 0x226 0x226 0x226 0x226 0x226 0x226 0x226 0x226 0x226 0x226 0x226 0x226 0x226 0x226 0x226 0x226 0x226 0x226 0x226 0x226 0x226 0x226 0x226 0x226 0x226 0x226 0x226 0x226 0x226 0x226 0x226 0x226 0x226 0x226 0x226 0x226 0x226 0x226 0x226 0x226 0x226 0x226 0x226 0x226 0x226 0x226 0x226 0x226 0x226 0x226 0x226 0x226 0x226 0x226 0x226 0x226 0x226 0x226 0x226 0x226 0x226 0x226 0x226 0x226 0x226 0x226 0x226 0x226 0x226 0x226 0x226 0x226 0x226 0x226 0x226 0x226 0x226 0x226 0x226 0x226 0x226 0x226 0x226 0x226 0x226 0x226 0x226 0x226 0x226 0x226 0x226 0x226 0x226 0x226 0x226 0x226 0x226 0x226 0x226 0x226 0x226 0x226 0x226 0x226 0x226 0x226 0x226 0x226 0x226 0x226 0x226 0x226 0x226 0x226 0x226 0x226 0x226 0x226 0x226 0x226 0x226 0x226 0x226 0x226 0x226 0x226 0x226 0x226 0x226 0x226 0x226 0x226 0x226 0x226 0x226 0x226 0x226 0x226 0x226 0x226 0x226 0x226 0x226 0x226 0x226 0x226 0x226 0x226 0x226 0x226 0x226 0x226 0x226 0x226 0x226 0x226 0x226 0x226 0x226 0x226 0x226 0x226 0x226 0x226 0x226 0x226 0x226 0x226 0x226 0x226 0x226 0x226 0x226 0x226 0x226 0x226 0x226 0x226 0x226 0x226 0x226 0x226 0x226 0x226 0x226 0x226 0x226 0x226 0x226 0x226 0x226 0x226 0x226 0x226 0x226 0x226 0x226 0x226 0x226 0x226 0x226 0x226 0x226 0x226 0x226 0x226 0x226 0x226 0x226 0x226 0x226 0x226 0x226 0x226 0x226 0x226 0x226 0x226 0x226 0x226 0x226 0x226 0x226 0x226 0x226 0x226 0x226 0x226 0x226 0x226 0x226 0x226 0x226 0x226 0x226 0x226 0x226 0x226 0x226 0x226 0x226 0x226 0x226 0x226 0x226 0x226 0x226 0x226 0x226 0x226 0x226 0x226 0x226 0x226 0x226 0x226 0x226 0x226 0x226 0x226 0x226 0x226 0x226 0x226 0x226 0x226 0x226 0x226 0x226 0x226 0x226 0x226 0x226 0x226 0x226 0x226 0x226 0x226 0x226 0x226 0x226 0x226 0x226 0x226 0x226 0x226 0x226 0x226 0x226 0x226 0x226 0x226 0x226 0x226 0x226 0x226 0x226 0x226 0x226 0x226 0x226 0x226 0x226 0x226 0x226 0x226 0x226 0x226 0x226 0x226 0x226 0x226 0x226 0x226 0x226 0x226 0x226 0x226 0x226 0x226 0x226 0x226 0x226 0x226 0x226 0x226 0x226 0x226 0x226 0x226 0x226 0x226 0x226 0x226 0x226 0x226 0x226 0x226 0x226 0x226 0x226 0x226 0x226 0x226 0x226 0x226 0x226 0x226 0x226 0x226 0x226 0x226 0x226 0x226 0x226 0x226 0x226 0x226 0x226 0x226 0x226 0x226 0x226 0x226 0x226 0x226 0x226 0x226 0x226 0x226 0x226 0x226 0x226 0x226 0x226 0x226 0x226 0x226 0x226 0x226 0x226 0x226 0x226 0x226 0x226 0x226 0x226 0x226 0x226 0x226 0x226 0x226 0x226 0x226 0x226 0x226 0x226 0x226 0x226 0x226 0x226 0x226 0x226 0x226 0x226 0x5a0 0x226 0x226 0x226 0x226 0x226 0x226 0x226 0x226 0x226 0x226 0x226 0x226 0x226 0x226 0x226 0x226 0x5a0 0x226 0x226 0x226 0x226 0x226 0x226 0x226 0x226 0x226 0x226 0x226 0x226 0x226 0x226 0x226 0x226 0x226 0x226 0x226 0x226 0x226 0x226 0x226 0x226 0x226 0x226 0x226 0x226 0x226 0x226 0x226 0x226 0x226 0x226 0x226 0x226 0x226 0x226 0x226 0x226 0x226 0x226 0x226 0x226 0x226 0x226 0x226 0x226 0x226 0x226 0x226 0x226 0x226 0x226 0x226 0x226 0x226 0x226 0x226 0x226 0x226 0x226 0x226 0x226 0x226 0x226 0x226 0x226 0x226 0x226 0x226 0x226 0x226 0x226 0x226 0x226 0x226 0x226 0x226 0x226 0x226 0x226 0x226 0x226 0x226 0x226 0x226 0x226 0x226 0x226 0x226 0x226 0x226 0x226 0x226 0x226 0x226 0x226 0x226 0x226 0x226 0x226 0x226 0x226 0x226 0x226 0x226 0x226 0x226 0x226 0x226 0x226 0x226 0x226 0x226 0x226 0x226 0x226 0x226 0x226 0x226 0x226 0x226 0x226 0x226 0x226 0x226 0x226 0x226 0x226 0x226 0x226 0x226 0x226 0x226 0x226 0x226 0x226 0x226 0x226 0x226 0x226 0x226 0x226 0x226 0x226 0x226 0x226 0x226 0x226 0x226 0x226 0x226 0x226 0x226 0x226 0x226 0x226 0x226 0x226 0x226 0x226 0x226 0x226 0x226 0x226 0x226 0x226 0x226 0x226 0x226 0x226 0x226 0x226 0x226 0x226 0x226 0x226 0x226 0x226 0x226 0x226 0x226 0x226 0x226 0x226 0x226 0x226 0x226 0x226 0x226 0x226 0x226 0x226 0x226 0x226 0x226 0x226 0x226 0x226 0x226 0x226 0x226 0x226 0x226 0x226 0x226 0x226 0x226 0x226 0x226 0x226 0x226 0x226 0x226 0x226 0x226 0x226 0x226 0x226 0x226 0x226 0x226 0x226 0x226 0x226 0x226 0x226 0x226 0x226 0x226 0x226 0x226 0x226 0x226 0x226 0x226 0x226 0x226 0x226 0x226 0x226 0x226 0x226 0x226 0x226 0x226 0x226>;
				pt7_lo_limits_02 = <0x226 0x226 0x226 0x226 0x226 0x226 0x226 0x226 0x226 0x226 0x226 0x226 0x226 0x226 0x226 0x226 0x226 0x226 0x226 0x226 0x226 0x226 0x226 0x226 0x226 0x226 0x226 0x226 0x226 0x226 0x226 0x226 0x226 0x226 0x226 0x226 0x226 0x226 0x226 0x226 0x226 0x226 0x226 0x226 0x226 0x226 0x226 0x226 0x226 0x226 0x226 0x226 0x226 0x226 0x226 0x226 0x226 0x226 0x226 0x226 0x226 0x226 0x226 0x226 0x226 0x226 0x226 0x226 0x226 0x226 0x226 0x226 0x226 0x226 0x226 0x226 0x226 0x226 0x226 0x226 0x226 0x226 0x226 0x226 0x226 0x226 0x226 0x226 0x226 0x226 0x226 0x226 0x226 0x226 0x226 0x226 0x226 0x226 0x226 0x226 0x226 0x226 0x226 0x226 0x226 0x226 0x226 0x226 0x226 0x226 0x226 0x226 0x226 0x226 0x226 0x226 0x226 0x226 0x226 0x226 0x226 0x226 0x226 0x226 0x226 0x226 0x226 0x226 0x226 0x226 0x226 0x226 0x226 0x226 0x226 0x226 0x226 0x226 0x226 0x226 0x226 0x226 0x226 0x226 0x226 0x226 0x226 0x226 0x226 0x226 0x226 0x226 0x226 0x226 0x226 0x226 0x226 0x226 0x226 0x226 0x226 0x226 0x226 0x226 0x226 0x226 0x226 0x226 0x226 0x226 0x226 0x226 0x226 0x226 0x226 0x226 0x226 0x226 0x226 0x226 0x226 0x226 0x226 0x226 0x226 0x226 0x226 0x226 0x226 0x226 0x226 0x226 0x226 0x226 0x226 0x226 0x226 0x226 0x226 0x226 0x226 0x226 0x226 0x226 0x226 0x226 0x226 0x226 0x226 0x226 0x226 0x226 0x226 0x226 0x226 0x226 0x226 0x226 0x226 0x226 0x226 0x226 0x226 0x226 0x226 0x226 0x226 0x226 0x226 0x226 0x226 0x226 0x226 0x226 0x226 0x226 0x226 0x226 0x226 0x226 0x226 0x226 0x226 0x226 0x226 0x226 0x226 0x226 0x226 0x226 0x226 0x226 0x226 0x226 0x226 0x226 0x226 0x226 0x226 0x226 0x226 0x226 0x226 0x226 0x226 0x226 0x226 0x226 0x226 0x226 0x226 0x226 0x226 0x226 0x226 0x226 0x226 0x226 0x226 0x226 0x226 0x226 0x226 0x226 0x226 0x226 0x226 0x226 0x226 0x226 0x226 0x226 0x226 0x226 0x226 0x226 0x226 0x226 0x226 0x226 0x226 0x226 0x226 0x226 0x226 0x226 0x226 0x226 0x226 0x226 0x226 0x226 0x226 0x226 0x226 0x226 0x226 0x226 0x226 0x226 0x226 0x226 0x226 0x226 0x226 0x226 0x226 0x226 0x226 0x226 0x226 0x226 0x226 0x226 0x226 0x226 0x226 0x226 0x226 0x226 0x226 0x226 0x226 0x226 0x226 0x226 0x226 0x226 0x226 0x226 0x226 0x226 0x226 0x226 0x226 0x226 0x226 0x226 0x226 0x226 0x226 0x226 0x226 0x226 0x226 0x226 0x226 0x226 0x226 0x226 0x226 0x226 0x226 0x226 0x226 0x226 0x226 0x226 0x226 0x226 0x226 0x226 0x226 0x226 0x226 0x226 0x226 0x226 0x226 0x226 0x226 0x226 0x226 0x226 0x226 0x226 0x226 0x226 0x226 0x226 0x226 0x226 0x226 0x226 0x226 0x226 0x226 0x226 0x226 0x226 0x226 0x226 0x226 0x226 0x226 0x226 0x226 0x226 0x226 0x226 0x226 0x226 0x226 0x226 0x226 0x226 0x226 0x226 0x226 0x226 0x226 0x226 0x226 0x226 0x226 0x226 0x226 0x226 0x226 0x226 0x226 0x226 0x226 0x226 0x226 0x226 0x226 0x226 0x226 0x226 0x226 0x226 0x226 0x226 0x226 0x226 0x226 0x226 0x226 0x226 0x226 0x226 0x226 0x226 0x226 0x226 0x226 0x226 0x226 0x226 0x226 0x226 0x226 0x226 0x226 0x226 0x226 0x226 0x226 0x226 0x226 0x226 0x226 0x226 0x226 0x226 0x226 0x226 0x226 0x226 0x226 0x226 0x226 0x226 0x226 0x226 0x226 0x226 0x226 0x226 0x226 0x226 0x226 0x226 0x226 0x226 0x226 0x226 0x226 0x226 0x226 0x226 0x226 0x226 0x226 0x226 0x226 0x226 0x226 0x226 0x226 0x226 0x226 0x226 0x226 0x226 0x226 0x226 0x226 0x226 0x226 0x226 0x226 0x226 0x226 0x226 0x226 0x226 0x226 0x226 0x226 0x226 0x226 0x226 0x226 0x226 0x226 0x226 0x226 0x226 0x226 0x226 0x226 0x226 0x226 0x226 0x226 0x226 0x226 0x226 0x226 0x226 0x226 0x226 0x226 0x226 0x226 0x226 0x226 0x226 0x226 0x226 0x226 0x226 0x226 0x226 0x226 0x226 0x226 0x226 0x226 0x226 0x226 0x226 0x226 0x226 0x226 0x226 0x226 0x226 0x226 0x226 0x226 0x226 0x226 0x226 0x226 0x226 0x226 0x226 0x226 0x226 0x226 0x226 0x226 0x226 0x226 0x226 0x226 0x226 0x226 0x226 0x226 0x226 0x226 0x226 0x226 0x226 0x226 0x226 0x226 0x226 0x226 0x226 0x226 0x226 0x226 0x226 0x226 0x226 0x226 0x226 0x226 0x226 0x226 0x226 0x226 0x226 0x226 0x226 0x226 0x226 0x226 0x226 0x226 0x226 0x226 0x226 0x226 0x226 0x226 0x226 0x226 0x226 0x226 0x226 0x226 0x226 0x226 0x226 0x226 0x226 0x226 0x226 0x226 0x226 0x226 0x226 0x226 0x226 0x226 0x226 0x226 0x226 0x226 0x226 0x226 0x226 0x226 0x226 0x226 0x226 0x226 0x226 0x226 0x226 0x226 0x226 0x226 0x226 0x226 0x226 0x226 0x226 0x226 0x226 0x226 0x226 0x226 0x226 0x226 0x226 0x226 0x226 0x226 0x226 0x226 0x226 0x226 0x226 0x226 0x226 0x226 0x226 0x226 0x226 0x226 0x226 0x226 0x226 0x226 0x226 0x226 0x226 0x226 0x226 0x226 0x226 0x226 0x226 0x226 0x226 0x226 0x226 0x226 0x226 0x226 0x226 0x226 0x226 0x226 0x226 0x226 0x226 0x226 0x226 0x226 0x226 0x226 0x226 0x226 0x226 0x226 0x226 0x226 0x226 0x226 0x226 0x226 0x226 0x226 0x226 0x226 0x226 0x226 0x226 0x226 0x226 0x226 0x226 0x226 0x226 0x226 0x226 0x226 0x226 0x226 0x226 0x226 0x226 0x226 0x226 0x226 0x226 0x226 0x226 0x226 0x226 0x226 0x226 0x226 0x226 0x226 0x226 0x226 0x226 0x226 0x226 0x226 0x226 0x226 0x226 0x226 0x226 0x226 0x226 0x226 0x226 0x226 0x226 0x226 0x226 0x226 0x226 0x226 0x226 0x226 0x226 0x226 0x226 0x226 0x226 0x226 0x226 0x226 0x226 0x226 0x226 0x226 0x226 0x226 0x226 0x226 0x226 0x226 0x226 0x226 0x226 0x226 0x226 0x226 0x226 0x226 0x226 0x226 0x226 0x226 0x226 0x226 0x226 0x226 0x226 0x226 0x226 0x226 0x226 0x226 0x226 0x226 0x226 0x226 0x226 0x226 0x226 0x226 0x226 0x226 0x226 0x226 0x226 0x226 0x226 0x226 0x226 0x226 0x226 0x226 0x226 0x226 0x226 0x226 0x226 0x226 0x226 0x226 0x226 0x226 0x226 0x226 0x226 0x226 0x226 0x226 0x226 0x226 0x226 0x226 0x226 0x226 0x226 0x226 0x226 0x226 0x226 0x226 0x226 0x226 0x226 0x226 0x226 0x226 0x226 0x226 0x226 0x226 0x226 0x226 0x226 0x226 0x226 0x226 0x226 0x226 0x226 0x226 0x226 0x226 0x226 0x226 0x226 0x226 0x226 0x226 0x226 0x226 0x226 0x226 0x226 0x226 0x226 0x226 0x226 0x226 0x226 0x226 0x226 0x226 0x226 0x226 0x226 0x226 0x226 0x226 0x226 0x226 0x226 0x226 0x226 0x226 0x226 0x226 0x226 0x226 0x226 0x226 0x226 0x226 0x226 0x226 0x226 0x226 0x226 0x226 0x226 0x226 0x226 0x226 0x226 0x226 0x226 0x226 0x226 0x226 0x226 0x226 0x226 0x226 0x226 0x226 0x226 0x226 0x226 0x226 0x226 0x226 0x226 0x226 0x226 0x226 0x226 0x226 0x226 0x226 0x226 0x226 0x226 0x226 0x226 0x226 0x226 0x226 0x226 0x226 0x226 0x226 0x226 0x226 0x226 0x226 0x226 0x226 0x226 0x226 0x226 0x226 0x226 0x226 0x226 0x226 0x226 0x226 0x226 0x226 0x226 0x226 0x226 0x226 0x226 0x226 0x226 0x226 0x226 0x226 0x226 0x226 0x226 0x226 0x226 0x226 0x226 0x226 0x226 0x226 0x226 0x226 0x226 0x226 0x226 0x226 0x226 0x226 0x226 0x226 0x226 0x226 0x226 0x226 0x226 0x226 0x226 0x226 0x226 0x226 0x226 0x226 0x226 0x226 0x226 0x226 0x226 0x226 0x226 0x226 0x226 0x226 0x226 0x226 0x226 0x226 0x226 0x226 0x226 0x226 0x226 0x226 0x226 0x226 0x226 0x226 0x226 0x226 0x226 0x226 0x226 0x226 0x226 0x226 0x226 0x226 0x226 0x226 0x226 0x226 0x226 0x226 0x226 0x226 0x226 0x226 0x226 0x226 0x226 0x226 0x226 0x226 0x226 0x226 0x226 0x226 0x226 0x226 0x226 0x226 0x226 0x226 0x226 0x226 0x226 0x226 0x226 0x226 0x226 0x226 0x226 0x226 0x226 0x226 0x226 0x226 0x226 0x226 0x226 0x226 0x226 0x226 0x226 0x226 0x226 0x226 0x226 0x226 0x226 0x226 0x226 0x226 0x226 0x226 0x226 0x226 0x226 0x226 0x226 0x226 0x226 0x226 0x226 0x226 0x226 0x226 0x226 0x226 0x226 0x226 0x226 0x226 0x226 0x226 0x226 0x226 0x226 0x226 0x226 0x226 0x226 0x226 0x226 0x226 0x226 0x226 0x226 0x226 0x226 0x226 0x226 0x226 0x226 0x226 0x226 0x226 0x226 0x226 0x226 0x226 0x226 0x226 0x226 0x226 0x226 0x226 0x226 0x226 0x226 0x226 0x226 0x226 0x226 0x226 0x226 0x226 0x226 0x226 0x226 0x226 0x226 0x226 0x226 0x226 0x226 0x226 0x226 0x226 0x226 0x226 0x226 0x226 0x226 0x226 0x226 0x226 0x226 0x226 0x226 0x226 0x226 0x226 0x226 0x226 0x226 0x226 0x226 0x226 0x226 0x226 0x226 0x226 0x226 0x226 0x226 0x226 0x226 0x226 0x226 0x226 0x226 0x226 0x226 0x226 0x226 0x226 0x226 0x226 0x226 0x226 0x226 0x226 0x226 0x226 0x226 0x226 0x226 0x226 0x226 0x226 0x226 0x226 0x226 0x226 0x226 0x226 0x226 0x226 0x226 0x226 0x226 0x226 0x226 0x226 0x226 0x226 0x226 0x226 0x226 0x226 0x226 0x226 0x226 0x226 0x226 0x226 0x226 0x226 0x226 0x226 0x226 0x226 0x226 0x226 0x226 0x226 0x226 0x226 0x226 0x226 0x226 0x226 0x226 0x226 0x226 0x226 0x226 0x226 0x226 0x226 0x226 0x226 0x226 0x226 0x226 0x226 0x226 0x226 0x226 0x226 0x226 0x226 0x226 0x226 0x226 0x226 0x226 0x226 0x226 0x226 0x226 0x226 0x226 0x226 0x226 0x226 0x226 0x226 0x226 0x226 0x226 0x226 0x226 0x226 0x226 0x226 0x226 0x226 0x226 0x226 0x226 0x226 0x226 0x226 0x226 0x226 0x226 0x226 0x226 0x226 0x226 0x226 0x226 0x226 0x226 0x226 0x226 0x226 0x226 0x226 0x226 0x226 0x226 0x226 0x226 0x226 0x226 0x226 0x226 0x226 0x226 0x226 0x226 0x226 0x226 0x226 0x226 0x226 0x226 0x226 0x226 0x226 0x226 0x226 0x226 0x226 0x226 0x226 0x226 0x226 0x226 0x226 0x226 0x226 0x226 0x226 0x226 0x226 0x226 0x226 0x226>;
				pt7_lo_limits_cols_01 = <0x26>;
				pt7_lo_limits_cols_02 = <0x26>;
				pt7_lo_limits_row_01 = <0x26>;
				pt7_lo_limits_row_02 = <0x26>;
				reg = <0x0>;
				spi-max-frequency = <0x7a1200>;
				status = "okay";
			};
		};
	};

	fragment@34 {
		target = <0xffffffff>;

		__overlay__ {
			compatible = "mediatek,touch";
			pinctrl-0 = <0x24>;
			pinctrl-1 = <0x25>;
			pinctrl-2 = <0x26>;
			pinctrl-3 = <0x27>;
			pinctrl-4 = <0x28>;
			pinctrl-5 = <0x29>;
			pinctrl-names = "default", "state_eint_as_int", "state_eint_output0", "state_eint_output1", "state_rst_output0", "state_rst_output1";
			status = "okay";
			tpd-filter-custom-prameters = <0x0 0x0 0x0 0x0 0x0 0x0 0x0 0x0 0x0 0x0 0x0 0x0>;
			tpd-filter-custom-speed = <0x0 0x0 0x0>;
			tpd-filter-enable = <0x0>;
			tpd-filter-pixel-density = <0x6a>;
			tpd-key-dim-local = <0x5a 0x373 0x64 0x28 0xe6 0x373 0x64 0x28 0x172 0x373 0x64 0x28 0x0 0x0 0x0 0x0>;
			tpd-key-local = <0x8b 0xac 0x9e 0x0>;
			tpd-key-num = <0x3>;
			tpd-max-touch-num = <0x5>;
			tpd-resolution = <0x2d0 0x64c>;
			use-tpd-button = <0x0>;
		};
	};

	fragment@35 {
		target = <0xffffffff>;

		__overlay__ {

			ctpeint@0 {
				phandle = <0x25>;

				pins_cmd_dat {
					pinmux = <0x400>;
					slew-rate = <0x0>;
				};
			};

			eint0default {
				phandle = <0x24>;
			};

			eintoutput0 {
				phandle = <0x26>;

				pins_cmd_dat {
					output-low;
					pinmux = <0x400>;
					slew-rate = <0x1>;
				};
			};

			eintoutput1 {
				phandle = <0x27>;

				pins_cmd_dat {
					output-high;
					pinmux = <0x400>;
					slew-rate = <0x1>;
				};
			};

			rstoutput0 {
				phandle = <0x28>;

				pins_cmd_dat {
					output-low;
					pinmux = <0xae00>;
					slew-rate = <0x1>;
				};
			};

			rstoutput1 {
				phandle = <0x29>;

				pins_cmd_dat {
					output-high;
					pinmux = <0xae00>;
					slew-rate = <0x1>;
				};
			};
		};
	};

	fragment@36 {
		target = <0xffffffff>;

		__overlay__ {

			aw32257@6a {
				awinic,chg-en-gpio = <0xffffffff 0x1 0x0>;
				compatible = "awinic,aw32257";
				reg = <0x6a>;
			};
		};
	};

	fragment@37 {
		target = <0xffffffff>;

		__overlay__ {

			tran_battery {
				compatible = "tran,chg_fun";
				enable_pcb_tml;
				jeita_above_t4_chg_cur = <0x0>;
				jeita_above_t4_input_cur = <0xf4240>;
				jeita_below_t0_chg_cur = <0x0>;
				jeita_below_t0_input_cur = <0x16e360>;
				jeita_t0_to_t1_chg_cur = <0xf4240>;
				jeita_t0_to_t1_input_cur = <0x16e360>;
				jeita_t2_to_t3_chg_cur = <0x1e8480>;
				jeita_t2_to_t3_input_cur = <0x200b20>;
				jeita_t3_to_t4_chg_cur = <0x1e8480>;
				jeita_t3_to_t4_input_cur = <0x200b20>;
				md_pa_current_limit = <0x7a120>;
				md_pa_input_current_limit = <0x7a120>;
				md_pa_temp_thres = <0xd6d8>;
				md_pa_temp_thres_minus_x_degree = <0xcb20>;
				pcb_cur_step_one = <0xc8>;
				pcb_cur_step_two = <0x2bc>;
				pcb_min_chg_cur = <0x124f80>;
				pcb_temp_step_one = <0xa028>;
				pcb_temp_step_two = <0xabe0>;
				phandle = <0x4f>;
				pinctrl-0 = <0x2a>;
				pinctrl-1 = <0x2b>;
				pinctrl-2 = <0x2c>;
				pinctrl-3 = <0x2d>;
				pinctrl-4 = <0x2e>;
				pinctrl-5 = <0x2f>;
				pinctrl-names = "otg_gpio_init", "otg_gpio_low", "otg_gpio_high", "meta_gpio_init", "meta_gpio_low", "meta_gpio_high";
			};

			tran_battery_aging {
				battery_aging_module0 = <0x0>;
				battery_aging_module1 = <0x0>;
				battery_aging_module2 = <0x0>;
				battery_aging_module3 = <0x0>;
				compatible = "tran,chg_aging";
				phandle = <0x50>;
			};
		};
	};

	fragment@38 {
		target = <0xffffffff>;

		__overlay__ {
			ac_charger_current = <0x1e8480>;
			ac_charger_input_current = <0x1e8480>;
			algorithm_name = "Basic";
			apple_1_0a_charger_current = <0x9eb10>;
			apple_2_1a_charger_current = <0xc3500>;
			battery_cv = <0x432380 0x432380 0x432380 0x432380>;
			bif_cv_under_threshold2 = <0x43e6d0>;
			bif_threshold1 = <0x40d990>;
			bif_threshold2 = <0x419ce0>;
			cable_imp_threshold = <0x2bb>;
			charger = <0xffffffff>;
			charger_configuration = <0x0>;
			charging_host_charger_current = <0x16e360>;
			chg1_ta_ac_charger_current = <0x16e360>;
			chg2_ta_ac_charger_current = <0x16e360>;
			compatible = "mediatek,charger";
			disable_pd_dual;
			dual_polling_ieoc = <0x6ddd0>;
			enable_ir_comp;
			enable_min_charge_temp;
			enable_sw_jeita;
			high_temp_to_enter_pe40 = <0x27>;
			high_temp_to_leave_pe40 = <0x2e>;
			ibus_err = <0xe>;
			jeita_temp_above_t4_cv = <0x3e8fa0 0x3e8fa0 0x3e8fa0 0x3e8fa0>;
			jeita_temp_below_t0_cv = <0x432380 0x432380 0x432380 0x432380>;
			jeita_temp_t0_to_t1_cv = <0x432380 0x432380 0x432380 0x432380>;
			jeita_temp_t1_to_t2_cv = <0x432380 0x432380 0x432380 0x432380>;
			jeita_temp_t2_to_t3_cv = <0x432380 0x432380 0x432380 0x432380>;
			jeita_temp_t3_to_t4_cv = <0x3e8fa0 0x3e8fa0 0x3e8fa0 0x3e8fa0>;
			low_temp_to_enter_pe40 = <0x10>;
			low_temp_to_leave_pe40 = <0xa>;
			max_charge_temp = <0x35>;
			max_charge_temp_minus_x_degree = <0x34>;
			max_charger_voltage = <0x632ea0>;
			max_charging_time = <0x11940>;
			max_dmivr_charger_current = <0x155cc0>;
			min_charge_temp = <0x0>;
			min_charge_temp_plus_x_degree = <0x1>;
			min_charger_voltage = <0x4630c0>;
			min_charger_voltage_1 = <0x432380>;
			min_charger_voltage_2 = <0x401640>;
			multi_battery_cv;
			non_std_ac_charger_current = <0x124f80>;
			pd_ichg_level_threshold = <0xf4240>;
			pd_stop_battery_soc = <0x50>;
			pd_vbus_low_bound = <0x4c4b40>;
			pd_vbus_upper_bound = <0x4c4b40>;
			pe20_ichg_level_threshold = <0xf4240>;
			pe40_dual_charger_chg1_current = <0x1e8480>;
			pe40_dual_charger_chg2_current = <0x1e8480>;
			pe40_dual_charger_input_current = <0x2dc6c0>;
			pe40_r_cable_1a_lower = <0x206>;
			pe40_r_cable_2a_lower = <0x17f>;
			pe40_r_cable_3a_lower = <0xf5>;
			pe40_single_charger_current = <0x2dc6c0>;
			pe40_single_charger_input_current = <0x2dc6c0>;
			pe40_stop_battery_soc = <0x50>;
			pe_ichg_level_threshold = <0xf4240>;
			r_bat_comp = <0x1e>;
			slave_mivr_diff = <0x186a0>;
			ta_9v_support;
			ta_ac_12v_input_current = <0x30d400>;
			ta_ac_7v_input_current = <0x231860>;
			ta_ac_9v_input_current = <0x200b20>;
			ta_ac_charger_current = <0x2dc6c0>;
			ta_start_battery_soc = <0x0>;
			ta_stop_battery_soc = <0x5a>;
			temp_neg_10_thres = <0x2>;
			temp_t0_thres = <0x1>;
			temp_t0_thres_plus_x_degree = <0x1>;
			temp_t1_thres = <0x1>;
			temp_t1_thres_plus_x_degree = <0x1>;
			temp_t2_thres = <0xf>;
			temp_t2_thres_plus_x_degree = <0x10>;
			temp_t3_thres = <0x2d>;
			temp_t3_thres_minus_x_degree = <0x2c>;
			temp_t4_thres = <0x37>;
			temp_t4_thres_minus_x_degree = <0x33>;
			usb_charger_current = <0x7a120>;
			usb_charger_current_configured = <0x7a120>;
			usb_charger_current_suspend = <0x0>;
			usb_charger_current_unconfigured = <0x11170>;
			v_comp_max = <0x3a98>;
			vbat_cable_imp_threshold = <0x3b8260>;
			vsys_watt = <0x4c4b40>;
		};
	};

	fragment@39 {
		target = <0xffffffff>;

		__overlay__ {
			ac_charger_current = <0x16e360>;
			ac_charger_input_current = <0x16e360>;
			charging_host_charger_current = <0x16e360>;
			compatible = "mediatek,lk_charger";
			cur_threshold = <0x7a120>;
			enable_anime;
			fast_charge_voltage = <0x2625a0>;
			max_charger_voltage = <0x632ea0>;
			non_std_ac_charger_current = <0x7a120>;
			pd_charger_current = <0x7a120>;
			power_path_support;
			ta_ac_charger_current = <0x2dc6c0>;
			temp_t1_threshold = <0x0>;
			temp_t2_threshold = <0xf>;
			temp_t3_threshold = <0x2d>;
			temp_t4_threshold = <0x32>;
			usb_charger_current = <0x7a120>;
		};
	};

	fragment@4 {
		target = <0xffffffff>;

		__overlay__ {

			fingerprint_default {
				phandle = <0x7>;
			};

			gpio8_eint {
				phandle = <0x8>;

				pins_cmd_dat {
					bias-pull-down;
					output-low;
					pinmux = <0x800>;
					slew-rate = <0x0>;
				};
			};

			gpio8_eint_pull_down {
				phandle = <0x9>;

				pins_cmd_dat {
					bias-pull-down;
					output-low;
					pinmux = <0x800>;
					slew-rate = <0x0>;
				};
			};

			rst_out_one {
				phandle = <0xa>;

				pins_cmd_dat {
					bias-pull-down;
					output-high;
					pinmux = <0x1800>;
					slew-rate = <0x1>;
				};
			};

			rst_out_zero {
				phandle = <0xb>;

				pins_cmd_dat {
					bias-pull-down;
					output-low;
					pinmux = <0x1800>;
					slew-rate = <0x1>;
				};
			};
		};
	};

	fragment@40 {
		target = <0xffffffff>;

		__overlay__ {

			adc_channel@ {
				compatible = "mediatek,adc_channel";
				mediatek,adc_fdd_rf_params_dynamic_custom_ch = <0x2>;
				mediatek,temperature0 = <0x0>;
				mediatek,temperature1 = <0x1>;
				status = "okay";
			};
		};
	};

	fragment@41 {
		target = <0xffffffff>;

		__overlay__ {
			io-channels = <0xffffffff 0x2>;
		};
	};

	fragment@42 {
		target = <0xffffffff>;

		__overlay__ {
			mediatek,clkbuf-config = <0x2 0x1 0x1 0x2 0x0 0x0 0x0>;
			mediatek,clkbuf-driving-current = <0x1 0x1 0x1 0x1 0x1 0x1 0x1>;
			mediatek,clkbuf-quantity = <0x7>;
			status = "okay";
		};
	};

	fragment@43 {
		target = <0xffffffff>;

		__overlay__ {
			#address-cells = <0x1>;
			#size-cells = <0x0>;
			clock-frequency = <0x61a80>;
			mediatek,use-open-drain;
		};
	};

	fragment@44 {
		target = <0xffffffff>;

		__overlay__ {
			#address-cells = <0x1>;
			#size-cells = <0x0>;
			clock-frequency = <0x61a80>;
			mediatek,use-open-drain;
		};
	};

	fragment@45 {
		target = <0xffffffff>;

		__overlay__ {
			#address-cells = <0x1>;
			#size-cells = <0x0>;
			clock-frequency = <0x61a80>;
			mediatek,use-open-drain;

			camera_main@1a {
				compatible = "mediatek,camera_main";
				phandle = <0x51>;
				reg = <0x1a>;
				status = "okay";
			};

			camera_main_af@0c {
				compatible = "mediatek,camera_main_af";
				phandle = <0x53>;
				reg = <0xc>;
				status = "okay";
			};

			camera_main_eeprom@50 {
				compatible = "mediatek,camera_main_eeprom";
				phandle = <0x52>;
				reg = <0x50>;
				status = "okay";
			};
		};
	};

	fragment@46 {
		target = <0xffffffff>;

		__overlay__ {
			#address-cells = <0x1>;
			#size-cells = <0x0>;
			clock-frequency = <0x61a80>;
			mediatek,use-open-drain;

			ext_buck_lp4@57 {
				compatible = "mediatek,ext_buck_lp4";
				phandle = <0x57>;
				reg = <0x57>;
				status = "okay";
			};

			ext_buck_lp4x@50 {
				compatible = "mediatek,ext_buck_lp4x";
				phandle = <0x58>;
				reg = <0x50>;
				status = "okay";
			};

			nfc@08 {
				compatible = "mediatek,nfc";
				phandle = <0x56>;
				reg = <0x8>;
				status = "okay";
			};

			slave_charger@4b {
				compatible = "mediatek,slave_charger";
				phandle = <0x55>;
				reg = <0x4b>;
				status = "okay";
			};

			speaker_amp@34 {
				compatible = "mediatek,speaker_amp";
				phandle = <0x54>;
				reg = <0x34>;
				status = "okay";
			};
		};
	};

	fragment@47 {
		target = <0xffffffff>;

		__overlay__ {
			#address-cells = <0x1>;
			#size-cells = <0x0>;
			clock-frequency = <0x61a80>;
			mediatek,use-open-drain;

			camera_sub@2d {
				compatible = "mediatek,camera_sub";
				phandle = <0x59>;
				reg = <0x2d>;
				status = "okay";
			};

			camera_sub_eeprom@51 {
				compatible = "mediatek,camera_sub_eeprom";
				phandle = <0x5a>;
				reg = <0x51>;
				status = "okay";
			};
		};
	};

	fragment@48 {
		target = <0xffffffff>;

		__overlay__ {
			#address-cells = <0x1>;
			#size-cells = <0x0>;
			clock-frequency = <0x61a80>;
			mediatek,use-open-drain;

			i2c_lcd_bias@3e {
				compatible = "mediatek,i2c_lcd_bias";
				phandle = <0x5b>;
				reg = <0x3e>;
				status = "okay";
			};

			strobe_main@63 {
				compatible = "mediatek,strobe_main";
				phandle = <0x5e>;
				reg = <0x63>;
				status = "okay";
			};

			subpmic_pmu@34 {
				compatible = "mediatek,subpmic_pmu";
				phandle = <0x5c>;
				reg = <0x34>;
				status = "okay";
			};

			usb_type_c@4e {
				compatible = "mediatek,usb_type_c";
				phandle = <0x5d>;
				reg = <0x4e>;
				status = "okay";
			};
		};
	};

	fragment@49 {
		target = <0xffffffff>;

		__overlay__ {
			#address-cells = <0x1>;
			#size-cells = <0x0>;
			clock-frequency = <0x61a80>;
			mediatek,use-open-drain;

			ext_buck_vgpu@55 {
				compatible = "mediatek,ext_buck_vgpu";
				phandle = <0x5f>;
				reg = <0x55>;
				status = "okay";
			};
		};
	};

	fragment@5 {
		target = <0xffffffff>;

		__overlay__ {
			#address-cells = <0x1>;
			#size-cells = <0x0>;
			clock-frequency = <0x61a80>;

			mtk-usb@60 {
				compatible = "mediatek,mtk-usb";
				reg = <0x60>;
				status = "okay";
			};
		};
	};

	fragment@50 {
		target = <0xffffffff>;

		__overlay__ {
			#address-cells = <0x1>;
			#size-cells = <0x0>;
			clock-frequency = <0x61a80>;
			mediatek,use-open-drain;
		};
	};

	fragment@51 {
		target = <0xffffffff>;

		__overlay__ {
			#address-cells = <0x1>;
			#size-cells = <0x0>;
			clock-frequency = <0x61a80>;
			mediatek,use-open-drain;
		};
	};

	fragment@52 {
		target = <0xffffffff>;

		__overlay__ {
			#address-cells = <0x1>;
			#size-cells = <0x0>;
			clock-frequency = <0x61a80>;
			mediatek,use-open-drain;
		};
	};

	fragment@53 {
		target = <0xffffffff>;

		__overlay__ {
			GPIO_FDD_BAND_SUPPORT_DETECT_1ST_PIN = <0xffffffff 0x42 0x0>;
			GPIO_FDD_BAND_SUPPORT_DETECT_2ND_PIN = <0xffffffff 0x43 0x0>;
			GPIO_FDD_BAND_SUPPORT_DETECT_3RD_PIN = <0xffffffff 0x44 0x0>;
			GPIO_SIM1_HOT_PLUG = <0xffffffff 0x2f 0x0>;
			GPIO_SIM1_SCLK = <0xffffffff 0x26 0x0>;
			GPIO_SIM1_SIO = <0xffffffff 0x28 0x0>;
			GPIO_SIM1_SRST = <0xffffffff 0x27 0x0>;
			GPIO_SIM2_SCLK = <0xffffffff 0x25 0x0>;
			GPIO_SIM2_SIO = <0xffffffff 0x23 0x0>;
			GPIO_SIM2_SRST = <0xffffffff 0x24 0x0>;
		};
	};

	fragment@54 {
		target = <0xffffffff>;

		__overlay__ {
			gpio_init_default = <0x0 0x0 0x0 0x0 0x1 0x1 0x1 0x1 0x0 0x1 0x0 0x0 0x0 0x0 0x2 0x0 0x0 0x0 0x1 0x1 0x1 0x3 0x0 0x0 0x0 0x1 0x0 0x1 0x4 0x0 0x0 0x0 0x1 0x1 0x0 0x5 0x5 0x0 0x0 0x0 0x0 0x0 0x6 0x0 0x0 0x0 0x1 0x1 0x0 0x7 0x0 0x0 0x0 0x1 0x0 0x0 0x8 0x0 0x0 0x0 0x1 0x0 0x0 0x9 0x0 0x0 0x0 0x1 0x1 0x0 0xa 0x0 0x0 0x0 0x1 0x0 0x0 0xb 0x0 0x0 0x0 0x1 0x1 0x0 0xc 0x0 0x0 0x0 0x1 0x0 0x0 0xd 0x3 0x0 0x0 0x1 0x0 0x0 0xe 0x3 0x0 0x0 0x0 0x0 0x0 0xf 0x3 0x0 0x0 0x0 0x0 0x0 0x10 0x3 0x0 0x0 0x0 0x0 0x0 0x11 0x2 0x1 0x0 0x1 0x0 0x0 0x12 0x2 0x1 0x0 0x0 0x0 0x0 0x13 0x2 0x0 0x0 0x0 0x0 0x0 0x14 0x2 0x1 0x0 0x1 0x0 0x0 0x15 0x0 0x1 0x0 0x0 0x0 0x0 0x16 0x2 0x0 0x0 0x0 0x0 0x0 0x17 0x0 0x0 0x0 0x1 0x1 0x0 0x18 0x3 0x0 0x0 0x1 0x0 0x0 0x19 0x3 0x0 0x0 0x1 0x0 0x0 0x1a 0x3 0x0 0x0 0x1 0x0 0x0 0x1b 0x3 0x0 0x0 0x0 0x0 0x0 0x1c 0x3 0x0 0x0 0x1 0x0 0x0 0x1d 0x1 0x0 0x0 0x1 0x0 0x1 0x1e 0x1 0x0 0x0 0x1 0x0 0x1 0x1f 0x1 0x0 0x0 0x1 0x0 0x1 0x20 0x1 0x0 0x0 0x1 0x0 0x1 0x21 0x1 0x0 0x0 0x1 0x0 0x1 0x22 0x1 0x0 0x0 0x1 0x0 0x1 0x23 0x1 0x0 0x0 0x1 0x1 0x0 0x24 0x1 0x0 0x0 0x0 0x0 0x0 0x25 0x1 0x0 0x0 0x0 0x0 0x0 0x26 0x1 0x0 0x0 0x0 0x0 0x0 0x27 0x1 0x0 0x0 0x0 0x0 0x0 0x28 0x1 0x0 0x0 0x1 0x1 0x0 0x29 0x0 0x0 0x0 0x1 0x1 0x0 0x2a 0x0 0x0 0x0 0x1 0x0 0x0 0x2b 0x1 0x1 0x0 0x1 0x0 0x0 0x2c 0x1 0x0 0x0 0x1 0x0 0x0 0x2d 0x0 0x1 0x0 0x1 0x0 0x0 0x2e 0x0 0x0 0x0 0x1 0x0 0x0 0x2f 0x1 0x0 0x0 0x1 0x1 0x0 0x30 0x1 0x0 0x0 0x1 0x1 0x1 0x31 0x1 0x0 0x0 0x1 0x1 0x1 0x32 0x1 0x0 0x0 0x1 0x1 0x1 0x33 0x1 0x0 0x0 0x1 0x1 0x1 0x34 0x1 0x0 0x0 0x1 0x0 0x0 0x35 0x1 0x0 0x0 0x1 0x0 0x0 0x36 0x1 0x0 0x0 0x1 0x0 0x0 0x37 0x1 0x0 0x0 0x1 0x0 0x0 0x38 0x1 0x0 0x0 0x1 0x0 0x0 0x39 0x1 0x0 0x0 0x1 0x0 0x0 0x3a 0x0 0x0 0x0 0x1 0x0 0x0 0x3b 0x1 0x0 0x0 0x1 0x0 0x0 0x3c 0x1 0x0 0x0 0x1 0x0 0x0 0x3d 0x1 0x0 0x0 0x1 0x0 0x0 0x3e 0x1 0x0 0x0 0x1 0x0 0x0 0x3f 0x1 0x0 0x0 0x1 0x0 0x0 0x40 0x1 0x0 0x0 0x1 0x0 0x0 0x41 0x0 0x0 0x0 0x1 0x0 0x0 0x42 0x0 0x0 0x0 0x1 0x0 0x0 0x43 0x0 0x0 0x0 0x1 0x0 0x0 0x44 0x0 0x0 0x0 0x1 0x0 0x0 0x45 0x1 0x0 0x0 0x1 0x0 0x0 0x46 0x1 0x0 0x0 0x1 0x0 0x0 0x47 0x1 0x0 0x0 0x1 0x0 0x0 0x48 0x1 0x0 0x0 0x1 0x0 0x0 0x49 0x1 0x0 0x0 0x1 0x0 0x0 0x4a 0x1 0x0 0x0 0x1 0x0 0x0 0x4b 0x1 0x0 0x0 0x1 0x0 0x0 0x4c 0x1 0x0 0x0 0x1 0x0 0x0 0x4d 0x1 0x0 0x0 0x1 0x0 0x0 0x4e 0x1 0x0 0x0 0x1 0x0 0x0 0x4f 0x1 0x0 0x0 0x1 0x0 0x0 0x50 0x1 0x0 0x0 0x1 0x0 0x0 0x51 0x1 0x0 0x0 0x1 0x1 0x1 0x52 0x1 0x0 0x0 0x1 0x1 0x1 0x53 0x1 0x0 0x0 0x1 0x1 0x1 0x54 0x1 0x0 0x0 0x1 0x1 0x1 0x55 0x1 0x0 0x0 0x1 0x0 0x0 0x56 0x1 0x0 0x0 0x1 0x0 0x0 0x57 0x0 0x1 0x1 0x1 0x0 0x0 0x58 0x0 0x1 0x0 0x1 0x0 0x0 0x59 0x1 0x0 0x0 0x1 0x0 0x0 0x5a 0x2 0x0 0x0 0x0 0x0 0x0 0x5b 0x0 0x1 0x0 0x0 0x0 0x0 0x5c 0x1 0x0 0x0 0x0 0x0 0x0 0x5d 0x1 0x0 0x0 0x1 0x1 0x0 0x5e 0x1 0x0 0x0 0x1 0x1 0x0 0x5f 0x1 0x0 0x0 0x1 0x1 0x0 0x60 0x1 0x0 0x0 0x0 0x0 0x0 0x61 0x0 0x1 0x0 0x1 0x0 0x0 0x62 0x0 0x1 0x0 0x1 0x0 0x0 0x63 0x1 0x0 0x0 0x0 0x0 0x0 0x64 0x1 0x0 0x0 0x0 0x0 0x0 0x65 0x0 0x1 0x0 0x1 0x0 0x0 0x66 0x0 0x1 0x0 0x1 0x0 0x0 0x67 0x1 0x0 0x0 0x1 0x1 0x1 0x68 0x1 0x0 0x0 0x1 0x1 0x1 0x69 0x1 0x0 0x0 0x1 0x1 0x1 0x6a 0x1 0x0 0x0 0x1 0x1 0x1 0x6b 0x2 0x0 0x0 0x0 0x0 0x0 0x6c 0x1 0x0 0x0 0x0 0x0 0x0 0x6d 0x2 0x0 0x0 0x1 0x1 0x0 0x6e 0x0 0x0 0x0 0x1 0x0 0x0 0x6f 0x0 0x0 0x0 0x1 0x0 0x0 0x70 0x0 0x0 0x0 0x1 0x0 0x0 0x71 0x0 0x0 0x0 0x1 0x0 0x0 0x72 0x0 0x0 0x0 0x1 0x0 0x0 0x73 0x0 0x0 0x0 0x1 0x0 0x0 0x74 0x0 0x0 0x0 0x1 0x0 0x0 0x75 0x0 0x0 0x0 0x1 0x0 0x0 0x76 0x0 0x0 0x0 0x1 0x0 0x0 0x77 0x0 0x0 0x0 0x1 0x0 0x0 0x78 0x0 0x0 0x0 0x1 0x0 0x0 0x79 0x0 0x0 0x0 0x1 0x0 0x0 0x86 0x1 0x0 0x0 0x1 0x0 0x1 0x87 0x1 0x0 0x0 0x0 0x0 0x0 0x88 0x1 0x0 0x0 0x0 0x0 0x0 0x89 0x1 0x0 0x0 0x0 0x0 0x0 0x8a 0x1 0x0 0x0 0x0 0x0 0x0 0x8b 0x1 0x0 0x0 0x0 0x0 0x0 0x8c 0x1 0x0 0x0 0x1 0x0 0x0 0x8d 0x1 0x0 0x0 0x1 0x0 0x0 0x8e 0x1 0x0 0x0 0x1 0x0 0x0 0x8f 0x1 0x0 0x0 0x1 0x0 0x0 0x90 0x1 0x0 0x0 0x1 0x0 0x0 0x91 0x1 0x0 0x0 0x0 0x0 0x0 0x92 0x1 0x0 0x0 0x1 0x0 0x0 0x93 0x1 0x0 0x0 0x0 0x0 0x0 0x94 0x1 0x0 0x0 0x0 0x0 0x0 0x95 0x1 0x0 0x0 0x0 0x0 0x0 0x96 0x6 0x0 0x0 0x1 0x1 0x0 0x97 0x0 0x1 0x0 0x1 0x0 0x0 0x98 0x5 0x0 0x0 0x1 0x1 0x0 0x99 0x0 0x1 0x0 0x1 0x0 0x0 0x9a 0x0 0x1 0x0 0x1 0x0 0x0 0x9b 0x1 0x0 0x0 0x1 0x0 0x0 0x9c 0x1 0x1 0x0 0x1 0x0 0x0 0x9d 0x1 0x1 0x0 0x1 0x0 0x0 0x9e 0x1 0x1 0x0 0x1 0x0 0x0 0x9f 0x0 0x1 0x0 0x1 0x0 0x0 0xa0 0x0 0x1 0x0 0x1 0x0 0x0 0xa1 0x1 0x0 0x0 0x1 0x1 0x1 0xa2 0x1 0x0 0x0 0x1 0x1 0x1 0xa3 0x0 0x0 0x0 0x0 0x0 0x0 0xa4 0x0 0x0 0x0 0x0 0x0 0x0 0xa5 0x0 0x0 0x0 0x1 0x0 0x0 0xa6 0x0 0x0 0x0 0x1 0x0 0x0 0xa7 0x0 0x0 0x0 0x1 0x0 0x0 0xa8 0x0 0x0 0x0 0x1 0x0 0x0 0xa9 0x0 0x1 0x0 0x1 0x0 0x0 0xaa 0x0 0x1 0x0 0x1 0x0 0x0 0xab 0x0 0x0 0x0 0x1 0x1 0x1 0xac 0x0 0x1 0x1 0x1 0x0 0x0 0xad 0x0 0x1 0x0 0x1 0x0 0x0 0xae 0x0 0x1 0x0 0x1 0x0 0x0 0xaf 0x0 0x1 0x0 0x1 0x0 0x0 0xb0 0x0 0x1 0x0 0x1 0x0 0x0 0xb1 0x0 0x1 0x0 0x1 0x0 0x0 0xb2 0x0 0x1 0x0 0x1 0x0 0x0 0xb3 0x0 0x0 0x0 0x1 0x0 0x0>;
		};
	};

	fragment@55 {
		target = <0xffffffff>;

		__overlay__ {
			deb-gpios = <0xffffffff 0x0 0x0>;
			debounce = <0x186a0>;
			interrupt-parent = <0xffffffff>;
			interrupts = <0x0 0x4 0x0 0x0>;
			status = "okay";
		};
	};

	fragment@56 {
		target = <0xffffffff>;

		__overlay__ {
			deb-gpios = <0xffffffff 0x2 0x0>;
			debounce = <0x7d000>;
			interrupt-parent = <0xffffffff>;
			interrupts = <0x2 0x8 0x2 0x0>;
			status = "okay";
		};
	};

	fragment@57 {
		target = <0xffffffff>;

		__overlay__ {
			interrupt-parent = <0xffffffff>;
			interrupts = <0x4 0x8 0x4 0x0>;
			status = "okay";
		};
	};

	fragment@58 {
		target = <0xffffffff>;

		__overlay__ {
			deb-gpios = <0xffffffff 0x9 0x0>;
			debounce = <0x3e800>;
			interrupt-parent = <0xffffffff>;
			interrupts = <0x9 0x8 0x9 0x0>;
			status = "okay";
		};
	};

	fragment@59 {
		target = <0xffffffff>;

		__overlay__ {
			interrupt-parent = <0xffffffff>;
			interrupts = <0xa 0x4 0xa 0x0>;
			status = "okay";
		};
	};

	fragment@6 {
		target = <0xffffffff>;

		__overlay__ {

			ext_buck_lp4@57 {
				regulator-max-microvolt = <0x13d620>;
				regulator-min-microvolt = <0x493e0>;
				regulator-name = "ext_buck_vdd2";
				vsel_pin = <0x0>;
			};

			ext_buck_lp4x@50 {
				regulator-max-microvolt = <0x13d620>;
				regulator-min-microvolt = <0x493e0>;
				regulator-name = "ext_buck_vddq";
				vsel_pin = <0x1>;
			};
		};
	};

	fragment@60 {
		target = <0xffffffff>;

		__overlay__ {
			interrupt-parent = <0xffffffff>;
			interrupts = <0xb 0x2 0xb 0x0>;
			status = "okay";
		};
	};

	fragment@61 {
		target = <0xffffffff>;

		__overlay__ {
			interrupt-parent = <0xffffffff>;
			interrupts = <0x17 0x8 0x17 0x0>;
			status = "okay";
		};
	};

	fragment@62 {
		target = <0xffffffff>;

		__overlay__ {
			interrupt-parent = <0xffffffff>;
			interrupts = <0x29 0x8 0x29 0x0>;
			status = "okay";
		};
	};

	fragment@63 {
		target = <0xffffffff>;

		__overlay__ {
			interrupt-parent = <0xffffffff>;
			interrupts = <0x2c 0x1 0x2c 0x1>;
			status = "okay";
		};
	};

	fragment@64 {
		target = <0xffffffff>;

		__overlay__ {
			interrupt-parent = <0xffffffff>;
			interrupts = <0x90 0x4 0x90 0x1>;
			status = "okay";
		};
	};

	fragment@65 {
		target = <0xffffffff>;

		__overlay__ {
			compatible = "mediatek,md1_sim1_hot_plug_eint-eint";
			debounce = <0x0 0xc350>;
			dedicated = <0x0 0x0>;
			interrupts = <0x0 0x8>;
			sockettype = <0x0 0x0>;
			src_pin = <0x0 0x1>;
			status = "okay";
		};
	};

	fragment@66 {
		target = <0xffffffff>;

		__overlay__ {
			regulator-default-on = <0x1>;
			regulator-name = "vcama";
			status = "okay";
		};
	};

	fragment@67 {
		target = <0xffffffff>;

		__overlay__ {
			regulator-default-on = <0x1>;
			regulator-name = "vsim1";
			status = "okay";
		};
	};

	fragment@68 {
		target = <0xffffffff>;

		__overlay__ {
			regulator-default-on = <0x1>;
			regulator-name = "vsim2";
			status = "okay";
		};
	};

	fragment@69 {
		target = <0xffffffff>;

		__overlay__ {
			regulator-default-on = <0x1>;
			regulator-name = "vcamd";
			status = "okay";
		};
	};

	fragment@7 {
		target = <0xffffffff>;

		__overlay__ {

			ext_buck_vgpu@55 {
				regulator-max-microvolt = <0x13d620>;
				regulator-min-microvolt = <0x493e0>;
				regulator-name = "ext_buck_vgpu";
				vsel_pin = <0x2>;
			};
		};
	};

	fragment@70 {
		target = <0xffffffff>;

		__overlay__ {
			regulator-default-on = <0x1>;
			regulator-name = "vcamio";
			status = "okay";
		};
	};

	fragment@71 {
		target = <0xffffffff>;

		__overlay__ {
			regulator-default-on = <0x1>;
			regulator-name = "vldo28";
			status = "okay";
		};
	};

	fragment@72 {
		target = <0xffffffff>;

		__overlay__ {
			status = "okay";
			vcama_main2-supply = <0xffffffff>;
			vcamaf-supply = <0xffffffff>;
			vcamd-supply = <0xffffffff>;
			vcamd_sub-supply = <0xffffffff>;
			vcamio-supply = <0xffffffff>;
			vcamio_sub-supply = <0xffffffff>;
		};
	};

	fragment@73 {
		target = <0xffffffff>;

		__overlay__ {
			status = "okay";
			vtouch-supply = <0xffffffff>;
		};
	};

	fragment@74 {
		target = <0xffffffff>;

		__overlay__ {
			mediatek,kpd-hw-dl-key0 = <0x0>;
			mediatek,kpd-hw-dl-key1 = <0x1>;
			mediatek,kpd-hw-dl-key2 = <0x8>;
			mediatek,kpd-hw-factory-key = <0x1>;
			mediatek,kpd-hw-init-map = <0x73 0x72 0x0 0x0 0x0 0x0 0x0 0x0 0x0 0x0 0x0 0x0 0x0 0x0 0x0 0x0 0x0 0x0 0x0 0x0 0x0 0x0 0x0 0x0 0x0 0x0 0x0 0x0 0x0 0x0 0x0 0x0 0x0 0x0 0x0 0x0 0x0 0x0 0x0 0x0 0x0 0x0 0x0 0x0 0x0 0x0 0x0 0x0 0x0 0x0 0x0 0x0 0x0 0x0 0x0 0x0 0x0 0x0 0x0 0x0 0x0 0x0 0x0 0x0 0x0 0x0 0x0 0x0 0x0 0x0 0x0 0x0>;
			mediatek,kpd-hw-map-num = <0x48>;
			mediatek,kpd-hw-pwrkey = <0x8>;
			mediatek,kpd-hw-recovery-key = <0x0>;
			mediatek,kpd-key-debounce = <0x400>;
			mediatek,kpd-pwkey-gpio-din = <0x0>;
			mediatek,kpd-pwrkey-eint-gpio = <0x0>;
			mediatek,kpd-sw-pwrkey = <0x74>;
			mediatek,kpd-use-extend-type = <0x0>;
			status = "okay";
		};
	};

	fragment@75 {
		target = <0xffffffff>;

		__overlay__ {

			cam0@0 {
				phandle = <0x31>;

				pins_cmd_dat {
					output-low;
					pinmux = <0x6600>;
					slew-rate = <0x1>;
				};
			};

			cam0@1 {
				phandle = <0x32>;

				pins_cmd_dat {
					output-high;
					pinmux = <0x6600>;
					slew-rate = <0x1>;
				};
			};

			cam0@2 {
				phandle = <0x33>;

				pins_cmd_dat {
					output-low;
					pinmux = <0x6200>;
					slew-rate = <0x1>;
				};
			};

			cam0@3 {
				phandle = <0x34>;

				pins_cmd_dat {
					output-high;
					pinmux = <0x6200>;
					slew-rate = <0x1>;
				};
			};

			cam0@vcama0 {
				phandle = <0x3a>;

				pins_cmd_dat {
					output-low;
					pinmux = <0x9900>;
					slew-rate = <0x1>;
				};
			};

			cam0@vcama1 {
				phandle = <0x39>;

				pins_cmd_dat {
					output-high;
					pinmux = <0x9900>;
					slew-rate = <0x1>;
				};
			};

			cam1@0 {
				phandle = <0x35>;

				pins_cmd_dat {
					output-low;
					pinmux = <0x6500>;
					slew-rate = <0x1>;
				};
			};

			cam1@1 {
				phandle = <0x36>;

				pins_cmd_dat {
					output-high;
					pinmux = <0x6500>;
					slew-rate = <0x1>;
				};
			};

			cam1@2 {
				phandle = <0x37>;

				pins_cmd_dat {
					output-low;
					pinmux = <0x6100>;
					slew-rate = <0x1>;
				};
			};

			cam1@3 {
				phandle = <0x38>;

				pins_cmd_dat {
					output-high;
					pinmux = <0x6100>;
					slew-rate = <0x1>;
				};
			};

			cam1@vcama0 {
				phandle = <0x3c>;

				pins_cmd_dat {
					output-low;
					pinmux = <0x9900>;
					slew-rate = <0x1>;
				};
			};

			cam1@vcama1 {
				phandle = <0x3b>;

				pins_cmd_dat {
					output-high;
					pinmux = <0x9900>;
					slew-rate = <0x1>;
				};
			};

			camdefault {
				phandle = <0x30>;
			};

			camera_pins_cam0_mclk_off {
				phandle = <0x3e>;

				pins_cmd_dat {
					pinmux = <0x6400>;
				};
			};

			camera_pins_cam0_mclk_on {
				phandle = <0x3d>;

				pins_cmd_dat {
					pinmux = <0x6401>;
				};
			};

			camera_pins_cam1_mclk_off {
				phandle = <0x40>;

				pins_cmd_dat {
					pinmux = <0x6300>;
				};
			};

			camera_pins_cam1_mclk_on {
				phandle = <0x3f>;

				pins_cmd_dat {
					pinmux = <0x6301>;
				};
			};

			camera_pins_cam2_mclk_off {
				phandle = <0x42>;

				pins_cmd_dat {
					pinmux = <0x6c00>;
				};
			};

			camera_pins_cam2_mclk_on {
				phandle = <0x41>;

				pins_cmd_dat {
					pinmux = <0x6c01>;
				};
			};
		};
	};

	fragment@76 {
		target = <0xffffffff>;

		__overlay__ {
			cam0_vcamd-supply = <0xffffffff>;
			cam0_vcamio-supply = <0xffffffff>;
			cam1_vcamd-supply = <0xffffffff>;
			cam1_vcamio-supply = <0xffffffff>;
			cam2_vcama-supply = <0xffffffff>;
			pinctrl-0 = <0x30>;
			pinctrl-1 = <0x31>;
			pinctrl-10 = <0x3a>;
			pinctrl-11 = <0x3b>;
			pinctrl-12 = <0x3c>;
			pinctrl-13 = <0x3d>;
			pinctrl-14 = <0x3e>;
			pinctrl-15 = <0x3f>;
			pinctrl-16 = <0x40>;
			pinctrl-17 = <0x41>;
			pinctrl-18 = <0x42>;
			pinctrl-2 = <0x32>;
			pinctrl-3 = <0x33>;
			pinctrl-4 = <0x34>;
			pinctrl-5 = <0x35>;
			pinctrl-6 = <0x36>;
			pinctrl-7 = <0x37>;
			pinctrl-8 = <0x38>;
			pinctrl-9 = <0x39>;
			pinctrl-names = "default", "cam0_rst0", "cam0_rst1", "cam0_pnd0", "cam0_pnd1", "cam1_rst0", "cam1_rst1", "cam1_pnd0", "cam1_pnd1", "cam0_vcama_on", "cam0_vcama_off", "cam1_vcama_on", "cam1_vcama_off", "cam0_mclk_on", "cam0_mclk_off", "cam1_mclk_on", "cam1_mclk_off", "cam2_mclk_on", "cam2_mclk_off";
			status = "okay";
		};
	};

	fragment@77 {
		target = <0xffffffff>;

		__overlay__ {

			aw36515default {
				phandle = <0x1>;
			};

			aw36515hwen_high {
				phandle = <0x2>;

				pins_cmd_dat {
					output-high;
					pinmux = <0x9800>;
					slew-rate = <0x1>;
				};
			};

			aw36515hwen_low {
				phandle = <0x3>;

				pins_cmd_dat {
					output-low;
					pinmux = <0x9800>;
					slew-rate = <0x1>;
				};
			};
		};
	};

	fragment@78 {
		target = <0xffffffff>;

		__overlay__ {

			ocp81375default {
				phandle = <0x4>;
			};

			ocp81375hwen_high {
				phandle = <0x5>;

				pins_cmd_dat {
					output-high;
					pinmux = <0x9800>;
					slew-rate = <0x1>;
				};
			};

			ocp81375hwen_low {
				phandle = <0x6>;

				pins_cmd_dat {
					output-low;
					pinmux = <0x9800>;
					slew-rate = <0x1>;
				};
			};
		};
	};

	fragment@8 {
		target = <0xffffffff>;

		__overlay__ {
			pinctrl-0 = <0xc>;
			pinctrl-names = "default";
		};
	};

	fragment@9 {
		target = <0xffffffff>;

		__overlay__ {

			kpdgpiodefault {
				phandle = <0xc>;

				pins_cmd_dat {
					bias-pull-up = <0x66>;
					input-schmitt-enable;
					output-low;
					pinmux = <0x5d01>;
				};
			};
		};
	};
};
